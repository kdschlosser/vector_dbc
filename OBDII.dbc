VERSION "1.0.0"

NS_ :

BS_:

BU_: OBD_COMPLIANT_ECUS OBD2_SCAN_TOOL
VAL_TABLE_ GlowPlugLampStatus 1 "On" 0 "Off" ;
VAL_TABLE_ TransmissionStatus 1 "In Gear" 0 "Park/Neutral" ;
VAL_TABLE_ EmissionsRequirements 16 "Heavy Duty Vehicles (EURO EEV) C" 15 "Heavy Duty Vehicles (EURO V) B2" 14 "Heavy Duty Vehicles (EURO IV) B1" ;
VAL_TABLE_ MonitorStatus 1 "Not Complete" 0 "Complete" ;
VAL_TABLE_ TrueFalse 1 "True" 0 "False" ;
VAL_TABLE_ IgnitionMonitorType 1 "Compression ignition monitor" 0 "Spark ignition monitor" ;
VAL_TABLE_ PTOStatus 1 "Enabled" 0 "Disabled" ;
VAL_TABLE_ SupportedUnsupported 1 "Supported" 0 "Unsupported" ;

BO_ 2015 TX: 8 OBD2_SCAN_TOOL
 SG_ EGR_B_CommandedDutyCyclePosition m105 : 63|8@0+ (0.392156862745098,0) [0|100] ""  OBD_COMPLIANT_ECUS
 SG_ IAT_B2S1 m104 : 63|8@0+ (1,-40) [-40|215] "°C"  OBD_COMPLIANT_ECUS
 SG_ EngineTorquePoint4 m100 : 63|8@0+ (1,-125) [-125|130] "%"  OBD_COMPLIANT_ECUS
 SG_ PID_08_Supported m0 : 48|1@0+ (1,0) [0|0] ""  OBD_COMPLIANT_ECUS
 SG_ PID_28_Supported m32 : 48|1@0+ (1,0) [0|0] ""  OBD_COMPLIANT_ECUS
 SG_ PID_48_Supported m64 : 48|1@0+ (1,0) [0|0] ""  OBD_COMPLIANT_ECUS
 SG_ Cat_NMHCCatMonitorStatus m65 : 48|1@0+ (1,0) [0|1] ""  OBD_COMPLIANT_ECUS
 SG_ PID_68_Supported m96 : 48|1@0+ (1,0) [0|0] ""  OBD_COMPLIANT_ECUS
 SG_ PID_88_Supported m128 : 48|1@0+ (1,0) [0|0] ""  OBD_COMPLIANT_ECUS
 SG_ PID_A8_Supported m160 : 48|1@0+ (1,0) [0|0] ""  OBD_COMPLIANT_ECUS
 SG_ PID_C8_Supported m192 : 48|1@0+ (1,0) [0|0] ""  OBD_COMPLIANT_ECUS
 SG_ PID_07_Supported m0 : 49|1@0+ (1,0) [0|0] ""  OBD_COMPLIANT_ECUS
 SG_ PID_27_Supported m32 : 49|1@0+ (1,0) [0|0] ""  OBD_COMPLIANT_ECUS
 SG_ PID_47_Supported m64 : 49|1@0+ (1,0) [0|0] ""  OBD_COMPLIANT_ECUS
 SG_ HeatedCat_NOxSCRMonitorStatus m65 : 49|1@0+ (1,0) [0|1] ""  OBD_COMPLIANT_ECUS
 SG_ PID_67_Supported m96 : 49|1@0+ (1,0) [0|0] ""  OBD_COMPLIANT_ECUS
 SG_ PID_87_Supported m128 : 49|1@0+ (1,0) [0|0] ""  OBD_COMPLIANT_ECUS
 SG_ PID_A7_Supported m160 : 49|1@0+ (1,0) [0|0] ""  OBD_COMPLIANT_ECUS
 SG_ PID_C7_Supported m192 : 49|1@0+ (1,0) [0|0] ""  OBD_COMPLIANT_ECUS
 SG_ PID_06_Supported m0 : 50|1@0+ (1,0) [0|0] ""  OBD_COMPLIANT_ECUS
 SG_ PID_26_Supported m32 : 50|1@0+ (1,0) [0|0] ""  OBD_COMPLIANT_ECUS
 SG_ PID_46_Supported m64 : 50|1@0+ (1,0) [0|0] ""  OBD_COMPLIANT_ECUS
 SG_ EvapMonitorStatus m65 : 50|1@0+ (1,0) [0|1] ""  OBD_COMPLIANT_ECUS
 SG_ PID_66_Supported m96 : 50|1@0+ (1,0) [0|0] ""  OBD_COMPLIANT_ECUS
 SG_ PID_86_Supported m128 : 50|1@0+ (1,0) [0|0] ""  OBD_COMPLIANT_ECUS
 SG_ PID_A6_Supported m160 : 50|1@0+ (1,0) [0|0] ""  OBD_COMPLIANT_ECUS
 SG_ PID_C6_Supported m192 : 50|1@0+ (1,0) [0|0] ""  OBD_COMPLIANT_ECUS
 SG_ PID_05_Supported m0 : 51|1@0+ (1,0) [0|0] ""  OBD_COMPLIANT_ECUS
 SG_ PID_25_Supported m32 : 51|1@0+ (1,0) [0|0] ""  OBD_COMPLIANT_ECUS
 SG_ PID_45_Supported m64 : 51|1@0+ (1,0) [0|0] ""  OBD_COMPLIANT_ECUS
 SG_ SecondaryAir_BoostPressureMonito m65 : 51|1@0+ (1,0) [0|1] ""  OBD_COMPLIANT_ECUS
 SG_ PID_65_Supported m96 : 51|1@0+ (1,0) [0|0] ""  OBD_COMPLIANT_ECUS
 SG_ PID_85_Supported m128 : 51|1@0+ (1,0) [0|0] ""  OBD_COMPLIANT_ECUS
 SG_ PID_A5_Supported m160 : 51|1@0+ (1,0) [0|0] ""  OBD_COMPLIANT_ECUS
 SG_ PID_C5_Supported m192 : 51|1@0+ (1,0) [0|0] ""  OBD_COMPLIANT_ECUS
 SG_ PID_04_Supported m0 : 52|1@0+ (1,0) [0|0] ""  OBD_COMPLIANT_ECUS
 SG_ PID_24_Supported m32 : 52|1@0+ (1,0) [0|0] ""  OBD_COMPLIANT_ECUS
 SG_ PID_44_Supported m64 : 52|1@0+ (1,0) [0|0] ""  OBD_COMPLIANT_ECUS
 SG_ PID_64_Supported m96 : 52|1@0+ (1,0) [0|0] ""  OBD_COMPLIANT_ECUS
 SG_ PID_84_Supported m128 : 52|1@0+ (1,0) [0|0] ""  OBD_COMPLIANT_ECUS
 SG_ PID_A4_Supported m160 : 52|1@0+ (1,0) [0|0] ""  OBD_COMPLIANT_ECUS
 SG_ PID_C4_Supported m192 : 52|1@0+ (1,0) [0|0] ""  OBD_COMPLIANT_ECUS
 SG_ PID_03_Supported m0 : 53|1@0+ (1,0) [0|0] ""  OBD_COMPLIANT_ECUS
 SG_ PID_23_Supported m32 : 53|1@0+ (1,0) [0|0] ""  OBD_COMPLIANT_ECUS
 SG_ PID_43_Supported m64 : 53|1@0+ (1,0) [0|0] ""  OBD_COMPLIANT_ECUS
 SG_ O2_ExhaustGasMonitorStatus m65 : 53|1@0+ (1,0) [0|1] ""  OBD_COMPLIANT_ECUS
 SG_ PID_63_Supported m96 : 53|1@0+ (1,0) [0|0] ""  OBD_COMPLIANT_ECUS
 SG_ PID_83_Supported m128 : 53|1@0+ (1,0) [0|0] ""  OBD_COMPLIANT_ECUS
 SG_ PID_A3_Supported m160 : 53|1@0+ (1,0) [0|0] ""  OBD_COMPLIANT_ECUS
 SG_ PID_C3_Supported m192 : 53|1@0+ (1,0) [0|0] ""  OBD_COMPLIANT_ECUS
 SG_ PID_02_Supported m0 : 54|1@0+ (1,0) [0|0] ""  OBD_COMPLIANT_ECUS
 SG_ PID_22_Supported m32 : 54|1@0+ (1,0) [0|0] ""  OBD_COMPLIANT_ECUS
 SG_ PID_42_Supported m64 : 54|1@0+ (1,0) [0|0] ""  OBD_COMPLIANT_ECUS
 SG_ O2_PMFilterMonitorStatus m65 : 54|1@0+ (1,0) [0|1] ""  OBD_COMPLIANT_ECUS
 SG_ PID_62_Supported m96 : 54|1@0+ (1,0) [0|0] ""  OBD_COMPLIANT_ECUS
 SG_ PID_82_Supported m128 : 54|1@0+ (1,0) [0|0] ""  OBD_COMPLIANT_ECUS
 SG_ PID_A2_Supported m160 : 54|1@0+ (1,0) [0|0] ""  OBD_COMPLIANT_ECUS
 SG_ PID_C2_Supported m192 : 54|1@0+ (1,0) [0|0] ""  OBD_COMPLIANT_ECUS
 SG_ EGR_A_Error m105 : 55|8@0+ (0.389093137254902,0) [0|99.21875] ""  OBD_COMPLIANT_ECUS
 SG_ IAT_B1S3 m104 : 55|8@0+ (1,-40) [-40|215] "°C"  OBD_COMPLIANT_ECUS
 SG_ MAFSensorB m102 : 55|16@0+ (0.03125,0) [0|2047.96875] "g/s"  OBD_COMPLIANT_ECUS
 SG_ MaximumValueForIntakeManifoldAbs m79 : 55|8@0+ (10,0) [0|2550] "kPa"  OBD_COMPLIANT_ECUS
 SG_ PID_01_Supported m0 : 55|1@0+ (1,0) [0|0] ""  OBD_COMPLIANT_ECUS
 SG_ PID_21_Supported m32 : 55|1@0+ (1,0) [0|0] ""  OBD_COMPLIANT_ECUS
 SG_ PID_41_Supported m64 : 55|1@0+ (1,0) [0|0] ""  OBD_COMPLIANT_ECUS
 SG_ EGR_VVTMonitorStatus m65 : 55|1@0+ (1,0) [0|1] ""  OBD_COMPLIANT_ECUS
 SG_ PID_61_Supported m96 : 55|1@0+ (1,0) [0|0] ""  OBD_COMPLIANT_ECUS
 SG_ EngineTorquePoint3 m100 : 55|8@0+ (1,-125) [-125|130] "%"  OBD_COMPLIANT_ECUS
 SG_ PID_81_Supported m128 : 55|1@0+ (1,0) [0|0] ""  OBD_COMPLIANT_ECUS
 SG_ NOxConcentrationB1S2 m131 : 55|16@0+ (1,0) [0|65535] "ppm"  OBD_COMPLIANT_ECUS
 SG_ NOxAvgDemReagentConsumption m133 : 55|16@0+ (0.005,0) [0|327.675] "L/h"  OBD_COMPLIANT_ECUS
 SG_ PMConcentration_B2S1 m134 : 55|16@0+ (0.0125,0) [0|819.1875] "mg"  OBD_COMPLIANT_ECUS
 SG_ IntakeManifoldAbsolutePressureB m135 : 55|16@0- (0.03125,0) [-1024|1023.96875] "kPa"  OBD_COMPLIANT_ECUS
 SG_ PID_A1_Supported m160 : 55|1@0+ (1,0) [0|0] ""  OBD_COMPLIANT_ECUS
 SG_ PID_C1_Supported m192 : 55|1@0+ (1,0) [0|0] ""  OBD_COMPLIANT_ECUS
 SG_ PID_10_Supported m0 : 40|1@0+ (1,0) [0|0] ""  OBD_COMPLIANT_ECUS
 SG_ PID_30_Supported m32 : 40|1@0+ (1,0) [0|0] ""  OBD_COMPLIANT_ECUS
 SG_ PID_50_Supported m64 : 40|1@0+ (1,0) [0|0] ""  OBD_COMPLIANT_ECUS
 SG_ Cat_NMHCCatMonitorEnabled m65 : 40|1@0+ (1,0) [0|1] ""  OBD_COMPLIANT_ECUS
 SG_ PID_70_Supported m96 : 40|1@0+ (1,0) [0|0] ""  OBD_COMPLIANT_ECUS
 SG_ PID_90_Supported m128 : 40|1@0+ (1,0) [0|0] ""  OBD_COMPLIANT_ECUS
 SG_ PID_B0_Supported m160 : 40|1@0+ (1,0) [0|0] ""  OBD_COMPLIANT_ECUS
 SG_ PID_D0_Supported m192 : 40|1@0+ (1,0) [0|0] ""  OBD_COMPLIANT_ECUS
 SG_ PID_0F_Supported m0 : 41|1@0+ (1,0) [0|0] ""  OBD_COMPLIANT_ECUS
 SG_ PID_2F_Supported m32 : 41|1@0+ (1,0) [0|0] ""  OBD_COMPLIANT_ECUS
 SG_ PID_4F_Supported m64 : 41|1@0+ (1,0) [0|0] ""  OBD_COMPLIANT_ECUS
 SG_ HeatedCat_NOxSCRMonitorEnabled m65 : 41|1@0+ (1,0) [0|1] ""  OBD_COMPLIANT_ECUS
 SG_ PID_6F_Supported m96 : 41|1@0+ (1,0) [0|0] ""  OBD_COMPLIANT_ECUS
 SG_ PID_8F_Supported m128 : 41|1@0+ (1,0) [0|0] ""  OBD_COMPLIANT_ECUS
 SG_ PID_AF_Supported m160 : 41|1@0+ (1,0) [0|0] ""  OBD_COMPLIANT_ECUS
 SG_ PID_CF_Supported m192 : 41|1@0+ (1,0) [0|0] ""  OBD_COMPLIANT_ECUS
 SG_ PID_0E_Supported m0 : 42|1@0+ (1,0) [0|0] ""  OBD_COMPLIANT_ECUS
 SG_ PID_2E_Supported m32 : 42|1@0+ (1,0) [0|0] ""  OBD_COMPLIANT_ECUS
 SG_ PID_4E_Supported m64 : 42|1@0+ (1,0) [0|0] ""  OBD_COMPLIANT_ECUS
 SG_ EvapMonitorEnabled m65 : 42|1@0+ (1,0) [0|1] ""  OBD_COMPLIANT_ECUS
 SG_ PID_6E_Supported m96 : 42|1@0+ (1,0) [0|0] ""  OBD_COMPLIANT_ECUS
 SG_ PID_8E_Supported m128 : 42|1@0+ (1,0) [0|0] ""  OBD_COMPLIANT_ECUS
 SG_ PID_AE_Supported m160 : 42|1@0+ (1,0) [0|0] ""  OBD_COMPLIANT_ECUS
 SG_ PID_CE_Supported m192 : 42|1@0+ (1,0) [0|0] ""  OBD_COMPLIANT_ECUS
 SG_ PID_0D_Supported m0 : 43|1@0+ (1,0) [0|0] ""  OBD_COMPLIANT_ECUS
 SG_ PID_2D_Supported m32 : 43|1@0+ (1,0) [0|0] ""  OBD_COMPLIANT_ECUS
 SG_ PID_4D_Supported m64 : 43|1@0+ (1,0) [0|0] ""  OBD_COMPLIANT_ECUS
 SG_ SecondaryAir_BoostPressureM_0000 m65 : 43|1@0+ (1,0) [0|1] ""  OBD_COMPLIANT_ECUS
 SG_ PID_6D_Supported m96 : 43|1@0+ (1,0) [0|0] ""  OBD_COMPLIANT_ECUS
 SG_ PID_8D_Supported m128 : 43|1@0+ (1,0) [0|0] ""  OBD_COMPLIANT_ECUS
 SG_ PID_AD_Supported m160 : 43|1@0+ (1,0) [0|0] ""  OBD_COMPLIANT_ECUS
 SG_ PID_CD_Supported m192 : 43|1@0+ (1,0) [0|0] ""  OBD_COMPLIANT_ECUS
 SG_ PID_0C_Supported m0 : 44|1@0+ (1,0) [0|0] ""  OBD_COMPLIANT_ECUS
 SG_ PID_2C_Supported m32 : 44|1@0+ (1,0) [0|0] ""  OBD_COMPLIANT_ECUS
 SG_ PID_4C_Supported m64 : 44|1@0+ (1,0) [0|0] ""  OBD_COMPLIANT_ECUS
 SG_ PID_6C_Supported m96 : 44|1@0+ (1,0) [0|0] ""  OBD_COMPLIANT_ECUS
 SG_ PID_8C_Supported m128 : 44|1@0+ (1,0) [0|0] ""  OBD_COMPLIANT_ECUS
 SG_ PID_AC_Supported m160 : 44|1@0+ (1,0) [0|0] ""  OBD_COMPLIANT_ECUS
 SG_ PID_CC_Supported m192 : 44|1@0+ (1,0) [0|0] ""  OBD_COMPLIANT_ECUS
 SG_ PID_0B_Supported m0 : 45|1@0+ (1,0) [0|0] ""  OBD_COMPLIANT_ECUS
 SG_ PID_2B_Supported m32 : 45|1@0+ (1,0) [0|0] ""  OBD_COMPLIANT_ECUS
 SG_ PID_4B_Supported m64 : 45|1@0+ (1,0) [0|0] ""  OBD_COMPLIANT_ECUS
 SG_ O2_ExhaustGasMonitorEnabled m65 : 45|1@0+ (1,0) [0|1] ""  OBD_COMPLIANT_ECUS
 SG_ PID_6B_Supported m96 : 45|1@0+ (1,0) [0|0] ""  OBD_COMPLIANT_ECUS
 SG_ PID_8B_Supported m128 : 45|1@0+ (1,0) [0|0] ""  OBD_COMPLIANT_ECUS
 SG_ PID_AB_Supported m160 : 45|1@0+ (1,0) [0|0] ""  OBD_COMPLIANT_ECUS
 SG_ PID_CB_Supported m192 : 45|1@0+ (1,0) [0|0] ""  OBD_COMPLIANT_ECUS
 SG_ PID_0A_Supported m0 : 46|1@0+ (1,0) [0|0] ""  OBD_COMPLIANT_ECUS
 SG_ PID_2A_Supported m32 : 46|1@0+ (1,0) [0|0] ""  OBD_COMPLIANT_ECUS
 SG_ PID_4A_Supported m64 : 46|1@0+ (1,0) [0|0] ""  OBD_COMPLIANT_ECUS
 SG_ O2Heater_PMFilterMonitorEnabled m65 : 46|1@0+ (1,0) [0|1] ""  OBD_COMPLIANT_ECUS
 SG_ PID_6A_Supported m96 : 46|1@0+ (1,0) [0|0] ""  OBD_COMPLIANT_ECUS
 SG_ PID_8A_Supported m128 : 46|1@0+ (1,0) [0|0] ""  OBD_COMPLIANT_ECUS
 SG_ PID_AA_Supported m160 : 46|1@0+ (1,0) [0|0] ""  OBD_COMPLIANT_ECUS
 SG_ PID_CA_Supported m192 : 46|1@0+ (1,0) [0|0] ""  OBD_COMPLIANT_ECUS
 SG_ EGR_A_DutyCyclePosition m105 : 47|8@0+ (0.392156862745098,0) [0|100] ""  OBD_COMPLIANT_ECUS
 SG_ IAT_B1S2 m104 : 47|8@0+ (1,-40) [-40|215] "°C"  OBD_COMPLIANT_ECUS
 SG_ ECTSensorB m103 : 47|8@0+ (1,-40) [-40|215] "°C"  OBD_COMPLIANT_ECUS
 SG_ MaximumValueForOxygenSensorCurre m79 : 47|8@0+ (1,0) [0|255] "mA"  OBD_COMPLIANT_ECUS
 SG_ PID_09_Supported m0 : 47|1@0+ (1,0) [0|0] ""  OBD_COMPLIANT_ECUS
 SG_ PID_29_Supported m32 : 47|1@0+ (1,0) [0|0] ""  OBD_COMPLIANT_ECUS
 SG_ O2_B1S1_WB_Volt m36 : 47|16@0+ (0.0001220703125,0) [0|2] "volts"  OBD_COMPLIANT_ECUS
 SG_ O2_B1S2_WB_Volt m37 : 47|16@0+ (0.0001220703125,0) [0|8] "volts"  OBD_COMPLIANT_ECUS
 SG_ O2_B1S3_WB_Volt m38 : 47|16@0+ (0.0001220703125,0) [0|8] "volts"  OBD_COMPLIANT_ECUS
 SG_ O2_B1S4_WB_Volt m39 : 47|16@0+ (0.0001220703125,0) [0|8] "volts"  OBD_COMPLIANT_ECUS
 SG_ O2_B2S1_WB_Volt m40 : 47|16@0+ (0.0001220703125,0) [0|8] "volts"  OBD_COMPLIANT_ECUS
 SG_ O2_B2S2_WB_Volt m41 : 47|16@0+ (0.0001220703125,0) [0|8] "volts"  OBD_COMPLIANT_ECUS
 SG_ O2_B2S3_WB_Volt m42 : 47|16@0+ (0.0001220703125,0) [0|8] "volts"  OBD_COMPLIANT_ECUS
 SG_ O2_B2S4_WB_Volt m43 : 47|16@0+ (0.0001220703125,0) [0|8] "volts"  OBD_COMPLIANT_ECUS
 SG_ O2_B1S1_WB_Current m52 : 47|16@0+ (0.00390625,-128) [-128|128] "mA"  OBD_COMPLIANT_ECUS
 SG_ O2_B1S2_WB_Current m53 : 47|16@0+ (0.00390625,-128) [-128|128] "mA"  OBD_COMPLIANT_ECUS
 SG_ O2_B1S3_WB_Current m54 : 47|16@0+ (0.00390625,-128) [-128|128] "mA"  OBD_COMPLIANT_ECUS
 SG_ O2_B1S4_WB_Current m55 : 47|16@0+ (0.00390625,-128) [-128|128] "mA"  OBD_COMPLIANT_ECUS
 SG_ O2_B2S1_WB_Current m56 : 47|16@0+ (0.00390625,-128) [-128|128] "mA"  OBD_COMPLIANT_ECUS
 SG_ O2_B2S2_WB_Current m57 : 47|16@0+ (0.00390625,-128) [-128|128] "mA"  OBD_COMPLIANT_ECUS
 SG_ O2_B2S3_WB_Current m58 : 47|16@0+ (0.00390625,-128) [-128|128] "mA"  OBD_COMPLIANT_ECUS
 SG_ O2_B2S4_WB_Current m59 : 47|16@0+ (0.00390625,-128) [-128|128] "mA"  OBD_COMPLIANT_ECUS
 SG_ PID_49_Supported m64 : 47|1@0+ (1,0) [0|0] ""  OBD_COMPLIANT_ECUS
 SG_ EGR_VVTSystemMonitorEnabled m65 : 47|1@0+ (1,0) [0|1] ""  OBD_COMPLIANT_ECUS
 SG_ PID_69_Supported m96 : 47|1@0+ (1,0) [0|0] ""  OBD_COMPLIANT_ECUS
 SG_ EngineTorquePoint2 m100 : 47|8@0+ (1,-125) [-125|130] "%"  OBD_COMPLIANT_ECUS
 SG_ PID_89_Supported m128 : 47|1@0+ (1,0) [0|0] ""  OBD_COMPLIANT_ECUS
 SG_ PID_A9_Supported m160 : 47|1@0+ (1,0) [0|0] ""  OBD_COMPLIANT_ECUS
 SG_ PID_C9_Supported m192 : 47|1@0+ (1,0) [0|0] ""  OBD_COMPLIANT_ECUS
 SG_ PTOStatus2 m101 : 32|1@0+ (1,0) [0|1] ""  OBD_COMPLIANT_ECUS
 SG_ PID_18_Supported m0 : 32|1@0+ (1,0) [0|0] ""  OBD_COMPLIANT_ECUS
 SG_ PID_38_Supported m32 : 32|1@0+ (1,0) [0|0] ""  OBD_COMPLIANT_ECUS
 SG_ PID_58_Supported m64 : 32|1@0+ (1,0) [0|0] ""  OBD_COMPLIANT_ECUS
 SG_ MisfireMonitorEnabled m65 : 32|1@0+ (1,0) [0|1] ""  OBD_COMPLIANT_ECUS
 SG_ PID_78_Supported m96 : 32|1@0+ (1,0) [0|0] ""  OBD_COMPLIANT_ECUS
 SG_ PID_98_Supported m128 : 32|1@0+ (1,0) [0|0] ""  OBD_COMPLIANT_ECUS
 SG_ PID_B8_Supported m160 : 32|1@0+ (1,0) [0|0] ""  OBD_COMPLIANT_ECUS
 SG_ PID_D8_Supported m192 : 32|1@0+ (1,0) [0|0] ""  OBD_COMPLIANT_ECUS
 SG_ AutomaticTransmissionGearStatus m101 : 33|1@0+ (1,0) [0|1] ""  OBD_COMPLIANT_ECUS
 SG_ PID_17_Supported m0 : 33|1@0+ (1,0) [0|0] ""  OBD_COMPLIANT_ECUS
 SG_ PID_37_Supported m32 : 33|1@0+ (1,0) [0|0] ""  OBD_COMPLIANT_ECUS
 SG_ PID_57_Supported m64 : 33|1@0+ (1,0) [0|0] ""  OBD_COMPLIANT_ECUS
 SG_ FuelSystemMonitorEnabled m65 : 33|1@0+ (1,0) [0|1] ""  OBD_COMPLIANT_ECUS
 SG_ PID_77_Supported m96 : 33|1@0+ (1,0) [0|0] ""  OBD_COMPLIANT_ECUS
 SG_ PID_97_Supported m128 : 33|1@0+ (1,0) [0|0] ""  OBD_COMPLIANT_ECUS
 SG_ PID_B7_Supported m160 : 33|1@0+ (1,0) [0|0] ""  OBD_COMPLIANT_ECUS
 SG_ PID_D7_Supported m192 : 33|1@0+ (1,0) [0|0] ""  OBD_COMPLIANT_ECUS
 SG_ ManualTransmissionGearStatus m101 : 34|1@0+ (1,0) [0|1] ""  OBD_COMPLIANT_ECUS
 SG_ PID_16_Supported m0 : 34|1@0+ (1,0) [0|0] ""  OBD_COMPLIANT_ECUS
 SG_ PID_36_Supported m32 : 34|1@0+ (1,0) [0|0] ""  OBD_COMPLIANT_ECUS
 SG_ PID_56_Supported m64 : 34|1@0+ (1,0) [0|0] ""  OBD_COMPLIANT_ECUS
 SG_ CompComponentMonitorEnabled m65 : 34|1@0+ (1,0) [0|1] ""  OBD_COMPLIANT_ECUS
 SG_ PID_76_Supported m96 : 34|1@0+ (1,0) [0|0] ""  OBD_COMPLIANT_ECUS
 SG_ PID_96_Supported m128 : 34|1@0+ (1,0) [0|0] ""  OBD_COMPLIANT_ECUS
 SG_ PID_B6_Supported m160 : 34|1@0+ (1,0) [0|0] ""  OBD_COMPLIANT_ECUS
 SG_ PID_D6_Supported m192 : 34|1@0+ (1,0) [0|0] ""  OBD_COMPLIANT_ECUS
 SG_ GlowPlugLampStatus m101 : 35|1@0+ (1,0) [0|1] ""  OBD_COMPLIANT_ECUS
 SG_ PID_15_Supported m0 : 35|1@0+ (1,0) [0|0] ""  OBD_COMPLIANT_ECUS
 SG_ PID_35_Supported m32 : 35|1@0+ (1,0) [0|0] ""  OBD_COMPLIANT_ECUS
 SG_ PID_55_Supported m64 : 35|1@0+ (1,0) [0|0] ""  OBD_COMPLIANT_ECUS
 SG_ IgnitionMonitorType m65 : 35|1@0+ (1,0) [0|1] ""  OBD_COMPLIANT_ECUS
 SG_ PID_75_Supported m96 : 35|1@0+ (1,0) [0|0] ""  OBD_COMPLIANT_ECUS
 SG_ PID_95_Supported m128 : 35|1@0+ (1,0) [0|0] ""  OBD_COMPLIANT_ECUS
 SG_ PID_B5_Supported m160 : 35|1@0+ (1,0) [0|0] ""  OBD_COMPLIANT_ECUS
 SG_ PID_D5_Supported m192 : 35|1@0+ (1,0) [0|0] ""  OBD_COMPLIANT_ECUS
 SG_ PID_14_Supported m0 : 36|1@0+ (1,0) [0|0] ""  OBD_COMPLIANT_ECUS
 SG_ PID_34_Supported m32 : 36|1@0+ (1,0) [0|0] ""  OBD_COMPLIANT_ECUS
 SG_ PID_54_Supported m64 : 36|1@0+ (1,0) [0|0] ""  OBD_COMPLIANT_ECUS
 SG_ MisfireMonitorStatus m65 : 36|1@0+ (1,0) [0|1] ""  OBD_COMPLIANT_ECUS
 SG_ PID_74_Supported m96 : 36|1@0+ (1,0) [0|0] ""  OBD_COMPLIANT_ECUS
 SG_ PID_94_Supported m128 : 36|1@0+ (1,0) [0|0] ""  OBD_COMPLIANT_ECUS
 SG_ PID_B4_Supported m160 : 36|1@0+ (1,0) [0|0] ""  OBD_COMPLIANT_ECUS
 SG_ PID_D4_Supported m192 : 36|1@0+ (1,0) [0|0] ""  OBD_COMPLIANT_ECUS
 SG_ PID_13_Supported m0 : 37|1@0+ (1,0) [0|0] ""  OBD_COMPLIANT_ECUS
 SG_ PID_33_Supported m32 : 37|1@0+ (1,0) [0|0] ""  OBD_COMPLIANT_ECUS
 SG_ PID_53_Supported m64 : 37|1@0+ (1,0) [0|0] ""  OBD_COMPLIANT_ECUS
 SG_ FuelSystemMonitorStatus m65 : 37|1@0+ (1,0) [0|1] ""  OBD_COMPLIANT_ECUS
 SG_ PID_73_Supported m96 : 37|1@0+ (1,0) [0|0] ""  OBD_COMPLIANT_ECUS
 SG_ PID_93_Supported m128 : 37|1@0+ (1,0) [0|0] ""  OBD_COMPLIANT_ECUS
 SG_ PID_B3_Supported m160 : 37|1@0+ (1,0) [0|0] ""  OBD_COMPLIANT_ECUS
 SG_ PID_D3_Supported m192 : 37|1@0+ (1,0) [0|0] ""  OBD_COMPLIANT_ECUS
 SG_ PID_12_Supported m0 : 38|1@0+ (1,0) [0|0] ""  OBD_COMPLIANT_ECUS
 SG_ PID_32_Supported m32 : 38|1@0+ (1,0) [0|0] ""  OBD_COMPLIANT_ECUS
 SG_ PID_52_Supported m64 : 38|1@0+ (1,0) [0|0] ""  OBD_COMPLIANT_ECUS
 SG_ CompComponentMonitorStatus m65 : 38|1@0+ (1,0) [0|1] ""  OBD_COMPLIANT_ECUS
 SG_ PID_72_Supported m96 : 38|1@0+ (1,0) [0|0] ""  OBD_COMPLIANT_ECUS
 SG_ PID_92_Supported m128 : 38|1@0+ (1,0) [0|0] ""  OBD_COMPLIANT_ECUS
 SG_ PID_B2_Supported m160 : 38|1@0+ (1,0) [0|0] ""  OBD_COMPLIANT_ECUS
 SG_ PID_D2_Supported m192 : 38|1@0+ (1,0) [0|0] ""  OBD_COMPLIANT_ECUS
 SG_ EGR_A_CommandedDutyCyclePosition m105 : 39|8@0+ (0.392156862745098,0) [0|100] ""  OBD_COMPLIANT_ECUS
 SG_ IAT_B1S1 m104 : 39|8@0+ (1,-40) [-40|215] "°C"  OBD_COMPLIANT_ECUS
 SG_ ECTSensorA m103 : 39|8@0+ (1,-40) [-40|215] "°C"  OBD_COMPLIANT_ECUS
 SG_ MAFSensorA m102 : 39|16@0+ (0.03125,0) [0|2047.96875] "g/s"  OBD_COMPLIANT_ECUS
 SG_ MaximumValueForOxygenSensorVolta m79 : 39|8@0+ (1,0) [0|255] "V"  OBD_COMPLIANT_ECUS
 SG_ PID_11_Supported m0 : 39|1@0+ (1,0) [0|0] ""  OBD_COMPLIANT_ECUS
 SG_ FuelSystem2Status m3 : 39|8@0+ (1,0) [0|255] ""  OBD_COMPLIANT_ECUS
 SG_ ShortTermFuelTrim_B3 m6 : 39|8@0+ (0.78125,-100) [-100|99.21875] "%"  OBD_COMPLIANT_ECUS
 SG_ LongTermFuelTrim_B3 m7 : 39|8@0+ (0.78125,-100) [-100|99.21875] "%"  OBD_COMPLIANT_ECUS
 SG_ ShortTermFuelTrim_B4 m8 : 39|8@0+ (0.78125,-100) [-100|99.21875] "%"  OBD_COMPLIANT_ECUS
 SG_ LongTermFuelTrim_B4 m9 : 39|8@0+ (0.78125,-100) [-100|99.21875] "%"  OBD_COMPLIANT_ECUS
 SG_ O2_B1S1_ShortTermFuelTrim m20 : 39|8@0+ (0.78125,-100) [-100|99.21875] "%"  OBD_COMPLIANT_ECUS
 SG_ O2_B1S2_ShortTermFuelTrim m21 : 39|8@0+ (0.78125,-100) [-100|99.21875] "%"  OBD_COMPLIANT_ECUS
 SG_ O2_B1S3_ShortTermFuelTrim m22 : 39|8@0+ (0.78125,-100) [-100|99.21875] "%"  OBD_COMPLIANT_ECUS
 SG_ O2_B1S4_ShortTermFuelTrim m23 : 39|8@0+ (0.78125,-100) [-100|99.21875] "%"  OBD_COMPLIANT_ECUS
 SG_ O2_B2S1_ShortTermFuelTrim m24 : 39|8@0+ (0.78125,-100) [-100|99.21875] "%"  OBD_COMPLIANT_ECUS
 SG_ O2_B2S2_ShortTermFuelTrim m25 : 39|8@0+ (0.78125,-100) [-100|99.21875] "%"  OBD_COMPLIANT_ECUS
 SG_ O2_B2S3_ShortTermFuelTrim m26 : 39|8@0+ (0.78125,-100) [-100|99.21875] "%"  OBD_COMPLIANT_ECUS
 SG_ O2_B2S4_ShortTermFuelTrim m27 : 39|8@0+ (0.78125,-100) [-100|99.21875] "%"  OBD_COMPLIANT_ECUS
 SG_ PID_31_Supported m32 : 39|1@0+ (1,0) [0|0] ""  OBD_COMPLIANT_ECUS
 SG_ PID_51_Supported m64 : 39|1@0+ (1,0) [0|0] ""  OBD_COMPLIANT_ECUS
 SG_ O2Secondary_B3_ShortTermFuelTrim m85 : 39|8@0+ (0.78125,-100) [-100|99.21875] "%"  OBD_COMPLIANT_ECUS
 SG_ O2Secondary_B3_LongTermFuelTrim m86 : 39|8@0+ (0.78125,-100) [-100|99.21875] "%"  OBD_COMPLIANT_ECUS
 SG_ O2Secondary_B4_ShortTermFuelTrim m87 : 39|8@0+ (0.78125,-100) [-100|99.21875] "%"  OBD_COMPLIANT_ECUS
 SG_ O2Secondary_B4_LongTermFuelTrim m88 : 39|8@0+ (0.78125,-100) [-100|99.21875] "%"  OBD_COMPLIANT_ECUS
 SG_ PID_71_Supported m96 : 39|1@0+ (1,0) [0|0] ""  OBD_COMPLIANT_ECUS
 SG_ EngineTorquePoint1 m100 : 39|8@0+ (1,-125) [-125|130] "%"  OBD_COMPLIANT_ECUS
 SG_ PID_91_Supported m128 : 39|1@0+ (1,0) [0|0] ""  OBD_COMPLIANT_ECUS
 SG_ NOxConcentrationB1S1 m131 : 39|16@0+ (1,0) [0|65535] "ppm"  OBD_COMPLIANT_ECUS
 SG_ NOxAvgReagentConsumption m133 : 39|16@0+ (0.005,0) [0|327.675] "L/h"  OBD_COMPLIANT_ECUS
 SG_ PMConcentration_B1S1 m134 : 39|16@0+ (0.0125,0) [0|819.1875] "mg"  OBD_COMPLIANT_ECUS
 SG_ IntakeManifoldAbsolutePressureA m135 : 39|16@0- (0.03125,0) [-1024|1023.96875] "kPa"  OBD_COMPLIANT_ECUS
 SG_ PID_B1_Supported m160 : 39|1@0+ (1,0) [0|0] ""  OBD_COMPLIANT_ECUS
 SG_ PID_D1_Supported m192 : 39|1@0+ (1,0) [0|0] ""  OBD_COMPLIANT_ECUS
 SG_ IAT_B1S1_Support m104 : 24|1@0+ (1,0) [0|1] ""  OBD_COMPLIANT_ECUS
 SG_ ECTSensorASupport m103 : 24|1@0+ (1,0) [0|1] ""  OBD_COMPLIANT_ECUS
 SG_ MAFSensorASupport m102 : 24|1@0+ (1,0) [0|1] ""  OBD_COMPLIANT_ECUS
 SG_ PTOStatus2Support m101 : 24|1@0+ (1,0) [0|1] ""  OBD_COMPLIANT_ECUS
 SG_ PID_20_Supported m0 : 24|1@0+ (1,0) [0|0] ""  OBD_COMPLIANT_ECUS
 SG_ O2_B1S1_Supported m19 : 24|1@0+ (1,0) [0|1] ""  OBD_COMPLIANT_ECUS
 SG_ PTOStatus m30 : 24|1@0+ (1,0) [0|1] ""  OBD_COMPLIANT_ECUS
 SG_ PID_40_Supported m32 : 24|1@0+ (1,0) [0|0] ""  OBD_COMPLIANT_ECUS
 SG_ PID_60_Supported m64 : 24|1@0+ (1,0) [0|0] ""  OBD_COMPLIANT_ECUS
 SG_ PID_80_Supported m96 : 24|1@0+ (1,0) [0|0] ""  OBD_COMPLIANT_ECUS
 SG_ PID_A0_Supported m128 : 24|1@0+ (1,0) [0|0] ""  OBD_COMPLIANT_ECUS
 SG_ NOxConcentrationB1S1Supported m131 : 24|1@0+ (1,0) [0|0] ""  OBD_COMPLIANT_ECUS
 SG_ NOxReagentSupported m133 : 24|1@0+ (1,0) [0|0] ""  OBD_COMPLIANT_ECUS
 SG_ PMConcentration_B1S1_Supported m134 : 24|1@0+ (1,0) [0|1] ""  OBD_COMPLIANT_ECUS
 SG_ PID_C0_Supported m160 : 24|1@0+ (1,0) [0|0] ""  OBD_COMPLIANT_ECUS
 SG_ PID_E0_Supported m192 : 24|1@0+ (1,0) [0|0] ""  OBD_COMPLIANT_ECUS
 SG_ EGR_A_DutyCyclePositionSupport m105 : 25|1@0+ (1,0) [0|1] ""  OBD_COMPLIANT_ECUS
 SG_ IAT_B1S2_Support m104 : 25|1@0+ (1,0) [0|1] ""  OBD_COMPLIANT_ECUS
 SG_ ECTSensorBSupport m103 : 25|1@0+ (1,0) [0|1] ""  OBD_COMPLIANT_ECUS
 SG_ MAFSensorBSupport m102 : 25|1@0+ (1,0) [0|1] ""  OBD_COMPLIANT_ECUS
 SG_ AutomaticTransmissionGearStatusS m101 : 25|1@0+ (1,0) [0|1] ""  OBD_COMPLIANT_ECUS
 SG_ PID_1F_Supported m0 : 25|1@0+ (1,0) [0|0] ""  OBD_COMPLIANT_ECUS
 SG_ O2_B1S2_Supported m19 : 25|1@0+ (1,0) [0|1] ""  OBD_COMPLIANT_ECUS
 SG_ PID_3F_Supported m32 : 25|1@0+ (1,0) [0|0] ""  OBD_COMPLIANT_ECUS
 SG_ PID_5F_Supported m64 : 25|1@0+ (1,0) [0|0] ""  OBD_COMPLIANT_ECUS
 SG_ PID_7F_Supported m96 : 25|1@0+ (1,0) [0|0] ""  OBD_COMPLIANT_ECUS
 SG_ PID_9F_Supported m128 : 25|1@0+ (1,0) [0|0] ""  OBD_COMPLIANT_ECUS
 SG_ NOxConcentrationB1S2Supported m131 : 25|1@0+ (1,0) [0|0] ""  OBD_COMPLIANT_ECUS
 SG_ NOxReagentDemandedSupported m133 : 25|1@0+ (1,0) [0|0] ""  OBD_COMPLIANT_ECUS
 SG_ PMConcentration_B2S1_Supported m134 : 25|1@0+ (1,0) [0|1] ""  OBD_COMPLIANT_ECUS
 SG_ IntakeManifoldAbsolutePressureSu m135 : 25|1@0+ (1,0) [0|1] ""  OBD_COMPLIANT_ECUS
 SG_ PID_BF_Supported m160 : 25|1@0+ (1,0) [0|0] ""  OBD_COMPLIANT_ECUS
 SG_ PID_DF_Supported m192 : 25|1@0+ (1,0) [0|0] ""  OBD_COMPLIANT_ECUS
 SG_ EGR_A_ErrorSupport m105 : 26|1@0+ (1,0) [0|1] ""  OBD_COMPLIANT_ECUS
 SG_ IAT_B1S3_Support m104 : 26|1@0+ (1,0) [0|1] ""  OBD_COMPLIANT_ECUS
 SG_ ManualTransmissionGearStatusSupp m101 : 26|1@0+ (1,0) [0|1] ""  OBD_COMPLIANT_ECUS
 SG_ PID_1E_Supported m0 : 26|1@0+ (1,0) [0|0] ""  OBD_COMPLIANT_ECUS
 SG_ O2_B1S3_Supported m19 : 26|1@0+ (1,0) [0|1] ""  OBD_COMPLIANT_ECUS
 SG_ PID_3E_Supported m32 : 26|1@0+ (1,0) [0|0] ""  OBD_COMPLIANT_ECUS
 SG_ PID_5E_Supported m64 : 26|1@0+ (1,0) [0|0] ""  OBD_COMPLIANT_ECUS
 SG_ PID_7E_Supported m96 : 26|1@0+ (1,0) [0|0] ""  OBD_COMPLIANT_ECUS
 SG_ PID_9E_Supported m128 : 26|1@0+ (1,0) [0|0] ""  OBD_COMPLIANT_ECUS
 SG_ NOxConcentrationB2S1Supported m131 : 26|1@0+ (1,0) [0|0] ""  OBD_COMPLIANT_ECUS
 SG_ NOxReagentLevelSupported m133 : 26|1@0+ (1,0) [0|0] ""  OBD_COMPLIANT_ECUS
 SG_ PID_BE_Supported m160 : 26|1@0+ (1,0) [0|0] ""  OBD_COMPLIANT_ECUS
 SG_ PID_DE_Supported m192 : 26|1@0+ (1,0) [0|0] ""  OBD_COMPLIANT_ECUS
 SG_ IAT_B2S1_Support m104 : 27|1@0+ (1,0) [0|1] ""  OBD_COMPLIANT_ECUS
 SG_ GlowPlugLampStatusSupport m101 : 27|1@0+ (1,0) [0|1] ""  OBD_COMPLIANT_ECUS
 SG_ PID_1D_Supported m0 : 27|1@0+ (1,0) [0|0] ""  OBD_COMPLIANT_ECUS
 SG_ O2_B1S4_Supported m19 : 27|1@0+ (1,0) [0|1] ""  OBD_COMPLIANT_ECUS
 SG_ PID_3D_Supported m32 : 27|1@0+ (1,0) [0|0] ""  OBD_COMPLIANT_ECUS
 SG_ PID_5D_Supported m64 : 27|1@0+ (1,0) [0|0] ""  OBD_COMPLIANT_ECUS
 SG_ PID_7D_Supported m96 : 27|1@0+ (1,0) [0|0] ""  OBD_COMPLIANT_ECUS
 SG_ PID_9D_Supported m128 : 27|1@0+ (1,0) [0|0] ""  OBD_COMPLIANT_ECUS
 SG_ NOxConcentrationB2S2Supported m131 : 27|1@0+ (1,0) [0|0] ""  OBD_COMPLIANT_ECUS
 SG_ NOxRuntimeWarningSupported m133 : 27|1@0+ (1,0) [0|0] ""  OBD_COMPLIANT_ECUS
 SG_ PID_BD_Supported m160 : 27|1@0+ (1,0) [0|0] ""  OBD_COMPLIANT_ECUS
 SG_ PID_DD_Supported m192 : 27|1@0+ (1,0) [0|0] ""  OBD_COMPLIANT_ECUS
 SG_ EGR_B_DutyCyclePositionSupport m105 : 28|1@0+ (1,0) [0|1] ""  OBD_COMPLIANT_ECUS
 SG_ IAT_B2S2_Support m104 : 28|1@0+ (1,0) [0|1] ""  OBD_COMPLIANT_ECUS
 SG_ PID_1C_Supported m0 : 28|1@0+ (1,0) [0|0] ""  OBD_COMPLIANT_ECUS
 SG_ O2_B2S1_Supported m19 : 28|1@0+ (1,0) [0|1] ""  OBD_COMPLIANT_ECUS
 SG_ PID_3C_Supported m32 : 28|1@0+ (1,0) [0|0] ""  OBD_COMPLIANT_ECUS
 SG_ PID_5C_Supported m64 : 28|1@0+ (1,0) [0|0] ""  OBD_COMPLIANT_ECUS
 SG_ PID_7C_Supported m96 : 28|1@0+ (1,0) [0|0] ""  OBD_COMPLIANT_ECUS
 SG_ PID_9C_Supported m128 : 28|1@0+ (1,0) [0|0] ""  OBD_COMPLIANT_ECUS
 SG_ PID_BC_Supported m160 : 28|1@0+ (1,0) [0|0] ""  OBD_COMPLIANT_ECUS
 SG_ PID_DC_Supported m192 : 28|1@0+ (1,0) [0|0] ""  OBD_COMPLIANT_ECUS
 SG_ EGR_B_ErrorSupport m105 : 29|1@0+ (1,0) [0|1] ""  OBD_COMPLIANT_ECUS
 SG_ IAT_B2S3_Support m104 : 29|1@0+ (1,0) [0|1] ""  OBD_COMPLIANT_ECUS
 SG_ PID_1B_Supported m0 : 29|1@0+ (1,0) [0|0] ""  OBD_COMPLIANT_ECUS
 SG_ O2_B2S2_Supported m19 : 29|1@0+ (1,0) [0|1] ""  OBD_COMPLIANT_ECUS
 SG_ PID_3B_Supported m32 : 29|1@0+ (1,0) [0|0] ""  OBD_COMPLIANT_ECUS
 SG_ PID_5B_Supported m64 : 29|1@0+ (1,0) [0|0] ""  OBD_COMPLIANT_ECUS
 SG_ PID_7B_Supported m96 : 29|1@0+ (1,0) [0|0] ""  OBD_COMPLIANT_ECUS
 SG_ PID_9B_Supported m128 : 29|1@0+ (1,0) [0|0] ""  OBD_COMPLIANT_ECUS
 SG_ PID_BB_Supported m160 : 29|1@0+ (1,0) [0|0] ""  OBD_COMPLIANT_ECUS
 SG_ PID_DB_Supported m192 : 29|1@0+ (1,0) [0|0] ""  OBD_COMPLIANT_ECUS
 SG_ PID_1A_Supported m0 : 30|1@0+ (1,0) [0|0] ""  OBD_COMPLIANT_ECUS
 SG_ O2_B2S3_Supported m19 : 30|1@0+ (1,0) [0|1] ""  OBD_COMPLIANT_ECUS
 SG_ PID_3A_Supported m32 : 30|1@0+ (1,0) [0|0] ""  OBD_COMPLIANT_ECUS
 SG_ PID_5A_Supported m64 : 30|1@0+ (1,0) [0|0] ""  OBD_COMPLIANT_ECUS
 SG_ PID_7A_Supported m96 : 30|1@0+ (1,0) [0|0] ""  OBD_COMPLIANT_ECUS
 SG_ PID_9A_Supported m128 : 30|1@0+ (1,0) [0|0] ""  OBD_COMPLIANT_ECUS
 SG_ PID_BA_Supported m160 : 30|1@0+ (1,0) [0|0] ""  OBD_COMPLIANT_ECUS
 SG_ PID_DA_Supported m192 : 30|1@0+ (1,0) [0|0] ""  OBD_COMPLIANT_ECUS
 SG_ MaximumValueForMassAirFlowSensor m80 : 31|8@0+ (10,0) [0|2550] "g/s"  OBD_COMPLIANT_ECUS
 SG_ MaximumValueForEquivalenceRatio m79 : 31|8@0+ (1,0) [0|255] "?"  OBD_COMPLIANT_ECUS
 SG_ PID_19_Supported m0 : 31|1@0+ (1,0) [0|0] ""  OBD_COMPLIANT_ECUS
 SG_ MonitorStatus m1 : 31|32@0+ (1,0) [0|4294967295] ""  OBD_COMPLIANT_ECUS
 SG_ FreezeDTC m2 : 31|16@0+ (1,0) [0|65535] ""  OBD_COMPLIANT_ECUS
 SG_ FuelSystem1Status m3 : 31|8@0+ (1,0) [0|255] ""  OBD_COMPLIANT_ECUS
 SG_ CalculatedEngineLoad m4 : 31|8@0+ (0.39216,0) [0|100] "%"  OBD_COMPLIANT_ECUS
 SG_ EngineCoolantTemp m5 : 31|8@0+ (1,-40) [-40|215] "°C"  OBD_COMPLIANT_ECUS
 SG_ ShortTermFuelTrim_B1 m6 : 31|8@0+ (0.78125,-100) [-100|99.21875] "%"  OBD_COMPLIANT_ECUS
 SG_ LongTermFuelTrim_B1 m7 : 31|8@0+ (0.78125,-100) [-100|99.21875] "%"  OBD_COMPLIANT_ECUS
 SG_ ShortTermFuelTrim_B2 m8 : 31|8@0+ (0.78125,-100) [-100|99.21875] "%"  OBD_COMPLIANT_ECUS
 SG_ LongTermFuelTrim_B2 m9 : 31|8@0+ (0.78125,-100) [-100|99.21875] "%"  OBD_COMPLIANT_ECUS
 SG_ FuelPressure m10 : 31|8@0+ (3,0) [0|765] "kPa"  OBD_COMPLIANT_ECUS
 SG_ IntakeManifoldAbsolutePressure m11 : 31|8@0+ (1,0) [0|255] "kPa"  OBD_COMPLIANT_ECUS
 SG_ EngineRPM m12 : 31|16@0+ (0.25,0) [0|16383.75] "rpm"  OBD_COMPLIANT_ECUS
 SG_ VehicleSpeed m13 : 31|8@0+ (1,0) [0|255] "km/h"  OBD_COMPLIANT_ECUS
 SG_ TimingAdvance m14 : 31|8@0+ (0.5,-64) [-64|63.5] "°"  OBD_COMPLIANT_ECUS
 SG_ IntakeAirTemp m15 : 31|8@0+ (1,-40) [-40|215] "°C"  OBD_COMPLIANT_ECUS
 SG_ MAFAirFlowRate m16 : 31|16@0+ (0.01,0) [0|655.35] "grams/sec"  OBD_COMPLIANT_ECUS
 SG_ ThrottlePosition m17 : 31|8@0+ (0.39216,0) [0|100] "%"  OBD_COMPLIANT_ECUS
 SG_ CommandSecondaryAirStatus m18 : 31|8@0+ (1,0) [0|255] ""  OBD_COMPLIANT_ECUS
 SG_ O2_B2S4_Supported m19 : 31|1@0+ (1,0) [0|1] ""  OBD_COMPLIANT_ECUS
 SG_ O2_B1S1_Volt m20 : 31|8@0+ (0.005,0) [0|1.275] "volts"  OBD_COMPLIANT_ECUS
 SG_ O2_B1S2_Volt m21 : 31|8@0+ (0.005,0) [0|1.275] "volts"  OBD_COMPLIANT_ECUS
 SG_ O2_B1S3_Volt m22 : 31|8@0+ (0.005,0) [0|1.275] "volts"  OBD_COMPLIANT_ECUS
 SG_ O2_B1S4_Volt m23 : 31|8@0+ (0.005,0) [0|1.275] "volts"  OBD_COMPLIANT_ECUS
 SG_ O2_B2S1_Volt m24 : 31|8@0+ (0.005,0) [0|1.275] "volts"  OBD_COMPLIANT_ECUS
 SG_ O2_B2S2_Volt m25 : 31|8@0+ (0.005,0) [0|1.275] "volts"  OBD_COMPLIANT_ECUS
 SG_ O2_B2S3_Volt m26 : 31|8@0+ (0.005,0) [0|1.275] "volts"  OBD_COMPLIANT_ECUS
 SG_ O2_B2S4_Volt m27 : 31|8@0+ (0.005,0) [0|1.275] "volts"  OBD_COMPLIANT_ECUS
 SG_ OBDStandard m28 : 31|8@0+ (1,0) [0|255] ""  OBD_COMPLIANT_ECUS
 SG_ TimeSinceEngineStart m31 : 31|16@0+ (1,0) [0|65535] "seconds"  OBD_COMPLIANT_ECUS
 SG_ PID_39_Supported m32 : 31|1@0+ (1,0) [0|0] ""  OBD_COMPLIANT_ECUS
 SG_ DistanceMILOn m33 : 31|16@0+ (1,0) [0|65535] "km"  OBD_COMPLIANT_ECUS
 SG_ FuelRailPressureRelativeToManifo m34 : 31|16@0+ (0.079,0) [0|5177.265] "kPa"  OBD_COMPLIANT_ECUS
 SG_ FuelRailPressure m35 : 31|16@0+ (10,0) [0|655350] "kPa"  OBD_COMPLIANT_ECUS
 SG_ CommandEGR m44 : 31|8@0+ (0.392156862745098,0) [0|100] "%"  OBD_COMPLIANT_ECUS
 SG_ EGRError m45 : 31|8@0+ (0.78125,-100) [-100|99.21875] "%"  OBD_COMPLIANT_ECUS
 SG_ CommandEVAPPurge m46 : 31|8@0+ (0.392156862745098,0) [0|100] "%"  OBD_COMPLIANT_ECUS
 SG_ FuelTankLevel m47 : 31|8@0+ (0.392156862745098,0) [0|100] "%"  OBD_COMPLIANT_ECUS
 SG_ WarmUpsSinceCodeClear m48 : 31|8@0+ (1,0) [0|255] "count"  OBD_COMPLIANT_ECUS
 SG_ DistanceSinceCodeClear m49 : 31|16@0+ (1,0) [0|65535] "km"  OBD_COMPLIANT_ECUS
 SG_ EVAPSystemVaporPressure m50 : 31|16@0- (0.25,0) [-8192|8191.75] "Pa"  OBD_COMPLIANT_ECUS
 SG_ AbsoluteBarometricPressure m51 : 31|8@0+ (1,0) [0|255] "kpa"  OBD_COMPLIANT_ECUS
 SG_ O2_B1S1_WB_Lambda m52 : 31|16@0+ (3.0517578125E-005,0) [0|2] "?"  OBD_COMPLIANT_ECUS
 SG_ O2_B1S2_WB_Lambda m53 : 31|16@0+ (3.0517578125E-005,0) [0|2] "?"  OBD_COMPLIANT_ECUS
 SG_ O2_B1S3_WB_Lambda m54 : 31|16@0+ (3.0517578125E-005,0) [0|2] "?"  OBD_COMPLIANT_ECUS
 SG_ O2_B1S4_WB_Lambda m55 : 31|16@0+ (3.0517578125E-005,0) [0|2] "?"  OBD_COMPLIANT_ECUS
 SG_ O2_B2S1_WB_Lambda m56 : 31|16@0+ (3.0517578125E-005,0) [0|2] "?"  OBD_COMPLIANT_ECUS
 SG_ O2_B2S2_WB_Lambda m57 : 31|16@0+ (3.0517578125E-005,0) [0|2] "?"  OBD_COMPLIANT_ECUS
 SG_ O2_B2S3_WB_Lambda m58 : 31|16@0+ (3.0517578125E-005,0) [0|2] "?"  OBD_COMPLIANT_ECUS
 SG_ O2_B2S4_WB_Lambda m59 : 31|16@0+ (3.0517578125E-005,0) [0|2] "?"  OBD_COMPLIANT_ECUS
 SG_ CatalystTemperature_B1S1 m60 : 31|16@0+ (0.1,-40) [-40|6513.5] "°C"  OBD_COMPLIANT_ECUS
 SG_ CatalystTemperature_B2S1 m61 : 31|16@0+ (0.1,-40) [-40|6513.5] "°C"  OBD_COMPLIANT_ECUS
 SG_ CatalystTemperature_B1S2 m62 : 31|16@0+ (0.1,-40) [-40|6513.5] "°C"  OBD_COMPLIANT_ECUS
 SG_ CatalystTemperature_B2S2 m63 : 31|16@0+ (0.1,-40) [-40|6513.5] "°C"  OBD_COMPLIANT_ECUS
 SG_ PID_59_Supported m64 : 31|1@0+ (1,0) [0|0] ""  OBD_COMPLIANT_ECUS
 SG_ ControlModuleVolt m66 : 31|16@0+ (0.001,0) [0|65.535] "V"  OBD_COMPLIANT_ECUS
 SG_ AbsoluteLoadValue m67 : 31|16@0+ (0.392156862745098,0) [0|25700] "%"  OBD_COMPLIANT_ECUS
 SG_ FuelAirCommandedLambda m68 : 31|16@0+ (3.0517578125E-005,0) [0|2] "?"  OBD_COMPLIANT_ECUS
 SG_ RelativeThrottlePosition m69 : 31|8@0+ (0.392156862745098,0) [0|100] "%"  OBD_COMPLIANT_ECUS
 SG_ AmbientAirTemp m70 : 31|8@0+ (1,-40) [-40|215] "°C"  OBD_COMPLIANT_ECUS
 SG_ AbsoluteThrottlePositionB m71 : 31|8@0+ (0.392156862745098,0) [0|100] "%"  OBD_COMPLIANT_ECUS
 SG_ AbsoluteThrottlePositionC m72 : 31|8@0+ (0.392156862745098,0) [0|100] "%"  OBD_COMPLIANT_ECUS
 SG_ AbsoluteThrottlePositionD m73 : 31|8@0+ (0.392156862745098,0) [0|100] "%"  OBD_COMPLIANT_ECUS
 SG_ AbsoluteThrottlePositionE m74 : 31|8@0+ (0.392156862745098,0) [0|100] "%"  OBD_COMPLIANT_ECUS
 SG_ AbsoluteThrottlePositionF m75 : 31|8@0+ (0.392156862745098,0) [0|100] "%"  OBD_COMPLIANT_ECUS
 SG_ CommandThrottleActuator m76 : 31|8@0+ (0.392156862745098,0) [0|100] "%"  OBD_COMPLIANT_ECUS
 SG_ TimeRunMILOn m77 : 31|16@0+ (1,0) [0|65535] "minutes"  OBD_COMPLIANT_ECUS
 SG_ TimeSinceCodeClear m78 : 31|16@0+ (1,0) [0|65535] "minutes"  OBD_COMPLIANT_ECUS
 SG_ FuelType m81 : 31|8@0+ (1,0) [0|255] ""  OBD_COMPLIANT_ECUS
 SG_ EthanolFuelPct m82 : 31|8@0+ (0.392156862745098,0) [0|100] "%"  OBD_COMPLIANT_ECUS
 SG_ AbsoluteEVAPSystemVaporPressure m83 : 31|16@0+ (0.005,0) [0|327.675] "kPa"  OBD_COMPLIANT_ECUS
 SG_ EvapSysVapPres m84 : 31|16@0+ (1,-32767) [-32767|32768] "Pa"  OBD_COMPLIANT_ECUS
 SG_ O2Secondary_B1_ShortTermFuelTrim m85 : 31|8@0+ (0.78125,-100) [-100|99.21875] "%"  OBD_COMPLIANT_ECUS
 SG_ O2Secondary_B1_LongTermFuelTrim m86 : 31|8@0+ (0.78125,-100) [-100|99.21875] "%"  OBD_COMPLIANT_ECUS
 SG_ O2Secondary_B2_ShortTermFuelTrim m87 : 31|8@0+ (0.78125,-100) [-100|99.21875] "%"  OBD_COMPLIANT_ECUS
 SG_ O2Secondary_B2_LongTermFuelTrim m88 : 31|8@0+ (0.78125,-100) [-100|99.21875] "%"  OBD_COMPLIANT_ECUS
 SG_ FuelRailPressureAbsolute m89 : 31|16@0+ (10,0) [0|655350] "kPa"  OBD_COMPLIANT_ECUS
 SG_ RelativeAcceleratorPedalPosition m90 : 31|8@0+ (0.392156862745098,0) [0|100] "%"  OBD_COMPLIANT_ECUS
 SG_ HybridBattteryPackRemainingLife m91 : 31|8@0+ (0.392156862745098,0) [0|100] "%"  OBD_COMPLIANT_ECUS
 SG_ EngineOilTemp m92 : 31|8@0+ (1,-40) [-40|215] "°C"  OBD_COMPLIANT_ECUS
 SG_ FuelInjectionTiming m93 : 31|16@0+ (0.0078125,-210) [-210|301.9921875] "°"  OBD_COMPLIANT_ECUS
 SG_ EngineFuelRate m94 : 31|16@0+ (0.05,0) [0|3276.75] "L/h"  OBD_COMPLIANT_ECUS
 SG_ EmissionRequirements m95 : 31|8@0+ (1,0) [0|255] ""  OBD_COMPLIANT_ECUS
 SG_ PID_79_Supported m96 : 31|1@0+ (1,0) [0|0] ""  OBD_COMPLIANT_ECUS
 SG_ EngineTorqueDemand m97 : 31|8@0+ (1,-125) [-125|130] "%"  OBD_COMPLIANT_ECUS
 SG_ EngineTorque m98 : 31|8@0+ (1,-125) [-125|130] "%"  OBD_COMPLIANT_ECUS
 SG_ EngineTorqueReference m99 : 31|16@0+ (1,0) [0|65535] "Nm"  OBD_COMPLIANT_ECUS
 SG_ EngineTorqueIdle m100 : 31|8@0+ (1,-125) [-125|130] "%"  OBD_COMPLIANT_ECUS
 SG_ CmdDieselIntAir m106 : 31|8@0+ (1,0) [0|255] ""  OBD_COMPLIANT_ECUS
 SG_ ExhaustGasTemp m107 : 31|8@0+ (1,0) [0|255] ""  OBD_COMPLIANT_ECUS
 SG_ CommandThrottleActuatorRelative m108 : 31|8@0+ (1,0) [0|255] ""  OBD_COMPLIANT_ECUS
 SG_ FuelPresContrSys m109 : 31|8@0+ (1,0) [0|255] ""  OBD_COMPLIANT_ECUS
 SG_ InjPresContrSys m110 : 31|8@0+ (1,0) [0|255] ""  OBD_COMPLIANT_ECUS
 SG_ TurboCompressorPressure m111 : 31|8@0+ (1,0) [0|255] ""  OBD_COMPLIANT_ECUS
 SG_ BoostPresCntrl m112 : 31|8@0+ (1,0) [0|255] ""  OBD_COMPLIANT_ECUS
 SG_ PID_99_Supported m128 : 31|1@0+ (1,0) [0|0] ""  OBD_COMPLIANT_ECUS
 SG_ IntakeManifoldSurfaceTemperature m132 : 31|8@0+ (1,-40) [-40|215] "°C"  OBD_COMPLIANT_ECUS
 SG_ EngineFrictionTorque m142 : 31|8@0+ (1,-125) [-125|130] "%"  OBD_COMPLIANT_ECUS
 SG_ PID_B9_Supported m160 : 31|1@0+ (1,0) [0|0] ""  OBD_COMPLIANT_ECUS
 SG_ Odometer m166 : 31|32@0+ (1,0) [0|4294967295] "km"  OBD_COMPLIANT_ECUS
 SG_ PID_D9_Supported m192 : 31|1@0+ (1,0) [0|0] ""  OBD_COMPLIANT_ECUS
 SG_ pid m1M : 23|8@0+ (1,0) [0|255] ""  OBD_COMPLIANT_ECUS
 SG_ mode M : 11|4@0+ (1,0) [0|15] ""  OBD_COMPLIANT_ECUS
 SG_ length_tx : 7|8@0+ (1,0) [0|255] ""  OBD_COMPLIANT_ECUS

BO_ 2024 RX: 8 OBD_COMPLIANT_ECUS
 SG_ EGR_B_CommandedDutyCyclePosition m105 : 63|8@0+ (0.392156862745098,0) [0|100] ""  OBD2_SCAN_TOOL
 SG_ IAT_B2S1 m104 : 63|8@0+ (1,-40) [-40|215] "°C"  OBD2_SCAN_TOOL
 SG_ EngineTorquePoint4 m100 : 63|8@0+ (1,-125) [-125|130] "%"  OBD2_SCAN_TOOL
 SG_ PID_08_Supported m0 : 48|1@0+ (1,0) [0|0] ""  OBD2_SCAN_TOOL
 SG_ PID_28_Supported m32 : 48|1@0+ (1,0) [0|0] ""  OBD2_SCAN_TOOL
 SG_ PID_48_Supported m64 : 48|1@0+ (1,0) [0|0] ""  OBD2_SCAN_TOOL
 SG_ Cat_NMHCCatMonitorStatus m65 : 48|1@0+ (1,0) [0|1] ""  OBD2_SCAN_TOOL
 SG_ PID_68_Supported m96 : 48|1@0+ (1,0) [0|0] ""  OBD2_SCAN_TOOL
 SG_ PID_88_Supported m128 : 48|1@0+ (1,0) [0|0] ""  OBD2_SCAN_TOOL
 SG_ PID_A8_Supported m160 : 48|1@0+ (1,0) [0|0] ""  OBD2_SCAN_TOOL
 SG_ PID_C8_Supported m192 : 48|1@0+ (1,0) [0|0] ""  OBD2_SCAN_TOOL
 SG_ PID_07_Supported m0 : 49|1@0+ (1,0) [0|0] ""  OBD2_SCAN_TOOL
 SG_ PID_27_Supported m32 : 49|1@0+ (1,0) [0|0] ""  OBD2_SCAN_TOOL
 SG_ PID_47_Supported m64 : 49|1@0+ (1,0) [0|0] ""  OBD2_SCAN_TOOL
 SG_ HeatedCat_NOxSCRMonitorStatus m65 : 49|1@0+ (1,0) [0|1] ""  OBD2_SCAN_TOOL
 SG_ PID_67_Supported m96 : 49|1@0+ (1,0) [0|0] ""  OBD2_SCAN_TOOL
 SG_ PID_87_Supported m128 : 49|1@0+ (1,0) [0|0] ""  OBD2_SCAN_TOOL
 SG_ PID_A7_Supported m160 : 49|1@0+ (1,0) [0|0] ""  OBD2_SCAN_TOOL
 SG_ PID_C7_Supported m192 : 49|1@0+ (1,0) [0|0] ""  OBD2_SCAN_TOOL
 SG_ PID_06_Supported m0 : 50|1@0+ (1,0) [0|0] ""  OBD2_SCAN_TOOL
 SG_ PID_26_Supported m32 : 50|1@0+ (1,0) [0|0] ""  OBD2_SCAN_TOOL
 SG_ PID_46_Supported m64 : 50|1@0+ (1,0) [0|0] ""  OBD2_SCAN_TOOL
 SG_ EvapMonitorStatus m65 : 50|1@0+ (1,0) [0|1] ""  OBD2_SCAN_TOOL
 SG_ PID_66_Supported m96 : 50|1@0+ (1,0) [0|0] ""  OBD2_SCAN_TOOL
 SG_ PID_86_Supported m128 : 50|1@0+ (1,0) [0|0] ""  OBD2_SCAN_TOOL
 SG_ PID_A6_Supported m160 : 50|1@0+ (1,0) [0|0] ""  OBD2_SCAN_TOOL
 SG_ PID_C6_Supported m192 : 50|1@0+ (1,0) [0|0] ""  OBD2_SCAN_TOOL
 SG_ PID_05_Supported m0 : 51|1@0+ (1,0) [0|0] ""  OBD2_SCAN_TOOL
 SG_ PID_25_Supported m32 : 51|1@0+ (1,0) [0|0] ""  OBD2_SCAN_TOOL
 SG_ PID_45_Supported m64 : 51|1@0+ (1,0) [0|0] ""  OBD2_SCAN_TOOL
 SG_ SecondaryAir_BoostPressureM_0001 m65 : 51|1@0+ (1,0) [0|1] ""  OBD2_SCAN_TOOL
 SG_ PID_65_Supported m96 : 51|1@0+ (1,0) [0|0] ""  OBD2_SCAN_TOOL
 SG_ PID_85_Supported m128 : 51|1@0+ (1,0) [0|0] ""  OBD2_SCAN_TOOL
 SG_ PID_A5_Supported m160 : 51|1@0+ (1,0) [0|0] ""  OBD2_SCAN_TOOL
 SG_ PID_C5_Supported m192 : 51|1@0+ (1,0) [0|0] ""  OBD2_SCAN_TOOL
 SG_ PID_04_Supported m0 : 52|1@0+ (1,0) [0|0] ""  OBD2_SCAN_TOOL
 SG_ PID_24_Supported m32 : 52|1@0+ (1,0) [0|0] ""  OBD2_SCAN_TOOL
 SG_ PID_44_Supported m64 : 52|1@0+ (1,0) [0|0] ""  OBD2_SCAN_TOOL
 SG_ PID_64_Supported m96 : 52|1@0+ (1,0) [0|0] ""  OBD2_SCAN_TOOL
 SG_ PID_84_Supported m128 : 52|1@0+ (1,0) [0|0] ""  OBD2_SCAN_TOOL
 SG_ PID_A4_Supported m160 : 52|1@0+ (1,0) [0|0] ""  OBD2_SCAN_TOOL
 SG_ PID_C4_Supported m192 : 52|1@0+ (1,0) [0|0] ""  OBD2_SCAN_TOOL
 SG_ PID_03_Supported m0 : 53|1@0+ (1,0) [0|0] ""  OBD2_SCAN_TOOL
 SG_ PID_23_Supported m32 : 53|1@0+ (1,0) [0|0] ""  OBD2_SCAN_TOOL
 SG_ PID_43_Supported m64 : 53|1@0+ (1,0) [0|0] ""  OBD2_SCAN_TOOL
 SG_ O2_ExhaustGasMonitorStatus m65 : 53|1@0+ (1,0) [0|1] ""  OBD2_SCAN_TOOL
 SG_ PID_63_Supported m96 : 53|1@0+ (1,0) [0|0] ""  OBD2_SCAN_TOOL
 SG_ PID_83_Supported m128 : 53|1@0+ (1,0) [0|0] ""  OBD2_SCAN_TOOL
 SG_ PID_A3_Supported m160 : 53|1@0+ (1,0) [0|0] ""  OBD2_SCAN_TOOL
 SG_ PID_C3_Supported m192 : 53|1@0+ (1,0) [0|0] ""  OBD2_SCAN_TOOL
 SG_ PID_02_Supported m0 : 54|1@0+ (1,0) [0|0] ""  OBD2_SCAN_TOOL
 SG_ PID_22_Supported m32 : 54|1@0+ (1,0) [0|0] ""  OBD2_SCAN_TOOL
 SG_ PID_42_Supported m64 : 54|1@0+ (1,0) [0|0] ""  OBD2_SCAN_TOOL
 SG_ O2_PMFilterMonitorStatus m65 : 54|1@0+ (1,0) [0|1] ""  OBD2_SCAN_TOOL
 SG_ PID_62_Supported m96 : 54|1@0+ (1,0) [0|0] ""  OBD2_SCAN_TOOL
 SG_ PID_82_Supported m128 : 54|1@0+ (1,0) [0|0] ""  OBD2_SCAN_TOOL
 SG_ PID_A2_Supported m160 : 54|1@0+ (1,0) [0|0] ""  OBD2_SCAN_TOOL
 SG_ PID_C2_Supported m192 : 54|1@0+ (1,0) [0|0] ""  OBD2_SCAN_TOOL
 SG_ EGR_A_Error m105 : 55|8@0+ (0.389093137254902,0) [0|99.21875] ""  OBD2_SCAN_TOOL
 SG_ IAT_B1S3 m104 : 55|8@0+ (1,-40) [-40|215] "°C"  OBD2_SCAN_TOOL
 SG_ MAFSensorB m102 : 55|16@0+ (0.03125,0) [0|2047.96875] "g/s"  OBD2_SCAN_TOOL
 SG_ MaximumValueForIntakeManifo_0000 m79 : 55|8@0+ (10,0) [0|2550] "kPa"  OBD2_SCAN_TOOL
 SG_ PID_01_Supported m0 : 55|1@0+ (1,0) [0|0] ""  OBD2_SCAN_TOOL
 SG_ PID_21_Supported m32 : 55|1@0+ (1,0) [0|0] ""  OBD2_SCAN_TOOL
 SG_ PID_41_Supported m64 : 55|1@0+ (1,0) [0|0] ""  OBD2_SCAN_TOOL
 SG_ EGR_VVTMonitorStatus m65 : 55|1@0+ (1,0) [0|1] ""  OBD2_SCAN_TOOL
 SG_ PID_61_Supported m96 : 55|1@0+ (1,0) [0|0] ""  OBD2_SCAN_TOOL
 SG_ EngineTorquePoint3 m100 : 55|8@0+ (1,-125) [-125|130] "%"  OBD2_SCAN_TOOL
 SG_ PID_81_Supported m128 : 55|1@0+ (1,0) [0|0] ""  OBD2_SCAN_TOOL
 SG_ NOxConcentrationB1S2 m131 : 55|16@0+ (1,0) [0|65535] "ppm"  OBD2_SCAN_TOOL
 SG_ NOxAvgDemReagentConsumption m133 : 55|16@0+ (0.005,0) [0|327.675] "L/h"  OBD2_SCAN_TOOL
 SG_ PMConcentration_B2S1 m134 : 55|16@0+ (0.0125,0) [0|819.1875] "mg"  OBD2_SCAN_TOOL
 SG_ IntakeManifoldAbsolutePressureB m135 : 55|16@0- (0.03125,0) [-1024|1023.96875] "kPa"  OBD2_SCAN_TOOL
 SG_ PID_A1_Supported m160 : 55|1@0+ (1,0) [0|0] ""  OBD2_SCAN_TOOL
 SG_ PID_C1_Supported m192 : 55|1@0+ (1,0) [0|0] ""  OBD2_SCAN_TOOL
 SG_ PID_10_Supported m0 : 40|1@0+ (1,0) [0|0] ""  OBD2_SCAN_TOOL
 SG_ PID_30_Supported m32 : 40|1@0+ (1,0) [0|0] ""  OBD2_SCAN_TOOL
 SG_ PID_50_Supported m64 : 40|1@0+ (1,0) [0|0] ""  OBD2_SCAN_TOOL
 SG_ Cat_NMHCCatMonitorEnabled m65 : 40|1@0+ (1,0) [0|1] ""  OBD2_SCAN_TOOL
 SG_ PID_70_Supported m96 : 40|1@0+ (1,0) [0|0] ""  OBD2_SCAN_TOOL
 SG_ PID_90_Supported m128 : 40|1@0+ (1,0) [0|0] ""  OBD2_SCAN_TOOL
 SG_ PID_B0_Supported m160 : 40|1@0+ (1,0) [0|0] ""  OBD2_SCAN_TOOL
 SG_ PID_D0_Supported m192 : 40|1@0+ (1,0) [0|0] ""  OBD2_SCAN_TOOL
 SG_ PID_0F_Supported m0 : 41|1@0+ (1,0) [0|0] ""  OBD2_SCAN_TOOL
 SG_ PID_2F_Supported m32 : 41|1@0+ (1,0) [0|0] ""  OBD2_SCAN_TOOL
 SG_ PID_4F_Supported m64 : 41|1@0+ (1,0) [0|0] ""  OBD2_SCAN_TOOL
 SG_ HeatedCat_NOxSCRMonitorEnabled m65 : 41|1@0+ (1,0) [0|1] ""  OBD2_SCAN_TOOL
 SG_ PID_6F_Supported m96 : 41|1@0+ (1,0) [0|0] ""  OBD2_SCAN_TOOL
 SG_ PID_8F_Supported m128 : 41|1@0+ (1,0) [0|0] ""  OBD2_SCAN_TOOL
 SG_ PID_AF_Supported m160 : 41|1@0+ (1,0) [0|0] ""  OBD2_SCAN_TOOL
 SG_ PID_CF_Supported m192 : 41|1@0+ (1,0) [0|0] ""  OBD2_SCAN_TOOL
 SG_ PID_0E_Supported m0 : 42|1@0+ (1,0) [0|0] ""  OBD2_SCAN_TOOL
 SG_ PID_2E_Supported m32 : 42|1@0+ (1,0) [0|0] ""  OBD2_SCAN_TOOL
 SG_ PID_4E_Supported m64 : 42|1@0+ (1,0) [0|0] ""  OBD2_SCAN_TOOL
 SG_ EvapMonitorEnabled m65 : 42|1@0+ (1,0) [0|1] ""  OBD2_SCAN_TOOL
 SG_ PID_6E_Supported m96 : 42|1@0+ (1,0) [0|0] ""  OBD2_SCAN_TOOL
 SG_ PID_8E_Supported m128 : 42|1@0+ (1,0) [0|0] ""  OBD2_SCAN_TOOL
 SG_ PID_AE_Supported m160 : 42|1@0+ (1,0) [0|0] ""  OBD2_SCAN_TOOL
 SG_ PID_CE_Supported m192 : 42|1@0+ (1,0) [0|0] ""  OBD2_SCAN_TOOL
 SG_ PID_0D_Supported m0 : 43|1@0+ (1,0) [0|0] ""  OBD2_SCAN_TOOL
 SG_ PID_2D_Supported m32 : 43|1@0+ (1,0) [0|0] ""  OBD2_SCAN_TOOL
 SG_ PID_4D_Supported m64 : 43|1@0+ (1,0) [0|0] ""  OBD2_SCAN_TOOL
 SG_ SecondaryAir_BoostPressureM_0002 m65 : 43|1@0+ (1,0) [0|1] ""  OBD2_SCAN_TOOL
 SG_ PID_6D_Supported m96 : 43|1@0+ (1,0) [0|0] ""  OBD2_SCAN_TOOL
 SG_ PID_8D_Supported m128 : 43|1@0+ (1,0) [0|0] ""  OBD2_SCAN_TOOL
 SG_ PID_AD_Supported m160 : 43|1@0+ (1,0) [0|0] ""  OBD2_SCAN_TOOL
 SG_ PID_CD_Supported m192 : 43|1@0+ (1,0) [0|0] ""  OBD2_SCAN_TOOL
 SG_ PID_0C_Supported m0 : 44|1@0+ (1,0) [0|0] ""  OBD2_SCAN_TOOL
 SG_ PID_2C_Supported m32 : 44|1@0+ (1,0) [0|0] ""  OBD2_SCAN_TOOL
 SG_ PID_4C_Supported m64 : 44|1@0+ (1,0) [0|0] ""  OBD2_SCAN_TOOL
 SG_ PID_6C_Supported m96 : 44|1@0+ (1,0) [0|0] ""  OBD2_SCAN_TOOL
 SG_ PID_8C_Supported m128 : 44|1@0+ (1,0) [0|0] ""  OBD2_SCAN_TOOL
 SG_ PID_AC_Supported m160 : 44|1@0+ (1,0) [0|0] ""  OBD2_SCAN_TOOL
 SG_ PID_CC_Supported m192 : 44|1@0+ (1,0) [0|0] ""  OBD2_SCAN_TOOL
 SG_ PID_0B_Supported m0 : 45|1@0+ (1,0) [0|0] ""  OBD2_SCAN_TOOL
 SG_ PID_2B_Supported m32 : 45|1@0+ (1,0) [0|0] ""  OBD2_SCAN_TOOL
 SG_ PID_4B_Supported m64 : 45|1@0+ (1,0) [0|0] ""  OBD2_SCAN_TOOL
 SG_ O2_ExhaustGasMonitorEnabled m65 : 45|1@0+ (1,0) [0|1] ""  OBD2_SCAN_TOOL
 SG_ PID_6B_Supported m96 : 45|1@0+ (1,0) [0|0] ""  OBD2_SCAN_TOOL
 SG_ PID_8B_Supported m128 : 45|1@0+ (1,0) [0|0] ""  OBD2_SCAN_TOOL
 SG_ PID_AB_Supported m160 : 45|1@0+ (1,0) [0|0] ""  OBD2_SCAN_TOOL
 SG_ PID_CB_Supported m192 : 45|1@0+ (1,0) [0|0] ""  OBD2_SCAN_TOOL
 SG_ PID_0A_Supported m0 : 46|1@0+ (1,0) [0|0] ""  OBD2_SCAN_TOOL
 SG_ PID_2A_Supported m32 : 46|1@0+ (1,0) [0|0] ""  OBD2_SCAN_TOOL
 SG_ PID_4A_Supported m64 : 46|1@0+ (1,0) [0|0] ""  OBD2_SCAN_TOOL
 SG_ O2Heater_PMFilterMonitorEnabled m65 : 46|1@0+ (1,0) [0|1] ""  OBD2_SCAN_TOOL
 SG_ PID_6A_Supported m96 : 46|1@0+ (1,0) [0|0] ""  OBD2_SCAN_TOOL
 SG_ PID_8A_Supported m128 : 46|1@0+ (1,0) [0|0] ""  OBD2_SCAN_TOOL
 SG_ PID_AA_Supported m160 : 46|1@0+ (1,0) [0|0] ""  OBD2_SCAN_TOOL
 SG_ PID_CA_Supported m192 : 46|1@0+ (1,0) [0|0] ""  OBD2_SCAN_TOOL
 SG_ EGR_A_DutyCyclePosition m105 : 47|8@0+ (0.392156862745098,0) [0|100] ""  OBD2_SCAN_TOOL
 SG_ IAT_B1S2 m104 : 47|8@0+ (1,-40) [-40|215] "°C"  OBD2_SCAN_TOOL
 SG_ ECTSensorB m103 : 47|8@0+ (1,-40) [-40|215] "°C"  OBD2_SCAN_TOOL
 SG_ MaximumValueForOxygenSensor_0000 m79 : 47|8@0+ (1,0) [0|255] "mA"  OBD2_SCAN_TOOL
 SG_ PID_09_Supported m0 : 47|1@0+ (1,0) [0|0] ""  OBD2_SCAN_TOOL
 SG_ PID_29_Supported m32 : 47|1@0+ (1,0) [0|0] ""  OBD2_SCAN_TOOL
 SG_ O2_B1S1_WB_Volt m36 : 47|16@0+ (0.0001220703125,0) [0|2] "volts"  OBD2_SCAN_TOOL
 SG_ O2_B1S2_WB_Volt m37 : 47|16@0+ (0.0001220703125,0) [0|8] "volts"  OBD2_SCAN_TOOL
 SG_ O2_B1S3_WB_Volt m38 : 47|16@0+ (0.0001220703125,0) [0|8] "volts"  OBD2_SCAN_TOOL
 SG_ O2_B1S4_WB_Volt m39 : 47|16@0+ (0.0001220703125,0) [0|8] "volts"  OBD2_SCAN_TOOL
 SG_ O2_B2S1_WB_Volt m40 : 47|16@0+ (0.0001220703125,0) [0|8] "volts"  OBD2_SCAN_TOOL
 SG_ O2_B2S2_WB_Volt m41 : 47|16@0+ (0.0001220703125,0) [0|8] "volts"  OBD2_SCAN_TOOL
 SG_ O2_B2S3_WB_Volt m42 : 47|16@0+ (0.0001220703125,0) [0|8] "volts"  OBD2_SCAN_TOOL
 SG_ O2_B2S4_WB_Volt m43 : 47|16@0+ (0.0001220703125,0) [0|8] "volts"  OBD2_SCAN_TOOL
 SG_ O2_B1S1_WB_Current m52 : 47|16@0+ (0.00390625,-128) [-128|128] "mA"  OBD2_SCAN_TOOL
 SG_ O2_B1S2_WB_Current m53 : 47|16@0+ (0.00390625,-128) [-128|128] "mA"  OBD2_SCAN_TOOL
 SG_ O2_B1S3_WB_Current m54 : 47|16@0+ (0.00390625,-128) [-128|128] "mA"  OBD2_SCAN_TOOL
 SG_ O2_B1S4_WB_Current m55 : 47|16@0+ (0.00390625,-128) [-128|128] "mA"  OBD2_SCAN_TOOL
 SG_ O2_B2S1_WB_Current m56 : 47|16@0+ (0.00390625,-128) [-128|128] "mA"  OBD2_SCAN_TOOL
 SG_ O2_B2S2_WB_Current m57 : 47|16@0+ (0.00390625,-128) [-128|128] "mA"  OBD2_SCAN_TOOL
 SG_ O2_B2S3_WB_Current m58 : 47|16@0+ (0.00390625,-128) [-128|128] "mA"  OBD2_SCAN_TOOL
 SG_ O2_B2S4_WB_Current m59 : 47|16@0+ (0.00390625,-128) [-128|128] "mA"  OBD2_SCAN_TOOL
 SG_ PID_49_Supported m64 : 47|1@0+ (1,0) [0|0] ""  OBD2_SCAN_TOOL
 SG_ EGR_VVTSystemMonitorEnabled m65 : 47|1@0+ (1,0) [0|1] ""  OBD2_SCAN_TOOL
 SG_ PID_69_Supported m96 : 47|1@0+ (1,0) [0|0] ""  OBD2_SCAN_TOOL
 SG_ EngineTorquePoint2 m100 : 47|8@0+ (1,-125) [-125|130] "%"  OBD2_SCAN_TOOL
 SG_ PID_89_Supported m128 : 47|1@0+ (1,0) [0|0] ""  OBD2_SCAN_TOOL
 SG_ PID_A9_Supported m160 : 47|1@0+ (1,0) [0|0] ""  OBD2_SCAN_TOOL
 SG_ PID_C9_Supported m192 : 47|1@0+ (1,0) [0|0] ""  OBD2_SCAN_TOOL
 SG_ PTOStatus2 m101 : 32|1@0+ (1,0) [0|1] ""  OBD2_SCAN_TOOL
 SG_ PID_18_Supported m0 : 32|1@0+ (1,0) [0|0] ""  OBD2_SCAN_TOOL
 SG_ PID_38_Supported m32 : 32|1@0+ (1,0) [0|0] ""  OBD2_SCAN_TOOL
 SG_ PID_58_Supported m64 : 32|1@0+ (1,0) [0|0] ""  OBD2_SCAN_TOOL
 SG_ MisfireMonitorEnabled m65 : 32|1@0+ (1,0) [0|1] ""  OBD2_SCAN_TOOL
 SG_ PID_78_Supported m96 : 32|1@0+ (1,0) [0|0] ""  OBD2_SCAN_TOOL
 SG_ PID_98_Supported m128 : 32|1@0+ (1,0) [0|0] ""  OBD2_SCAN_TOOL
 SG_ PID_B8_Supported m160 : 32|1@0+ (1,0) [0|0] ""  OBD2_SCAN_TOOL
 SG_ PID_D8_Supported m192 : 32|1@0+ (1,0) [0|0] ""  OBD2_SCAN_TOOL
 SG_ AutomaticTransmissionGearStatus m101 : 33|1@0+ (1,0) [0|1] ""  OBD2_SCAN_TOOL
 SG_ PID_17_Supported m0 : 33|1@0+ (1,0) [0|0] ""  OBD2_SCAN_TOOL
 SG_ PID_37_Supported m32 : 33|1@0+ (1,0) [0|0] ""  OBD2_SCAN_TOOL
 SG_ PID_57_Supported m64 : 33|1@0+ (1,0) [0|0] ""  OBD2_SCAN_TOOL
 SG_ FuelSystemMonitorEnabled m65 : 33|1@0+ (1,0) [0|1] ""  OBD2_SCAN_TOOL
 SG_ PID_77_Supported m96 : 33|1@0+ (1,0) [0|0] ""  OBD2_SCAN_TOOL
 SG_ PID_97_Supported m128 : 33|1@0+ (1,0) [0|0] ""  OBD2_SCAN_TOOL
 SG_ PID_B7_Supported m160 : 33|1@0+ (1,0) [0|0] ""  OBD2_SCAN_TOOL
 SG_ PID_D7_Supported m192 : 33|1@0+ (1,0) [0|0] ""  OBD2_SCAN_TOOL
 SG_ ManualTransmissionGearStatus m101 : 34|1@0+ (1,0) [0|1] ""  OBD2_SCAN_TOOL
 SG_ PID_16_Supported m0 : 34|1@0+ (1,0) [0|0] ""  OBD2_SCAN_TOOL
 SG_ PID_36_Supported m32 : 34|1@0+ (1,0) [0|0] ""  OBD2_SCAN_TOOL
 SG_ PID_56_Supported m64 : 34|1@0+ (1,0) [0|0] ""  OBD2_SCAN_TOOL
 SG_ CompComponentMonitorEnabled m65 : 34|1@0+ (1,0) [0|1] ""  OBD2_SCAN_TOOL
 SG_ PID_76_Supported m96 : 34|1@0+ (1,0) [0|0] ""  OBD2_SCAN_TOOL
 SG_ PID_96_Supported m128 : 34|1@0+ (1,0) [0|0] ""  OBD2_SCAN_TOOL
 SG_ PID_B6_Supported m160 : 34|1@0+ (1,0) [0|0] ""  OBD2_SCAN_TOOL
 SG_ PID_D6_Supported m192 : 34|1@0+ (1,0) [0|0] ""  OBD2_SCAN_TOOL
 SG_ GlowPlugLampStatus m101 : 35|1@0+ (1,0) [0|1] ""  OBD2_SCAN_TOOL
 SG_ PID_15_Supported m0 : 35|1@0+ (1,0) [0|0] ""  OBD2_SCAN_TOOL
 SG_ PID_35_Supported m32 : 35|1@0+ (1,0) [0|0] ""  OBD2_SCAN_TOOL
 SG_ PID_55_Supported m64 : 35|1@0+ (1,0) [0|0] ""  OBD2_SCAN_TOOL
 SG_ IgnitionMonitorType m65 : 35|1@0+ (1,0) [0|1] ""  OBD2_SCAN_TOOL
 SG_ PID_75_Supported m96 : 35|1@0+ (1,0) [0|0] ""  OBD2_SCAN_TOOL
 SG_ PID_95_Supported m128 : 35|1@0+ (1,0) [0|0] ""  OBD2_SCAN_TOOL
 SG_ PID_B5_Supported m160 : 35|1@0+ (1,0) [0|0] ""  OBD2_SCAN_TOOL
 SG_ PID_D5_Supported m192 : 35|1@0+ (1,0) [0|0] ""  OBD2_SCAN_TOOL
 SG_ PID_14_Supported m0 : 36|1@0+ (1,0) [0|0] ""  OBD2_SCAN_TOOL
 SG_ PID_34_Supported m32 : 36|1@0+ (1,0) [0|0] ""  OBD2_SCAN_TOOL
 SG_ PID_54_Supported m64 : 36|1@0+ (1,0) [0|0] ""  OBD2_SCAN_TOOL
 SG_ MisfireMonitorStatus m65 : 36|1@0+ (1,0) [0|1] ""  OBD2_SCAN_TOOL
 SG_ PID_74_Supported m96 : 36|1@0+ (1,0) [0|0] ""  OBD2_SCAN_TOOL
 SG_ PID_94_Supported m128 : 36|1@0+ (1,0) [0|0] ""  OBD2_SCAN_TOOL
 SG_ PID_B4_Supported m160 : 36|1@0+ (1,0) [0|0] ""  OBD2_SCAN_TOOL
 SG_ PID_D4_Supported m192 : 36|1@0+ (1,0) [0|0] ""  OBD2_SCAN_TOOL
 SG_ PID_13_Supported m0 : 37|1@0+ (1,0) [0|0] ""  OBD2_SCAN_TOOL
 SG_ PID_33_Supported m32 : 37|1@0+ (1,0) [0|0] ""  OBD2_SCAN_TOOL
 SG_ PID_53_Supported m64 : 37|1@0+ (1,0) [0|0] ""  OBD2_SCAN_TOOL
 SG_ FuelSystemMonitorStatus m65 : 37|1@0+ (1,0) [0|1] ""  OBD2_SCAN_TOOL
 SG_ PID_73_Supported m96 : 37|1@0+ (1,0) [0|0] ""  OBD2_SCAN_TOOL
 SG_ PID_93_Supported m128 : 37|1@0+ (1,0) [0|0] ""  OBD2_SCAN_TOOL
 SG_ PID_B3_Supported m160 : 37|1@0+ (1,0) [0|0] ""  OBD2_SCAN_TOOL
 SG_ PID_D3_Supported m192 : 37|1@0+ (1,0) [0|0] ""  OBD2_SCAN_TOOL
 SG_ PID_12_Supported m0 : 38|1@0+ (1,0) [0|0] ""  OBD2_SCAN_TOOL
 SG_ PID_32_Supported m32 : 38|1@0+ (1,0) [0|0] ""  OBD2_SCAN_TOOL
 SG_ PID_52_Supported m64 : 38|1@0+ (1,0) [0|0] ""  OBD2_SCAN_TOOL
 SG_ CompComponentMonitorStatus m65 : 38|1@0+ (1,0) [0|1] ""  OBD2_SCAN_TOOL
 SG_ PID_72_Supported m96 : 38|1@0+ (1,0) [0|0] ""  OBD2_SCAN_TOOL
 SG_ PID_92_Supported m128 : 38|1@0+ (1,0) [0|0] ""  OBD2_SCAN_TOOL
 SG_ PID_B2_Supported m160 : 38|1@0+ (1,0) [0|0] ""  OBD2_SCAN_TOOL
 SG_ PID_D2_Supported m192 : 38|1@0+ (1,0) [0|0] ""  OBD2_SCAN_TOOL
 SG_ EGR_A_CommandedDutyCyclePosition m105 : 39|8@0+ (0.392156862745098,0) [0|100] ""  OBD2_SCAN_TOOL
 SG_ IAT_B1S1 m104 : 39|8@0+ (1,-40) [-40|215] "°C"  OBD2_SCAN_TOOL
 SG_ ECTSensorA m103 : 39|8@0+ (1,-40) [-40|215] "°C"  OBD2_SCAN_TOOL
 SG_ MAFSensorA m102 : 39|16@0+ (0.03125,0) [0|2047.96875] "g/s"  OBD2_SCAN_TOOL
 SG_ MaximumValueForOxygenSensor_0001 m79 : 39|8@0+ (1,0) [0|255] "V"  OBD2_SCAN_TOOL
 SG_ PID_11_Supported m0 : 39|1@0+ (1,0) [0|0] ""  OBD2_SCAN_TOOL
 SG_ FuelSystem2Status m3 : 39|8@0+ (1,0) [0|255] ""  OBD2_SCAN_TOOL
 SG_ ShortTermFuelTrim_B3 m6 : 39|8@0+ (0.78125,-100) [-100|99.21875] "%"  OBD2_SCAN_TOOL
 SG_ LongTermFuelTrim_B3 m7 : 39|8@0+ (0.78125,-100) [-100|99.21875] "%"  OBD2_SCAN_TOOL
 SG_ ShortTermFuelTrim_B4 m8 : 39|8@0+ (0.78125,-100) [-100|99.21875] "%"  OBD2_SCAN_TOOL
 SG_ LongTermFuelTrim_B4 m9 : 39|8@0+ (0.78125,-100) [-100|99.21875] "%"  OBD2_SCAN_TOOL
 SG_ O2_B1S1_ShortTermFuelTrim m20 : 39|8@0+ (0.78125,-100) [-100|99.21875] "%"  OBD2_SCAN_TOOL
 SG_ O2_B1S2_ShortTermFuelTrim m21 : 39|8@0+ (0.78125,-100) [-100|99.21875] "%"  OBD2_SCAN_TOOL
 SG_ O2_B1S3_ShortTermFuelTrim m22 : 39|8@0+ (0.78125,-100) [-100|99.21875] "%"  OBD2_SCAN_TOOL
 SG_ O2_B1S4_ShortTermFuelTrim m23 : 39|8@0+ (0.78125,-100) [-100|99.21875] "%"  OBD2_SCAN_TOOL
 SG_ O2_B2S1_ShortTermFuelTrim m24 : 39|8@0+ (0.78125,-100) [-100|99.21875] "%"  OBD2_SCAN_TOOL
 SG_ O2_B2S2_ShortTermFuelTrim m25 : 39|8@0+ (0.78125,-100) [-100|99.21875] "%"  OBD2_SCAN_TOOL
 SG_ O2_B2S3_ShortTermFuelTrim m26 : 39|8@0+ (0.78125,-100) [-100|99.21875] "%"  OBD2_SCAN_TOOL
 SG_ O2_B2S4_ShortTermFuelTrim m27 : 39|8@0+ (0.78125,-100) [-100|99.21875] "%"  OBD2_SCAN_TOOL
 SG_ PID_31_Supported m32 : 39|1@0+ (1,0) [0|0] ""  OBD2_SCAN_TOOL
 SG_ PID_51_Supported m64 : 39|1@0+ (1,0) [0|0] ""  OBD2_SCAN_TOOL
 SG_ O2Secondary_B3_ShortTermFuelTrim m85 : 39|8@0+ (0.78125,-100) [-100|99.21875] "%"  OBD2_SCAN_TOOL
 SG_ O2Secondary_B3_LongTermFuelTrim m86 : 39|8@0+ (0.78125,-100) [-100|99.21875] "%"  OBD2_SCAN_TOOL
 SG_ O2Secondary_B4_ShortTermFuelTrim m87 : 39|8@0+ (0.78125,-100) [-100|99.21875] "%"  OBD2_SCAN_TOOL
 SG_ O2Secondary_B4_LongTermFuelTrim m88 : 39|8@0+ (0.78125,-100) [-100|99.21875] "%"  OBD2_SCAN_TOOL
 SG_ PID_71_Supported m96 : 39|1@0+ (1,0) [0|0] ""  OBD2_SCAN_TOOL
 SG_ EngineTorquePoint1 m100 : 39|8@0+ (1,-125) [-125|130] "%"  OBD2_SCAN_TOOL
 SG_ PID_91_Supported m128 : 39|1@0+ (1,0) [0|0] ""  OBD2_SCAN_TOOL
 SG_ NOxConcentrationB1S1 m131 : 39|16@0+ (1,0) [0|65535] "ppm"  OBD2_SCAN_TOOL
 SG_ NOxAvgReagentConsumption m133 : 39|16@0+ (0.005,0) [0|327.675] "L/h"  OBD2_SCAN_TOOL
 SG_ PMConcentration_B1S1 m134 : 39|16@0+ (0.0125,0) [0|819.1875] "mg"  OBD2_SCAN_TOOL
 SG_ IntakeManifoldAbsolutePressureA m135 : 39|16@0- (0.03125,0) [-1024|1023.96875] "kPa"  OBD2_SCAN_TOOL
 SG_ PID_B1_Supported m160 : 39|1@0+ (1,0) [0|0] ""  OBD2_SCAN_TOOL
 SG_ PID_D1_Supported m192 : 39|1@0+ (1,0) [0|0] ""  OBD2_SCAN_TOOL
 SG_ IAT_B1S1_Support m104 : 24|1@0+ (1,0) [0|1] ""  OBD2_SCAN_TOOL
 SG_ ECTSensorASupport m103 : 24|1@0+ (1,0) [0|1] ""  OBD2_SCAN_TOOL
 SG_ MAFSensorASupport m102 : 24|1@0+ (1,0) [0|1] ""  OBD2_SCAN_TOOL
 SG_ PTOStatus2Support m101 : 24|1@0+ (1,0) [0|1] ""  OBD2_SCAN_TOOL
 SG_ PID_20_Supported m0 : 24|1@0+ (1,0) [0|0] ""  OBD2_SCAN_TOOL
 SG_ IntakeManifoldAbsolutePress_0000 m135 : 24|1@0+ (1,0) [0|1] ""  OBD2_SCAN_TOOL
 SG_ O2_B1S1_Supported m19 : 24|1@0+ (1,0) [0|1] ""  OBD2_SCAN_TOOL
 SG_ PTOStatus m30 : 24|1@0+ (1,0) [0|1] ""  OBD2_SCAN_TOOL
 SG_ PID_40_Supported m32 : 24|1@0+ (1,0) [0|0] ""  OBD2_SCAN_TOOL
 SG_ PID_60_Supported m64 : 24|1@0+ (1,0) [0|0] ""  OBD2_SCAN_TOOL
 SG_ PID_80_Supported m96 : 24|1@0+ (1,0) [0|0] ""  OBD2_SCAN_TOOL
 SG_ PID_A0_Supported m128 : 24|1@0+ (1,0) [0|0] ""  OBD2_SCAN_TOOL
 SG_ NOxConcentrationB1S1Supported m131 : 24|1@0+ (1,0) [0|0] ""  OBD2_SCAN_TOOL
 SG_ NOxReagentSupported m133 : 24|1@0+ (1,0) [0|0] ""  OBD2_SCAN_TOOL
 SG_ PMConcentration_B1S1_Supported m134 : 24|1@0+ (1,0) [0|1] ""  OBD2_SCAN_TOOL
 SG_ PID_C0_Supported m160 : 24|1@0+ (1,0) [0|0] ""  OBD2_SCAN_TOOL
 SG_ PID_E0_Supported m192 : 24|1@0+ (1,0) [0|0] ""  OBD2_SCAN_TOOL
 SG_ EGR_A_DutyCyclePositionSupport m105 : 25|1@0+ (1,0) [0|1] ""  OBD2_SCAN_TOOL
 SG_ IAT_B1S2_Support m104 : 25|1@0+ (1,0) [0|1] ""  OBD2_SCAN_TOOL
 SG_ ECTSensorBSupport m103 : 25|1@0+ (1,0) [0|1] ""  OBD2_SCAN_TOOL
 SG_ MAFSensorBSupport m102 : 25|1@0+ (1,0) [0|1] ""  OBD2_SCAN_TOOL
 SG_ AutomaticTransmissionGearSt_0000 m101 : 25|1@0+ (1,0) [0|1] ""  OBD2_SCAN_TOOL
 SG_ PID_1F_Supported m0 : 25|1@0+ (1,0) [0|0] ""  OBD2_SCAN_TOOL
 SG_ O2_B1S2_Supported m19 : 25|1@0+ (1,0) [0|1] ""  OBD2_SCAN_TOOL
 SG_ PID_3F_Supported m32 : 25|1@0+ (1,0) [0|0] ""  OBD2_SCAN_TOOL
 SG_ PID_5F_Supported m64 : 25|1@0+ (1,0) [0|0] ""  OBD2_SCAN_TOOL
 SG_ PID_7F_Supported m96 : 25|1@0+ (1,0) [0|0] ""  OBD2_SCAN_TOOL
 SG_ PID_9F_Supported m128 : 25|1@0+ (1,0) [0|0] ""  OBD2_SCAN_TOOL
 SG_ NOxConcentrationB1S2Supported m131 : 25|1@0+ (1,0) [0|0] ""  OBD2_SCAN_TOOL
 SG_ NOxReagentDemandedSupported m133 : 25|1@0+ (1,0) [0|0] ""  OBD2_SCAN_TOOL
 SG_ PMConcentration_B2S1_Supported m134 : 25|1@0+ (1,0) [0|1] ""  OBD2_SCAN_TOOL
 SG_ IntakeManifoldAbsolutePress_0001 m135 : 25|1@0+ (1,0) [0|1] ""  OBD2_SCAN_TOOL
 SG_ PID_BF_Supported m160 : 25|1@0+ (1,0) [0|0] ""  OBD2_SCAN_TOOL
 SG_ PID_DF_Supported m192 : 25|1@0+ (1,0) [0|0] ""  OBD2_SCAN_TOOL
 SG_ EGR_A_ErrorSupport m105 : 26|1@0+ (1,0) [0|1] ""  OBD2_SCAN_TOOL
 SG_ IAT_B1S3_Support m104 : 26|1@0+ (1,0) [0|1] ""  OBD2_SCAN_TOOL
 SG_ ManualTransmissionGearStatu_0000 m101 : 26|1@0+ (1,0) [0|1] ""  OBD2_SCAN_TOOL
 SG_ PID_1E_Supported m0 : 26|1@0+ (1,0) [0|0] ""  OBD2_SCAN_TOOL
 SG_ O2_B1S3_Supported m19 : 26|1@0+ (1,0) [0|1] ""  OBD2_SCAN_TOOL
 SG_ PID_3E_Supported m32 : 26|1@0+ (1,0) [0|0] ""  OBD2_SCAN_TOOL
 SG_ PID_5E_Supported m64 : 26|1@0+ (1,0) [0|0] ""  OBD2_SCAN_TOOL
 SG_ PID_7E_Supported m96 : 26|1@0+ (1,0) [0|0] ""  OBD2_SCAN_TOOL
 SG_ PID_9E_Supported m128 : 26|1@0+ (1,0) [0|0] ""  OBD2_SCAN_TOOL
 SG_ NOxConcentrationB2S1Supported m131 : 26|1@0+ (1,0) [0|0] ""  OBD2_SCAN_TOOL
 SG_ NOxReagentLevelSupported m133 : 26|1@0+ (1,0) [0|0] ""  OBD2_SCAN_TOOL
 SG_ PID_BE_Supported m160 : 26|1@0+ (1,0) [0|0] ""  OBD2_SCAN_TOOL
 SG_ PID_DE_Supported m192 : 26|1@0+ (1,0) [0|0] ""  OBD2_SCAN_TOOL
 SG_ IAT_B2S1_Support m104 : 27|1@0+ (1,0) [0|1] ""  OBD2_SCAN_TOOL
 SG_ GlowPlugLampStatusSupport m101 : 27|1@0+ (1,0) [0|1] ""  OBD2_SCAN_TOOL
 SG_ PID_1D_Supported m0 : 27|1@0+ (1,0) [0|0] ""  OBD2_SCAN_TOOL
 SG_ O2_B1S4_Supported m19 : 27|1@0+ (1,0) [0|1] ""  OBD2_SCAN_TOOL
 SG_ PID_3D_Supported m32 : 27|1@0+ (1,0) [0|0] ""  OBD2_SCAN_TOOL
 SG_ PID_5D_Supported m64 : 27|1@0+ (1,0) [0|0] ""  OBD2_SCAN_TOOL
 SG_ PID_7D_Supported m96 : 27|1@0+ (1,0) [0|0] ""  OBD2_SCAN_TOOL
 SG_ PID_9D_Supported m128 : 27|1@0+ (1,0) [0|0] ""  OBD2_SCAN_TOOL
 SG_ NOxConcentrationB2S2Supported m131 : 27|1@0+ (1,0) [0|0] ""  OBD2_SCAN_TOOL
 SG_ NOxRuntimeWarningSupported m133 : 27|1@0+ (1,0) [0|0] ""  OBD2_SCAN_TOOL
 SG_ PID_BD_Supported m160 : 27|1@0+ (1,0) [0|0] ""  OBD2_SCAN_TOOL
 SG_ PID_DD_Supported m192 : 27|1@0+ (1,0) [0|0] ""  OBD2_SCAN_TOOL
 SG_ EGR_B_DutyCyclePositionSupport m105 : 28|1@0+ (1,0) [0|1] ""  OBD2_SCAN_TOOL
 SG_ IAT_B2S2_Support m104 : 28|1@0+ (1,0) [0|1] ""  OBD2_SCAN_TOOL
 SG_ PID_1C_Supported m0 : 28|1@0+ (1,0) [0|0] ""  OBD2_SCAN_TOOL
 SG_ IntakeManifoldAbsolutePressure m11 : 31|8@0+ (1,0) [0|255] "kPa"  OBD2_SCAN_TOOL
 SG_ O2_B2S1_Supported m19 : 28|1@0+ (1,0) [0|1] ""  OBD2_SCAN_TOOL
 SG_ PID_3C_Supported m32 : 28|1@0+ (1,0) [0|0] ""  OBD2_SCAN_TOOL
 SG_ PID_5C_Supported m64 : 28|1@0+ (1,0) [0|0] ""  OBD2_SCAN_TOOL
 SG_ PID_7C_Supported m96 : 28|1@0+ (1,0) [0|0] ""  OBD2_SCAN_TOOL
 SG_ PID_9C_Supported m128 : 28|1@0+ (1,0) [0|0] ""  OBD2_SCAN_TOOL
 SG_ PID_BC_Supported m160 : 28|1@0+ (1,0) [0|0] ""  OBD2_SCAN_TOOL
 SG_ PID_DC_Supported m192 : 28|1@0+ (1,0) [0|0] ""  OBD2_SCAN_TOOL
 SG_ EGR_B_ErrorSupport m105 : 29|1@0+ (1,0) [0|1] ""  OBD2_SCAN_TOOL
 SG_ IAT_B2S3_Support m104 : 29|1@0+ (1,0) [0|1] ""  OBD2_SCAN_TOOL
 SG_ PID_1B_Supported m0 : 29|1@0+ (1,0) [0|0] ""  OBD2_SCAN_TOOL
 SG_ O2_B2S2_Supported m19 : 29|1@0+ (1,0) [0|1] ""  OBD2_SCAN_TOOL
 SG_ PID_3B_Supported m32 : 29|1@0+ (1,0) [0|0] ""  OBD2_SCAN_TOOL
 SG_ PID_5B_Supported m64 : 29|1@0+ (1,0) [0|0] ""  OBD2_SCAN_TOOL
 SG_ PID_7B_Supported m96 : 29|1@0+ (1,0) [0|0] ""  OBD2_SCAN_TOOL
 SG_ PID_9B_Supported m128 : 29|1@0+ (1,0) [0|0] ""  OBD2_SCAN_TOOL
 SG_ PID_BB_Supported m160 : 29|1@0+ (1,0) [0|0] ""  OBD2_SCAN_TOOL
 SG_ PID_DB_Supported m192 : 29|1@0+ (1,0) [0|0] ""  OBD2_SCAN_TOOL
 SG_ PID_1A_Supported m0 : 30|1@0+ (1,0) [0|0] ""  OBD2_SCAN_TOOL
 SG_ O2_B2S3_Supported m19 : 30|1@0+ (1,0) [0|1] ""  OBD2_SCAN_TOOL
 SG_ PID_3A_Supported m32 : 30|1@0+ (1,0) [0|0] ""  OBD2_SCAN_TOOL
 SG_ PID_5A_Supported m64 : 30|1@0+ (1,0) [0|0] ""  OBD2_SCAN_TOOL
 SG_ PID_7A_Supported m96 : 30|1@0+ (1,0) [0|0] ""  OBD2_SCAN_TOOL
 SG_ PID_9A_Supported m128 : 30|1@0+ (1,0) [0|0] ""  OBD2_SCAN_TOOL
 SG_ PID_BA_Supported m160 : 30|1@0+ (1,0) [0|0] ""  OBD2_SCAN_TOOL
 SG_ PID_DA_Supported m192 : 30|1@0+ (1,0) [0|0] ""  OBD2_SCAN_TOOL
 SG_ MaximumValueForMassAirFlowSensor m80 : 31|8@0+ (10,0) [0|2550] "g/s"  OBD2_SCAN_TOOL
 SG_ MaximumValueForEquivalenceRatio m79 : 31|8@0+ (1,0) [0|255] "?"  OBD2_SCAN_TOOL
 SG_ PID_19_Supported m0 : 31|1@0+ (1,0) [0|0] ""  OBD2_SCAN_TOOL
 SG_ MonitorStatus m1 : 31|32@0+ (1,0) [0|4294967295] ""  OBD2_SCAN_TOOL
 SG_ FreezeDTC m2 : 31|16@0+ (1,0) [0|65535] ""  OBD2_SCAN_TOOL
 SG_ FuelSystem1Status m3 : 31|8@0+ (1,0) [0|255] ""  OBD2_SCAN_TOOL
 SG_ CalculatedEngineLoad m4 : 31|8@0+ (0.39216,0) [0|100] "%"  OBD2_SCAN_TOOL
 SG_ EngineCoolantTemp m5 : 31|8@0+ (1,-40) [-40|215] "°C"  OBD2_SCAN_TOOL
 SG_ ShortTermFuelTrim_B1 m6 : 31|8@0+ (0.78125,-100) [-100|99.21875] "%"  OBD2_SCAN_TOOL
 SG_ LongTermFuelTrim_B1 m7 : 31|8@0+ (0.78125,-100) [-100|99.21875] "%"  OBD2_SCAN_TOOL
 SG_ ShortTermFuelTrim_B2 m8 : 31|8@0+ (0.78125,-100) [-100|99.21875] "%"  OBD2_SCAN_TOOL
 SG_ LongTermFuelTrim_B2 m9 : 31|8@0+ (0.78125,-100) [-100|99.21875] "%"  OBD2_SCAN_TOOL
 SG_ FuelPressure m10 : 31|8@0+ (3,0) [0|765] "kPa"  OBD2_SCAN_TOOL
 SG_ EngineRPM m12 : 31|16@0+ (0.25,0) [0|16383.75] "rpm"  OBD2_SCAN_TOOL
 SG_ VehicleSpeed m13 : 31|8@0+ (1,0) [0|255] "km/h"  OBD2_SCAN_TOOL
 SG_ TimingAdvance m14 : 31|8@0+ (0.5,-64) [-64|63.5] "°"  OBD2_SCAN_TOOL
 SG_ IntakeAirTemp m15 : 31|8@0+ (1,-40) [-40|215] "°C"  OBD2_SCAN_TOOL
 SG_ MAFAirFlowRate m16 : 31|16@0+ (0.01,0) [0|655.35] "grams/sec"  OBD2_SCAN_TOOL
 SG_ ThrottlePosition m17 : 31|8@0+ (0.39216,0) [0|100] "%"  OBD2_SCAN_TOOL
 SG_ CommandSecondaryAirStatus m18 : 31|8@0+ (1,0) [0|255] ""  OBD2_SCAN_TOOL
 SG_ O2_B2S4_Supported m19 : 31|1@0+ (1,0) [0|1] ""  OBD2_SCAN_TOOL
 SG_ O2_B1S1_Volt m20 : 31|8@0+ (0.005,0) [0|1.275] "volts"  OBD2_SCAN_TOOL
 SG_ O2_B1S2_Volt m21 : 31|8@0+ (0.005,0) [0|1.275] "volts"  OBD2_SCAN_TOOL
 SG_ O2_B1S3_Volt m22 : 31|8@0+ (0.005,0) [0|1.275] "volts"  OBD2_SCAN_TOOL
 SG_ O2_B1S4_Volt m23 : 31|8@0+ (0.005,0) [0|1.275] "volts"  OBD2_SCAN_TOOL
 SG_ O2_B2S1_Volt m24 : 31|8@0+ (0.005,0) [0|1.275] "volts"  OBD2_SCAN_TOOL
 SG_ O2_B2S2_Volt m25 : 31|8@0+ (0.005,0) [0|1.275] "volts"  OBD2_SCAN_TOOL
 SG_ O2_B2S3_Volt m26 : 31|8@0+ (0.005,0) [0|1.275] "volts"  OBD2_SCAN_TOOL
 SG_ O2_B2S4_Volt m27 : 31|8@0+ (0.005,0) [0|1.275] "volts"  OBD2_SCAN_TOOL
 SG_ OBDStandard m28 : 31|8@0+ (1,0) [0|255] ""  OBD2_SCAN_TOOL
 SG_ TimeSinceEngineStart m31 : 31|16@0+ (1,0) [0|65535] "seconds"  OBD2_SCAN_TOOL
 SG_ PID_39_Supported m32 : 31|1@0+ (1,0) [0|0] ""  OBD2_SCAN_TOOL
 SG_ DistanceMILOn m33 : 31|16@0+ (1,0) [0|65535] "km"  OBD2_SCAN_TOOL
 SG_ FuelRailPressureRelativeToM_0000 m34 : 31|16@0+ (0.079,0) [0|5177.265] "kPa"  OBD2_SCAN_TOOL
 SG_ FuelRailPressure m35 : 31|16@0+ (10,0) [0|655350] "kPa"  OBD2_SCAN_TOOL
 SG_ CommandEGR m44 : 31|8@0+ (0.392156862745098,0) [0|100] "%"  OBD2_SCAN_TOOL
 SG_ EGRError m45 : 31|8@0+ (0.78125,-100) [-100|99.21875] "%"  OBD2_SCAN_TOOL
 SG_ CommandEVAPPurge m46 : 31|8@0+ (0.392156862745098,0) [0|100] "%"  OBD2_SCAN_TOOL
 SG_ FuelTankLevel m47 : 31|8@0+ (0.392156862745098,0) [0|100] "%"  OBD2_SCAN_TOOL
 SG_ WarmUpsSinceCodeClear m48 : 31|8@0+ (1,0) [0|255] "count"  OBD2_SCAN_TOOL
 SG_ DistanceSinceCodeClear m49 : 31|16@0+ (1,0) [0|65535] "km"  OBD2_SCAN_TOOL
 SG_ EVAPSystemVaporPressure m50 : 31|16@0- (0.25,0) [-8192|8191.75] "Pa"  OBD2_SCAN_TOOL
 SG_ AbsoluteBarometricPressure m51 : 31|8@0+ (1,0) [0|255] "kpa"  OBD2_SCAN_TOOL
 SG_ O2_B1S1_WB_Lambda m52 : 31|16@0+ (3.0517578125E-005,0) [0|2] "?"  OBD2_SCAN_TOOL
 SG_ O2_B1S2_WB_Lambda m53 : 31|16@0+ (3.0517578125E-005,0) [0|2] "?"  OBD2_SCAN_TOOL
 SG_ O2_B1S3_WB_Lambda m54 : 31|16@0+ (3.0517578125E-005,0) [0|2] "?"  OBD2_SCAN_TOOL
 SG_ O2_B1S4_WB_Lambda m55 : 31|16@0+ (3.0517578125E-005,0) [0|2] "?"  OBD2_SCAN_TOOL
 SG_ O2_B2S1_WB_Lambda m56 : 31|16@0+ (3.0517578125E-005,0) [0|2] "?"  OBD2_SCAN_TOOL
 SG_ O2_B2S2_WB_Lambda m57 : 31|16@0+ (3.0517578125E-005,0) [0|2] "?"  OBD2_SCAN_TOOL
 SG_ O2_B2S3_WB_Lambda m58 : 31|16@0+ (3.0517578125E-005,0) [0|2] "?"  OBD2_SCAN_TOOL
 SG_ O2_B2S4_WB_Lambda m59 : 31|16@0+ (3.0517578125E-005,0) [0|2] "?"  OBD2_SCAN_TOOL
 SG_ CatalystTemperature_B1S1 m60 : 31|16@0+ (0.1,-40) [-40|6513.5] "°C"  OBD2_SCAN_TOOL
 SG_ CatalystTemperature_B2S1 m61 : 31|16@0+ (0.1,-40) [-40|6513.5] "°C"  OBD2_SCAN_TOOL
 SG_ CatalystTemperature_B1S2 m62 : 31|16@0+ (0.1,-40) [-40|6513.5] "°C"  OBD2_SCAN_TOOL
 SG_ CatalystTemperature_B2S2 m63 : 31|16@0+ (0.1,-40) [-40|6513.5] "°C"  OBD2_SCAN_TOOL
 SG_ PID_59_Supported m64 : 31|1@0+ (1,0) [0|0] ""  OBD2_SCAN_TOOL
 SG_ ControlModuleVolt m66 : 31|16@0+ (0.001,0) [0|65.535] "V"  OBD2_SCAN_TOOL
 SG_ AbsoluteLoadValue m67 : 31|16@0+ (0.392156862745098,0) [0|25700] "%"  OBD2_SCAN_TOOL
 SG_ FuelAirCommandedLambda m68 : 31|16@0+ (3.0517578125E-005,0) [0|2] "?"  OBD2_SCAN_TOOL
 SG_ RelativeThrottlePosition m69 : 31|8@0+ (0.392156862745098,0) [0|100] "%"  OBD2_SCAN_TOOL
 SG_ AmbientAirTemp m70 : 31|8@0+ (1,-40) [-40|215] "°C"  OBD2_SCAN_TOOL
 SG_ AbsoluteThrottlePositionB m71 : 31|8@0+ (0.392156862745098,0) [0|100] "%"  OBD2_SCAN_TOOL
 SG_ AbsoluteThrottlePositionC m72 : 31|8@0+ (0.392156862745098,0) [0|100] "%"  OBD2_SCAN_TOOL
 SG_ AbsoluteThrottlePositionD m73 : 31|8@0+ (0.392156862745098,0) [0|100] "%"  OBD2_SCAN_TOOL
 SG_ AbsoluteThrottlePositionE m74 : 31|8@0+ (0.392156862745098,0) [0|100] "%"  OBD2_SCAN_TOOL
 SG_ AbsoluteThrottlePositionF m75 : 31|8@0+ (0.392156862745098,0) [0|100] "%"  OBD2_SCAN_TOOL
 SG_ CommandThrottleActuator m76 : 31|8@0+ (0.392156862745098,0) [0|100] "%"  OBD2_SCAN_TOOL
 SG_ TimeRunMILOn m77 : 31|16@0+ (1,0) [0|65535] "minutes"  OBD2_SCAN_TOOL
 SG_ TimeSinceCodeClear m78 : 31|16@0+ (1,0) [0|65535] "minutes"  OBD2_SCAN_TOOL
 SG_ FuelType m81 : 31|8@0+ (1,0) [0|255] ""  OBD2_SCAN_TOOL
 SG_ EthanolFuelPct m82 : 31|8@0+ (0.392156862745098,0) [0|100] "%"  OBD2_SCAN_TOOL
 SG_ AbsoluteEVAPSystemVaporPressure m83 : 31|16@0+ (0.005,0) [0|327.675] "kPa"  OBD2_SCAN_TOOL
 SG_ EvapSysVapPres m84 : 31|16@0+ (1,-32767) [-32767|32768] "Pa"  OBD2_SCAN_TOOL
 SG_ O2Secondary_B1_ShortTermFuelTrim m85 : 31|8@0+ (0.78125,-100) [-100|99.21875] "%"  OBD2_SCAN_TOOL
 SG_ O2Secondary_B1_LongTermFuelTrim m86 : 31|8@0+ (0.78125,-100) [-100|99.21875] "%"  OBD2_SCAN_TOOL
 SG_ O2Secondary_B2_ShortTermFuelTrim m87 : 31|8@0+ (0.78125,-100) [-100|99.21875] "%"  OBD2_SCAN_TOOL
 SG_ O2Secondary_B2_LongTermFuelTrim m88 : 31|8@0+ (0.78125,-100) [-100|99.21875] "%"  OBD2_SCAN_TOOL
 SG_ FuelRailPressureAbsolute m89 : 31|16@0+ (10,0) [0|655350] "kPa"  OBD2_SCAN_TOOL
 SG_ RelativeAcceleratorPedalPosition m90 : 31|8@0+ (0.392156862745098,0) [0|100] "%"  OBD2_SCAN_TOOL
 SG_ HybridBattteryPackRemainingLife m91 : 31|8@0+ (0.392156862745098,0) [0|100] "%"  OBD2_SCAN_TOOL
 SG_ EngineOilTemp m92 : 31|8@0+ (1,-40) [-40|215] "°C"  OBD2_SCAN_TOOL
 SG_ FuelInjectionTiming m93 : 31|16@0+ (0.0078125,-210) [-210|301.9921875] "°"  OBD2_SCAN_TOOL
 SG_ EngineFuelRate m94 : 31|16@0+ (0.05,0) [0|3276.75] "L/h"  OBD2_SCAN_TOOL
 SG_ EmissionRequirements m95 : 31|8@0+ (1,0) [0|255] ""  OBD2_SCAN_TOOL
 SG_ PID_79_Supported m96 : 31|1@0+ (1,0) [0|0] ""  OBD2_SCAN_TOOL
 SG_ EngineTorqueDemand m97 : 31|8@0+ (1,-125) [-125|130] "%"  OBD2_SCAN_TOOL
 SG_ EngineTorque m98 : 31|8@0+ (1,-125) [-125|130] "%"  OBD2_SCAN_TOOL
 SG_ EngineTorqueReference m99 : 31|16@0+ (1,0) [0|65535] "Nm"  OBD2_SCAN_TOOL
 SG_ EngineTorqueIdle m100 : 31|8@0+ (1,-125) [-125|130] "%"  OBD2_SCAN_TOOL
 SG_ CmdDieselIntAir m106 : 31|8@0+ (1,0) [0|255] ""  OBD2_SCAN_TOOL
 SG_ ExhaustGasTemp m107 : 31|8@0+ (1,0) [0|255] ""  OBD2_SCAN_TOOL
 SG_ CommandThrottleActuatorRelative m108 : 31|8@0+ (1,0) [0|255] ""  OBD2_SCAN_TOOL
 SG_ FuelPresContrSys m109 : 31|8@0+ (1,0) [0|255] ""  OBD2_SCAN_TOOL
 SG_ InjPresContrSys m110 : 31|8@0+ (1,0) [0|255] ""  OBD2_SCAN_TOOL
 SG_ TurboCompressorPressure m111 : 31|8@0+ (1,0) [0|255] ""  OBD2_SCAN_TOOL
 SG_ BoostPresCntrl m112 : 31|8@0+ (1,0) [0|255] ""  OBD2_SCAN_TOOL
 SG_ PID_99_Supported m128 : 31|1@0+ (1,0) [0|0] ""  OBD2_SCAN_TOOL
 SG_ IntakeManifoldSurfaceTemperature m132 : 31|8@0+ (1,-40) [-40|215] "°C"  OBD2_SCAN_TOOL
 SG_ EngineFrictionTorque m142 : 31|8@0+ (1,-125) [-125|130] "%"  OBD2_SCAN_TOOL
 SG_ PID_B9_Supported m160 : 31|1@0+ (1,0) [0|0] ""  OBD2_SCAN_TOOL
 SG_ Odometer m166 : 31|32@0+ (1,0) [0|4294967295] "km"  OBD2_SCAN_TOOL
 SG_ PID_D9_Supported m192 : 31|1@0+ (1,0) [0|0] ""  OBD2_SCAN_TOOL
 SG_ S2_PID_02_FreezeDTC m2 : 31|16@0+ (1,0) [0|65535] ""  OBD2_SCAN_TOOL
 SG_ pid m1M : 23|8@0+ (1,0) [0|255] ""  OBD2_SCAN_TOOL
 SG_ ParameterID_Service02 m2M : 23|8@0+ (1,0) [0|255] ""  OBD2_SCAN_TOOL
 SG_ mode M : 11|4@0+ (1,0) [0|15] ""  OBD2_SCAN_TOOL
 SG_ response : 15|4@0+ (1,0) [0|15] ""  OBD2_SCAN_TOOL
 SG_ length : 7|8@0+ (1,0) [0|255] ""  OBD2_SCAN_TOOL

CM_ SG_ 2024 MonitorStatus "Monitor status since DTCs cleared (includes malfunction indicator lamp (MIL) status and number of DTCs) ";
BA_DEF_  "VersionYear" INT 0 99;
BA_DEF_  "VersionDay" INT 1 31;
BA_DEF_  "VersionMonth" INT 1 12;
BA_DEF_  "VersionWeek" INT 0 52;
BA_DEF_  "VersionNumber" INT 0 2147483647;
BA_DEF_  "DBName" STRING ;
BA_DEF_  "BusType" STRING ;
BA_DEF_  "Manufacturer" STRING ;
BA_DEF_ BO_  "VFrameFormat" ENUM  "StandardCAN","ExtendedCAN","reserved","J1939PG";
BA_DEF_ SG_  "GenSigStartValue" INT 0 2147483647;
BA_DEF_ SG_  "SystemSignalLongSymbol" STRING ;
BA_DEF_DEF_  "VersionYear" 0;
BA_DEF_DEF_  "VersionDay" 0;
BA_DEF_DEF_  "VersionMonth" 0;
BA_DEF_DEF_  "VersionWeek" 0;
BA_DEF_DEF_  "VersionNumber" 0;
BA_DEF_DEF_  "DBName" "";
BA_DEF_DEF_  "BusType" "";
BA_DEF_DEF_  "Manufacturer" "";
BA_DEF_DEF_  "VFrameFormat" "";
BA_DEF_DEF_  "GenSigStartValue" 0;
BA_DEF_DEF_  "SystemSignalLongSymbol" "";
BA_ "Manufacturer" "SAE";
BA_ "BusType" "CAN";
BA_ "VersionNumber" 100;
BA_ "VersionWeek" 6;
BA_ "VersionMonth" 2;
BA_ "VersionDay" 18;
BA_ "VersionYear" 2021;
BA_ "DBName" "OBDII";
BA_ "VFrameFormat" BO_ 2015 0;
BA_ "VFrameFormat" BO_ 2024 0;
BA_ "SystemSignalLongSymbol" SG_ 2015 SecondaryAir_BoostPressureMonito "SecondaryAir_BoostPressureMonitorStatus";
BA_ "SystemSignalLongSymbol" SG_ 2015 MaximumValueForIntakeManifoldAbs "MaximumValueForIntakeManifoldAbsolutePressure";
BA_ "SystemSignalLongSymbol" SG_ 2015 SecondaryAir_BoostPressureM_0000 "SecondaryAir_BoostPressureMonitorEnabled";
BA_ "SystemSignalLongSymbol" SG_ 2015 MaximumValueForOxygenSensorCurre "MaximumValueForOxygenSensorCurrent";
BA_ "SystemSignalLongSymbol" SG_ 2015 MaximumValueForOxygenSensorVolta "MaximumValueForOxygenSensorVoltage";
BA_ "SystemSignalLongSymbol" SG_ 2015 AutomaticTransmissionGearStatusS "AutomaticTransmissionGearStatusSupport";
BA_ "SystemSignalLongSymbol" SG_ 2015 IntakeManifoldAbsolutePressureSu "IntakeManifoldAbsolutePressureSupportedB";
BA_ "SystemSignalLongSymbol" SG_ 2015 ManualTransmissionGearStatusSupp "ManualTransmissionGearStatusSupport";
BA_ "SystemSignalLongSymbol" SG_ 2015 FuelRailPressureRelativeToManifo "FuelRailPressureRelativeToManifoldVacuum";
BA_ "GenSigStartValue" SG_ 2015 mode 1;
BA_ "GenSigStartValue" SG_ 2015 length_tx 2;
BA_ "SystemSignalLongSymbol" SG_ 2024 SecondaryAir_BoostPressureM_0001 "SecondaryAir_BoostPressureMonitorStatus";
BA_ "SystemSignalLongSymbol" SG_ 2024 MaximumValueForIntakeManifo_0000 "MaximumValueForIntakeManifoldAbsolutePressure";
BA_ "SystemSignalLongSymbol" SG_ 2024 SecondaryAir_BoostPressureM_0002 "SecondaryAir_BoostPressureMonitorEnabled";
BA_ "SystemSignalLongSymbol" SG_ 2024 MaximumValueForOxygenSensor_0000 "MaximumValueForOxygenSensorCurrent";
BA_ "SystemSignalLongSymbol" SG_ 2024 MaximumValueForOxygenSensor_0001 "MaximumValueForOxygenSensorVoltage";
BA_ "SystemSignalLongSymbol" SG_ 2024 IntakeManifoldAbsolutePress_0000 "IntakeManifoldAbsolutePressureSupportedA";
BA_ "SystemSignalLongSymbol" SG_ 2024 AutomaticTransmissionGearSt_0000 "AutomaticTransmissionGearStatusSupport";
BA_ "SystemSignalLongSymbol" SG_ 2024 IntakeManifoldAbsolutePress_0001 "IntakeManifoldAbsolutePressureSupportedB";
BA_ "SystemSignalLongSymbol" SG_ 2024 ManualTransmissionGearStatu_0000 "ManualTransmissionGearStatusSupport";
BA_ "SystemSignalLongSymbol" SG_ 2024 FuelRailPressureRelativeToM_0000 "FuelRailPressureRelativeToManifoldVacuum";
VAL_ 2015 PID_08_Supported 1 "Supported" 0 "Unsupported" ;
VAL_ 2015 PID_28_Supported 1 "Supported" 0 "Unsupported" ;
VAL_ 2015 PID_48_Supported 1 "Supported" 0 "Unsupported" ;
VAL_ 2015 Cat_NMHCCatMonitorStatus 1 "Not Complete" 0 "Complete" ;
VAL_ 2015 PID_68_Supported 1 "Supported" 0 "Unsupported" ;
VAL_ 2015 PID_88_Supported 1 "Supported" 0 "Unsupported" ;
VAL_ 2015 PID_A8_Supported 1 "Supported" 0 "Unsupported" ;
VAL_ 2015 PID_C8_Supported 1 "Supported" 0 "Unsupported" ;
VAL_ 2015 PID_07_Supported 1 "Supported" 0 "Unsupported" ;
VAL_ 2015 PID_27_Supported 1 "Supported" 0 "Unsupported" ;
VAL_ 2015 PID_47_Supported 1 "Supported" 0 "Unsupported" ;
VAL_ 2015 HeatedCat_NOxSCRMonitorStatus 1 "Not Complete" 0 "Complete" ;
VAL_ 2015 PID_67_Supported 1 "Supported" 0 "Unsupported" ;
VAL_ 2015 PID_87_Supported 1 "Supported" 0 "Unsupported" ;
VAL_ 2015 PID_A7_Supported 1 "Supported" 0 "Unsupported" ;
VAL_ 2015 PID_C7_Supported 1 "Supported" 0 "Unsupported" ;
VAL_ 2015 PID_06_Supported 1 "Supported" 0 "Unsupported" ;
VAL_ 2015 PID_26_Supported 1 "Supported" 0 "Unsupported" ;
VAL_ 2015 PID_46_Supported 1 "Supported" 0 "Unsupported" ;
VAL_ 2015 EvapMonitorStatus 1 "Not Complete" 0 "Complete" ;
VAL_ 2015 PID_66_Supported 1 "Supported" 0 "Unsupported" ;
VAL_ 2015 PID_86_Supported 1 "Supported" 0 "Unsupported" ;
VAL_ 2015 PID_A6_Supported 1 "Supported" 0 "Unsupported" ;
VAL_ 2015 PID_C6_Supported 1 "Supported" 0 "Unsupported" ;
VAL_ 2015 PID_05_Supported 1 "Supported" 0 "Unsupported" ;
VAL_ 2015 PID_25_Supported 1 "Supported" 0 "Unsupported" ;
VAL_ 2015 PID_45_Supported 1 "Supported" 0 "Unsupported" ;
VAL_ 2015 SecondaryAir_BoostPressureMonito 1 "Not Complete" 0 "Complete" ;
VAL_ 2015 PID_65_Supported 1 "Supported" 0 "Unsupported" ;
VAL_ 2015 PID_85_Supported 1 "Supported" 0 "Unsupported" ;
VAL_ 2015 PID_A5_Supported 1 "Supported" 0 "Unsupported" ;
VAL_ 2015 PID_C5_Supported 1 "Supported" 0 "Unsupported" ;
VAL_ 2015 PID_04_Supported 1 "Supported" 0 "Unsupported" ;
VAL_ 2015 PID_24_Supported 1 "Supported" 0 "Unsupported" ;
VAL_ 2015 PID_44_Supported 1 "Supported" 0 "Unsupported" ;
VAL_ 2015 PID_64_Supported 1 "Supported" 0 "Unsupported" ;
VAL_ 2015 PID_84_Supported 1 "Supported" 0 "Unsupported" ;
VAL_ 2015 PID_A4_Supported 1 "Supported" 0 "Unsupported" ;
VAL_ 2015 PID_C4_Supported 1 "Supported" 0 "Unsupported" ;
VAL_ 2015 PID_03_Supported 1 "Supported" 0 "Unsupported" ;
VAL_ 2015 PID_23_Supported 1 "Supported" 0 "Unsupported" ;
VAL_ 2015 PID_43_Supported 1 "Supported" 0 "Unsupported" ;
VAL_ 2015 O2_ExhaustGasMonitorStatus 1 "Not Complete" 0 "Complete" ;
VAL_ 2015 PID_63_Supported 1 "Supported" 0 "Unsupported" ;
VAL_ 2015 PID_83_Supported 1 "Supported" 0 "Unsupported" ;
VAL_ 2015 PID_A3_Supported 1 "Supported" 0 "Unsupported" ;
VAL_ 2015 PID_C3_Supported 1 "Supported" 0 "Unsupported" ;
VAL_ 2015 PID_02_Supported 1 "Supported" 0 "Unsupported" ;
VAL_ 2015 PID_22_Supported 1 "Supported" 0 "Unsupported" ;
VAL_ 2015 PID_42_Supported 1 "Supported" 0 "Unsupported" ;
VAL_ 2015 O2_PMFilterMonitorStatus 1 "Not Complete" 0 "Complete" ;
VAL_ 2015 PID_62_Supported 1 "Supported" 0 "Unsupported" ;
VAL_ 2015 PID_82_Supported 1 "Supported" 0 "Unsupported" ;
VAL_ 2015 PID_A2_Supported 1 "Supported" 0 "Unsupported" ;
VAL_ 2015 PID_C2_Supported 1 "Supported" 0 "Unsupported" ;
VAL_ 2015 PID_01_Supported 1 "Supported" 0 "Unsupported" ;
VAL_ 2015 PID_21_Supported 1 "Supported" 0 "Unsupported" ;
VAL_ 2015 PID_41_Supported 1 "Supported" 0 "Unsupported" ;
VAL_ 2015 EGR_VVTMonitorStatus 1 "Not Complete" 0 "Complete" ;
VAL_ 2015 PID_61_Supported 1 "Supported" 0 "Unsupported" ;
VAL_ 2015 PID_81_Supported 1 "Supported" 0 "Unsupported" ;
VAL_ 2015 PID_A1_Supported 1 "Supported" 0 "Unsupported" ;
VAL_ 2015 PID_C1_Supported 1 "Supported" 0 "Unsupported" ;
VAL_ 2015 PID_10_Supported 1 "Supported" 0 "Unsupported" ;
VAL_ 2015 PID_30_Supported 1 "Supported" 0 "Unsupported" ;
VAL_ 2015 PID_50_Supported 1 "Supported" 0 "Unsupported" ;
VAL_ 2015 Cat_NMHCCatMonitorEnabled 1 "True" 0 "False" ;
VAL_ 2015 PID_70_Supported 1 "Supported" 0 "Unsupported" ;
VAL_ 2015 PID_90_Supported 1 "Supported" 0 "Unsupported" ;
VAL_ 2015 PID_B0_Supported 1 "Supported" 0 "Unsupported" ;
VAL_ 2015 PID_D0_Supported 1 "Supported" 0 "Unsupported" ;
VAL_ 2015 PID_0F_Supported 1 "Supported" 0 "Unsupported" ;
VAL_ 2015 PID_2F_Supported 1 "Supported" 0 "Unsupported" ;
VAL_ 2015 PID_4F_Supported 1 "Supported" 0 "Unsupported" ;
VAL_ 2015 HeatedCat_NOxSCRMonitorEnabled 1 "True" 0 "False" ;
VAL_ 2015 PID_6F_Supported 1 "Supported" 0 "Unsupported" ;
VAL_ 2015 PID_8F_Supported 1 "Supported" 0 "Unsupported" ;
VAL_ 2015 PID_AF_Supported 1 "Supported" 0 "Unsupported" ;
VAL_ 2015 PID_CF_Supported 1 "Supported" 0 "Unsupported" ;
VAL_ 2015 PID_0E_Supported 1 "Supported" 0 "Unsupported" ;
VAL_ 2015 PID_2E_Supported 1 "Supported" 0 "Unsupported" ;
VAL_ 2015 PID_4E_Supported 1 "Supported" 0 "Unsupported" ;
VAL_ 2015 EvapMonitorEnabled 1 "True" 0 "False" ;
VAL_ 2015 PID_6E_Supported 1 "Supported" 0 "Unsupported" ;
VAL_ 2015 PID_8E_Supported 1 "Supported" 0 "Unsupported" ;
VAL_ 2015 PID_AE_Supported 1 "Supported" 0 "Unsupported" ;
VAL_ 2015 PID_CE_Supported 1 "Supported" 0 "Unsupported" ;
VAL_ 2015 PID_0D_Supported 1 "Supported" 0 "Unsupported" ;
VAL_ 2015 PID_2D_Supported 1 "Supported" 0 "Unsupported" ;
VAL_ 2015 PID_4D_Supported 1 "Supported" 0 "Unsupported" ;
VAL_ 2015 SecondaryAir_BoostPressureM_0000 1 "True" 0 "False" ;
VAL_ 2015 PID_6D_Supported 1 "Supported" 0 "Unsupported" ;
VAL_ 2015 PID_8D_Supported 1 "Supported" 0 "Unsupported" ;
VAL_ 2015 PID_AD_Supported 1 "Supported" 0 "Unsupported" ;
VAL_ 2015 PID_CD_Supported 1 "Supported" 0 "Unsupported" ;
VAL_ 2015 PID_0C_Supported 1 "Supported" 0 "Unsupported" ;
VAL_ 2015 PID_2C_Supported 1 "Supported" 0 "Unsupported" ;
VAL_ 2015 PID_4C_Supported 1 "Supported" 0 "Unsupported" ;
VAL_ 2015 PID_6C_Supported 1 "Supported" 0 "Unsupported" ;
VAL_ 2015 PID_8C_Supported 1 "Supported" 0 "Unsupported" ;
VAL_ 2015 PID_AC_Supported 1 "Supported" 0 "Unsupported" ;
VAL_ 2015 PID_CC_Supported 1 "Supported" 0 "Unsupported" ;
VAL_ 2015 PID_0B_Supported 1 "Supported" 0 "Unsupported" ;
VAL_ 2015 PID_2B_Supported 1 "Supported" 0 "Unsupported" ;
VAL_ 2015 PID_4B_Supported 1 "Supported" 0 "Unsupported" ;
VAL_ 2015 O2_ExhaustGasMonitorEnabled 1 "True" 0 "False" ;
VAL_ 2015 PID_6B_Supported 1 "Supported" 0 "Unsupported" ;
VAL_ 2015 PID_8B_Supported 1 "Supported" 0 "Unsupported" ;
VAL_ 2015 PID_AB_Supported 1 "Supported" 0 "Unsupported" ;
VAL_ 2015 PID_CB_Supported 1 "Supported" 0 "Unsupported" ;
VAL_ 2015 PID_0A_Supported 1 "Supported" 0 "Unsupported" ;
VAL_ 2015 PID_2A_Supported 1 "Supported" 0 "Unsupported" ;
VAL_ 2015 PID_4A_Supported 1 "Supported" 0 "Unsupported" ;
VAL_ 2015 O2Heater_PMFilterMonitorEnabled 1 "True" 0 "False" ;
VAL_ 2015 PID_6A_Supported 1 "Supported" 0 "Unsupported" ;
VAL_ 2015 PID_8A_Supported 1 "Supported" 0 "Unsupported" ;
VAL_ 2015 PID_AA_Supported 1 "Supported" 0 "Unsupported" ;
VAL_ 2015 PID_CA_Supported 1 "Supported" 0 "Unsupported" ;
VAL_ 2015 PID_09_Supported 1 "Supported" 0 "Unsupported" ;
VAL_ 2015 PID_29_Supported 1 "Supported" 0 "Unsupported" ;
VAL_ 2015 PID_49_Supported 1 "Supported" 0 "Unsupported" ;
VAL_ 2015 EGR_VVTSystemMonitorEnabled 1 "True" 0 "False" ;
VAL_ 2015 PID_69_Supported 1 "Supported" 0 "Unsupported" ;
VAL_ 2015 PID_89_Supported 1 "Supported" 0 "Unsupported" ;
VAL_ 2015 PID_A9_Supported 1 "Supported" 0 "Unsupported" ;
VAL_ 2015 PID_C9_Supported 1 "Supported" 0 "Unsupported" ;
VAL_ 2015 PTOStatus2 1 "Enabled" 0 "Disabled" ;
VAL_ 2015 PID_18_Supported 1 "Supported" 0 "Unsupported" ;
VAL_ 2015 PID_38_Supported 1 "Supported" 0 "Unsupported" ;
VAL_ 2015 PID_58_Supported 1 "Supported" 0 "Unsupported" ;
VAL_ 2015 MisfireMonitorEnabled 1 "True" 0 "False" ;
VAL_ 2015 PID_78_Supported 1 "Supported" 0 "Unsupported" ;
VAL_ 2015 PID_98_Supported 1 "Supported" 0 "Unsupported" ;
VAL_ 2015 PID_B8_Supported 1 "Supported" 0 "Unsupported" ;
VAL_ 2015 PID_D8_Supported 1 "Supported" 0 "Unsupported" ;
VAL_ 2015 AutomaticTransmissionGearStatus 1 "In Gear" 0 "Park/Neutral" ;
VAL_ 2015 PID_17_Supported 1 "Supported" 0 "Unsupported" ;
VAL_ 2015 PID_37_Supported 1 "Supported" 0 "Unsupported" ;
VAL_ 2015 PID_57_Supported 1 "Supported" 0 "Unsupported" ;
VAL_ 2015 FuelSystemMonitorEnabled 1 "True" 0 "False" ;
VAL_ 2015 PID_77_Supported 1 "Supported" 0 "Unsupported" ;
VAL_ 2015 PID_97_Supported 1 "Supported" 0 "Unsupported" ;
VAL_ 2015 PID_B7_Supported 1 "Supported" 0 "Unsupported" ;
VAL_ 2015 PID_D7_Supported 1 "Supported" 0 "Unsupported" ;
VAL_ 2015 ManualTransmissionGearStatus 1 "In Gear" 0 "Park/Neutral" ;
VAL_ 2015 PID_16_Supported 1 "Supported" 0 "Unsupported" ;
VAL_ 2015 PID_36_Supported 1 "Supported" 0 "Unsupported" ;
VAL_ 2015 PID_56_Supported 1 "Supported" 0 "Unsupported" ;
VAL_ 2015 CompComponentMonitorEnabled 1 "True" 0 "False" ;
VAL_ 2015 PID_76_Supported 1 "Supported" 0 "Unsupported" ;
VAL_ 2015 PID_96_Supported 1 "Supported" 0 "Unsupported" ;
VAL_ 2015 PID_B6_Supported 1 "Supported" 0 "Unsupported" ;
VAL_ 2015 PID_D6_Supported 1 "Supported" 0 "Unsupported" ;
VAL_ 2015 GlowPlugLampStatus 1 "On" 0 "Off" ;
VAL_ 2015 PID_15_Supported 1 "Supported" 0 "Unsupported" ;
VAL_ 2015 PID_35_Supported 1 "Supported" 0 "Unsupported" ;
VAL_ 2015 PID_55_Supported 1 "Supported" 0 "Unsupported" ;
VAL_ 2015 IgnitionMonitorType 1 "Compression ignition monitor" 0 "Spark ignition monitor" ;
VAL_ 2015 PID_75_Supported 1 "Supported" 0 "Unsupported" ;
VAL_ 2015 PID_95_Supported 1 "Supported" 0 "Unsupported" ;
VAL_ 2015 PID_B5_Supported 1 "Supported" 0 "Unsupported" ;
VAL_ 2015 PID_D5_Supported 1 "Supported" 0 "Unsupported" ;
VAL_ 2015 PID_14_Supported 1 "Supported" 0 "Unsupported" ;
VAL_ 2015 PID_34_Supported 1 "Supported" 0 "Unsupported" ;
VAL_ 2015 PID_54_Supported 1 "Supported" 0 "Unsupported" ;
VAL_ 2015 MisfireMonitorStatus 1 "Not Complete" 0 "Complete" ;
VAL_ 2015 PID_74_Supported 1 "Supported" 0 "Unsupported" ;
VAL_ 2015 PID_94_Supported 1 "Supported" 0 "Unsupported" ;
VAL_ 2015 PID_B4_Supported 1 "Supported" 0 "Unsupported" ;
VAL_ 2015 PID_D4_Supported 1 "Supported" 0 "Unsupported" ;
VAL_ 2015 PID_13_Supported 1 "Supported" 0 "Unsupported" ;
VAL_ 2015 PID_33_Supported 1 "Supported" 0 "Unsupported" ;
VAL_ 2015 PID_53_Supported 1 "Supported" 0 "Unsupported" ;
VAL_ 2015 FuelSystemMonitorStatus 1 "Not Complete" 0 "Complete" ;
VAL_ 2015 PID_73_Supported 1 "Supported" 0 "Unsupported" ;
VAL_ 2015 PID_93_Supported 1 "Supported" 0 "Unsupported" ;
VAL_ 2015 PID_B3_Supported 1 "Supported" 0 "Unsupported" ;
VAL_ 2015 PID_D3_Supported 1 "Supported" 0 "Unsupported" ;
VAL_ 2015 PID_12_Supported 1 "Supported" 0 "Unsupported" ;
VAL_ 2015 PID_32_Supported 1 "Supported" 0 "Unsupported" ;
VAL_ 2015 PID_52_Supported 1 "Supported" 0 "Unsupported" ;
VAL_ 2015 CompComponentMonitorStatus 1 "Not Complete" 0 "Complete" ;
VAL_ 2015 PID_72_Supported 1 "Supported" 0 "Unsupported" ;
VAL_ 2015 PID_92_Supported 1 "Supported" 0 "Unsupported" ;
VAL_ 2015 PID_B2_Supported 1 "Supported" 0 "Unsupported" ;
VAL_ 2015 PID_D2_Supported 1 "Supported" 0 "Unsupported" ;
VAL_ 2015 PID_11_Supported 1 "Supported" 0 "Unsupported" ;
VAL_ 2015 FuelSystem2Status 1 "Open loop (insuff. eng. temp.)" 2 "Closed loop (oxy sens)" 4 "Open loop (eng. load, fuel cut)" 8 "Open loop (system failure)" 16 "Closed loop (feedback issue)" ;
VAL_ 2015 PID_31_Supported 1 "Supported" 0 "Unsupported" ;
VAL_ 2015 PID_51_Supported 1 "Supported" 0 "Unsupported" ;
VAL_ 2015 PID_71_Supported 1 "Supported" 0 "Unsupported" ;
VAL_ 2015 PID_91_Supported 1 "Supported" 0 "Unsupported" ;
VAL_ 2015 PID_B1_Supported 1 "Supported" 0 "Unsupported" ;
VAL_ 2015 PID_D1_Supported 1 "Supported" 0 "Unsupported" ;
VAL_ 2015 IAT_B1S1_Support 1 "Supported" 0 "Unsupported" ;
VAL_ 2015 ECTSensorASupport 1 "Supported" 0 "Unsupported" ;
VAL_ 2015 MAFSensorASupport 1 "Supported" 0 "Unsupported" ;
VAL_ 2015 PTOStatus2Support 1 "Supported" 0 "Unsupported" ;
VAL_ 2015 PID_20_Supported 1 "Supported" 0 "Unsupported" ;
VAL_ 2015 O2_B1S1_Supported 1 "Supported" 0 "Unsupported" ;
VAL_ 2015 PTOStatus 1 "Enabled" 0 "Disabled" ;
VAL_ 2015 PID_40_Supported 1 "Supported" 0 "Unsupported" ;
VAL_ 2015 PID_60_Supported 1 "Supported" 0 "Unsupported" ;
VAL_ 2015 PID_80_Supported 1 "Supported" 0 "Unsupported" ;
VAL_ 2015 PID_A0_Supported 1 "Supported" 0 "Unsupported" ;
VAL_ 2015 NOxConcentrationB1S1Supported 1 "Supported" 0 "Unsupported" ;
VAL_ 2015 NOxReagentSupported 1 "Supported" 0 "Unsupported" ;
VAL_ 2015 PMConcentration_B1S1_Supported 1 "Supported" 0 "Unsupported" ;
VAL_ 2015 PID_C0_Supported 1 "Supported" 0 "Unsupported" ;
VAL_ 2015 PID_E0_Supported 1 "Supported" 0 "Unsupported" ;
VAL_ 2015 EGR_A_DutyCyclePositionSupport 1 "Supported" 0 "Unsupported" ;
VAL_ 2015 IAT_B1S2_Support 1 "Supported" 0 "Unsupported" ;
VAL_ 2015 ECTSensorBSupport 1 "Supported" 0 "Unsupported" ;
VAL_ 2015 MAFSensorBSupport 1 "Supported" 0 "Unsupported" ;
VAL_ 2015 AutomaticTransmissionGearStatusS 1 "Supported" 0 "Unsupported" ;
VAL_ 2015 PID_1F_Supported 1 "Supported" 0 "Unsupported" ;
VAL_ 2015 O2_B1S2_Supported 1 "Supported" 0 "Unsupported" ;
VAL_ 2015 PID_3F_Supported 1 "Supported" 0 "Unsupported" ;
VAL_ 2015 PID_5F_Supported 1 "Supported" 0 "Unsupported" ;
VAL_ 2015 PID_7F_Supported 1 "Supported" 0 "Unsupported" ;
VAL_ 2015 PID_9F_Supported 1 "Supported" 0 "Unsupported" ;
VAL_ 2015 NOxConcentrationB1S2Supported 1 "Supported" 0 "Unsupported" ;
VAL_ 2015 NOxReagentDemandedSupported 1 "Supported" 0 "Unsupported" ;
VAL_ 2015 PMConcentration_B2S1_Supported 1 "Supported" 0 "Unsupported" ;
VAL_ 2015 IntakeManifoldAbsolutePressureSu 1 "Supported" 0 "Unsupported" ;
VAL_ 2015 PID_BF_Supported 1 "Supported" 0 "Unsupported" ;
VAL_ 2015 PID_DF_Supported 1 "Supported" 0 "Unsupported" ;
VAL_ 2015 EGR_A_ErrorSupport 1 "Supported" 0 "Unsupported" ;
VAL_ 2015 IAT_B1S3_Support 1 "Supported" 0 "Unsupported" ;
VAL_ 2015 ManualTransmissionGearStatusSupp 1 "Supported" 0 "Unsupported" ;
VAL_ 2015 PID_1E_Supported 1 "Supported" 0 "Unsupported" ;
VAL_ 2015 O2_B1S3_Supported 1 "Supported" 0 "Unsupported" ;
VAL_ 2015 PID_3E_Supported 1 "Supported" 0 "Unsupported" ;
VAL_ 2015 PID_5E_Supported 1 "Supported" 0 "Unsupported" ;
VAL_ 2015 PID_7E_Supported 1 "Supported" 0 "Unsupported" ;
VAL_ 2015 PID_9E_Supported 1 "Supported" 0 "Unsupported" ;
VAL_ 2015 NOxConcentrationB2S1Supported 1 "Supported" 0 "Unsupported" ;
VAL_ 2015 NOxReagentLevelSupported 1 "Supported" 0 "Unsupported" ;
VAL_ 2015 PID_BE_Supported 1 "Supported" 0 "Unsupported" ;
VAL_ 2015 PID_DE_Supported 1 "Supported" 0 "Unsupported" ;
VAL_ 2015 IAT_B2S1_Support 1 "Supported" 0 "Unsupported" ;
VAL_ 2015 GlowPlugLampStatusSupport 1 "Supported" 0 "Unsupported" ;
VAL_ 2015 PID_1D_Supported 1 "Supported" 0 "Unsupported" ;
VAL_ 2015 O2_B1S4_Supported 1 "Supported" 0 "Unsupported" ;
VAL_ 2015 PID_3D_Supported 1 "Supported" 0 "Unsupported" ;
VAL_ 2015 PID_5D_Supported 1 "Supported" 0 "Unsupported" ;
VAL_ 2015 PID_7D_Supported 1 "Supported" 0 "Unsupported" ;
VAL_ 2015 PID_9D_Supported 1 "Supported" 0 "Unsupported" ;
VAL_ 2015 NOxConcentrationB2S2Supported 1 "Supported" 0 "Unsupported" ;
VAL_ 2015 NOxRuntimeWarningSupported 1 "Supported" 0 "Unsupported" ;
VAL_ 2015 PID_BD_Supported 1 "Supported" 0 "Unsupported" ;
VAL_ 2015 PID_DD_Supported 1 "Supported" 0 "Unsupported" ;
VAL_ 2015 EGR_B_DutyCyclePositionSupport 1 "Supported" 0 "Unsupported" ;
VAL_ 2015 IAT_B2S2_Support 1 "Supported" 0 "Unsupported" ;
VAL_ 2015 PID_1C_Supported 1 "Supported" 0 "Unsupported" ;
VAL_ 2015 O2_B2S1_Supported 1 "Supported" 0 "Unsupported" ;
VAL_ 2015 PID_3C_Supported 1 "Supported" 0 "Unsupported" ;
VAL_ 2015 PID_5C_Supported 1 "Supported" 0 "Unsupported" ;
VAL_ 2015 PID_7C_Supported 1 "Supported" 0 "Unsupported" ;
VAL_ 2015 PID_9C_Supported 1 "Supported" 0 "Unsupported" ;
VAL_ 2015 PID_BC_Supported 1 "Supported" 0 "Unsupported" ;
VAL_ 2015 PID_DC_Supported 1 "Supported" 0 "Unsupported" ;
VAL_ 2015 EGR_B_ErrorSupport 1 "Supported" 0 "Unsupported" ;
VAL_ 2015 IAT_B2S3_Support 1 "Supported" 0 "Unsupported" ;
VAL_ 2015 PID_1B_Supported 1 "Supported" 0 "Unsupported" ;
VAL_ 2015 O2_B2S2_Supported 1 "Supported" 0 "Unsupported" ;
VAL_ 2015 PID_3B_Supported 1 "Supported" 0 "Unsupported" ;
VAL_ 2015 PID_5B_Supported 1 "Supported" 0 "Unsupported" ;
VAL_ 2015 PID_7B_Supported 1 "Supported" 0 "Unsupported" ;
VAL_ 2015 PID_9B_Supported 1 "Supported" 0 "Unsupported" ;
VAL_ 2015 PID_BB_Supported 1 "Supported" 0 "Unsupported" ;
VAL_ 2015 PID_DB_Supported 1 "Supported" 0 "Unsupported" ;
VAL_ 2015 PID_1A_Supported 1 "Supported" 0 "Unsupported" ;
VAL_ 2015 O2_B2S3_Supported 1 "Supported" 0 "Unsupported" ;
VAL_ 2015 PID_3A_Supported 1 "Supported" 0 "Unsupported" ;
VAL_ 2015 PID_5A_Supported 1 "Supported" 0 "Unsupported" ;
VAL_ 2015 PID_7A_Supported 1 "Supported" 0 "Unsupported" ;
VAL_ 2015 PID_9A_Supported 1 "Supported" 0 "Unsupported" ;
VAL_ 2015 PID_BA_Supported 1 "Supported" 0 "Unsupported" ;
VAL_ 2015 PID_DA_Supported 1 "Supported" 0 "Unsupported" ;
VAL_ 2015 PID_19_Supported 1 "Supported" 0 "Unsupported" ;
VAL_ 2015 FuelSystem1Status 1 "Open loop (insuff. eng. temp.)" 2 "Closed loop (oxy sens)" 4 "Open loop (eng. load, fuel cut)" 8 "Open loop (system failure)" 16 "Closed loop (feedback issue)" ;
VAL_ 2015 CommandSecondaryAirStatus 1 "Upstream" 2 "Downstream catalytic conv" 4 "From outside atmosphere/off" 8 "Pump cmd on for diagn." ;
VAL_ 2015 O2_B2S4_Supported 1 "Supported" 0 "Unsupported" ;
VAL_ 2015 PID_39_Supported 1 "Supported" 0 "Unsupported" ;
VAL_ 2015 PID_59_Supported 1 "Supported" 0 "Unsupported" ;
VAL_ 2015 FuelType 0 "Not available" 1 "Gasoline" 2 "Methanol" 3 "Ethanol" 4 "Diesel" 5 "LPG" 6 "CNG" 7 "Propane" 8 "Electric" 9 "Bifuel running Gasoline" 10 "Bifuel running Methanol" 11 "Bifuel running Ethanol" 12 "Bifuel running LPG" 13 "Bifuel running CNG" 14 "Bifuel running Propane" 15 "Bifuel running Electricity" 16 "Bifuel electric/comb. eng." 17 "Hybrid gasoline" 18 "Hybrid Ethanol" 19 "Hybrid Diesel" 20 "Hybrid Electric" 21 "Hybrid running electric/comb." 22 "Hybrid Regenerative" 23 "Bifuel running diesel" ;
VAL_ 2015 EmissionRequirements 16 "Heavy Duty Vehicles (EURO EEV) C" 15 "Heavy Duty Vehicles (EURO V) B2" 14 "Heavy Duty Vehicles (EURO IV) B1" ;
VAL_ 2015 PID_79_Supported 1 "Supported" 0 "Unsupported" ;
VAL_ 2015 PID_99_Supported 1 "Supported" 0 "Unsupported" ;
VAL_ 2015 PID_B9_Supported 1 "Supported" 0 "Unsupported" ;
VAL_ 2015 PID_D9_Supported 1 "Supported" 0 "Unsupported" ;
VAL_ 2015 pid 0 "PIDsSupported_01_20" 1 "MonitorStatus" 2 "FreezeDTC" 3 "FuelSystemStatus" 4 "CalculatedEngineLoad" 5 "EngineCoolantTemp" 6 "ShortTermFuelTrim_B1_B3" 7 "LongTermFuelTrim_B1_B3" 8 "ShortTermFuelTrim_B2_B4" 9 "LongTermFuelTrim_B2_B4" 10 "FuelPressure" 11 "IntakeManifoldAbsolutePressure" 12 "EngineRPM" 13 "VehicleSpeed" 14 "TimingAdvance" 15 "IntakeAirTemp" 16 "MAFAirFlowRate" 17 "ThrottlePosition" 18 "CommandSecondaryAirStatus" 19 "OxygenSensorsSupported_B1_B2_S1_S2_S3_S4" 20 "O2_B1S1_Volt_STFT" 21 "O2_B1S2_Volt_STFT" 22 "O2_B1S3_Volt_STFT" 23 "O2_B1S4_Volt_STFT" 24 "O2_B2S1_Volt_STFT" 25 "O2_B2S2_Volt_STFT" 26 "O2_B2S3_Volt_STFT" 27 "O2_B2S4_Volt_STFT" 28 "OBDStandard" 29 "OxygenSensorsPresent2" 30 "PTOStatus" 31 "TimeSinceEngineStart" 32 "PIDsSupported_21_40" 33 "DistanceMILOn" 34 "FuelRailPressureRelativeToManifoldVacuum" 35 "FuelRailPressure" 36 "O2_B1S1_WB_Volt" 37 "O2_B1S2_WB_Volt" 38 "O2_B1S3_WB_Volt" 39 "O2_B1S4_WB_Volt" 40 "O2_B2S1_WB_Volt" 41 "O2_B2S2_WB_Volt" 42 "O2_B2S3_WB_Volt" 43 "O2_B2S4_WB_Volt" 44 "CommandEGR" 45 "EGRError" 46 "CommandEVAPPurge" 47 "FuelTankLevel" 48 "WarmUpsSinceCodeClear" 49 "DistanceSinceCodeClear" 50 "EVAPSystemVaporPressure" 51 "AbsoluteBarometricPressure" 52 "O2_B1S1_WB_Lambda_Current" 53 "O2_B1S2_WB_Lambda_Current" 54 "O2_B1S3_WB_Lambda_Current" 55 "O2_B1S4_WB_Lambda_Current" 56 "O2_B2S1_WB_Lambda_Current" 57 "O2_B2S2_WB_Lambda_Current" 58 "O2_B2S3_WB_Lambda_Current" 59 "O2_B2S4_WB_Lambda_Current" 60 "CatalystTemperature_B1S1" 61 "CatalystTemperature_B2S1" 62 "CatalystTemperature_B1S2" 63 "CatalystTemperature_B2S2" 64 "PIDsSupported_41_60" 65 "DriveCycleMonitorStatus" 66 "ControlModuleVolt" 67 "AbsoluteLoadValue" 68 "FuelAirCommandedLambda" 69 "RelativeThrottlePosition" 70 "AmbientAirTemp" 71 "AbsoluteThrottlePositionB" 72 "AbsoluteThrottlePositionC" 73 "AbsoluteThrottlePositionD" 74 "AbsoluteThrottlePositionE" 75 "AbsoluteThrottlePositionF" 76 "CommandThrottleActuator" 77 "TimeRunMILOn" 78 "TimeSinceCodeClear" 79 "MaximumValues_EQ_O2Volt_O2Current_IntakeABS" 80 "MaximumValueForMassAirFlowSensor" 81 "FuelType" 82 "EthanolFuelPct" 83 "AbsoluteEVAPSystemVaporPressure" 84 "EvapSysVapPres" 85 "ShortSecOxyTrimBankX" 86 "LongSecOxyTrimBankX" 87 "O2Secondary_ShortTermFuelTrim_B1_B2_B3_B4" 88 "O2Secondary_LongTermFuelTrim_B1_B2_B3_B4" 89 "FuelRailPressureAbsolute" 90 "RelativeAcceleratorPedalPosition" 91 "HybridBattteryPackRemainingLife" 92 "EngineOilTemp" 93 "FuelInjectionTiming" 94 "EngineFuelRate" 95 "EmissionRequirements" 96 "PIDsSupported_61_80" 97 "EngineTorqueDemand" 98 "EngineTorque" 99 "EngineTorqueReference" 100 "EngineTorquePoint" 101 "AuxInputOutput" 102 "MAFSensorAB" 103 "EngineCoolantTemp AB" 104 "IntakeAirTempSensors" 105 "CmdEGR_EGRError" 106 "CmdDieselIntAir" 107 "ExhaustGasTemp" 108 "CommandThrottleActuatorRelative" 109 "FuelPresContrSys" 110 "InjPresContrSys" 111 "TurboCompressorPressure" 112 "BoostPresCntrl" 113 "TurboVGTControl" 114 "WastegateControl" 115 "ExhaustPressure" 116 "TurbochargerRpm" 117 "TurbochargerTemp1" 118 "TurbochargerTemp2" 119 "CACTemp" 120 "EGTBank1" 121 "EGTBank2" 122 "DPF1" 123 "DPF2" 124 "DPFTemp" 125 "NOxNTE" 126 "PMNTE" 127 "EngineRunTime" 128 "PIDsSupported_81_A0" 129 "AECDEngineRuntime1" 130 "AECDEngineRuntime2" 131 "NOxConcentration" 132 "IntakeManifoldSurfaceTemperature" 133 "NOxReagentSystem" 134 "PMConcentration" 135 "IntakeManifoldAbsolutePressureAB" 136 "SCRInduceSystem" 137 "AECDRuntime_11_15" 138 "AECDRuntime_16_20" 139 "DieselTreatment" 140 "O2WideRange" 141 "ThrottlePositionG" 142 "EngineFrictionTorque" 143 "PMSensor1&2" 144 "WWHOBDSystemInfo1" 145 "WWHOBDSystemInfo2" 146 "FuelSystemControl" 147 "WWHOBDCounterSupport" 148 "NOxWarningSystem" 152 "ExhaustGasTemp1" 153 "ExhaustGasTemp2" 154 "EVHybridVehSysData" 155 "DieselEFData" 156 "O2SensorData" 157 "FuelRate" 158 "ExhaustFlowRate" 159 "FuelSystemUse" 160 "PIDsSupported_A1_C0" 161 "NOxCorrectedData" 162 "CylinderFuelRate" 163 "EVAPSysPress" 164 "TransmissionGear" 165 "DieselEFD" 166 "Odometer" 192 "PIDsSupported_C1_E0" ;
VAL_ 2015 mode 10 "Permanent DTCs (Cleared DTCs)" 9 "Request vehicle information" 8 "Control on-board system" 7 "Show pending DTCs" 6 "Other system monitoring" 5 "Oxygen sensor monitoring" 4 "Clear DTCs and stored values" 3 "Show stored DTCs" 2 "Show freeze frame data" 1 "Live Data" ;
VAL_ 2024 PID_08_Supported 1 "Supported" 0 "Unsupported" ;
VAL_ 2024 PID_28_Supported 1 "Supported" 0 "Unsupported" ;
VAL_ 2024 PID_48_Supported 1 "Supported" 0 "Unsupported" ;
VAL_ 2024 Cat_NMHCCatMonitorStatus 1 "Not Complete" 0 "Complete" ;
VAL_ 2024 PID_68_Supported 1 "Supported" 0 "Unsupported" ;
VAL_ 2024 PID_88_Supported 1 "Supported" 0 "Unsupported" ;
VAL_ 2024 PID_A8_Supported 1 "Supported" 0 "Unsupported" ;
VAL_ 2024 PID_C8_Supported 1 "Supported" 0 "Unsupported" ;
VAL_ 2024 PID_07_Supported 1 "Supported" 0 "Unsupported" ;
VAL_ 2024 PID_27_Supported 1 "Supported" 0 "Unsupported" ;
VAL_ 2024 PID_47_Supported 1 "Supported" 0 "Unsupported" ;
VAL_ 2024 HeatedCat_NOxSCRMonitorStatus 1 "Not Complete" 0 "Complete" ;
VAL_ 2024 PID_67_Supported 1 "Supported" 0 "Unsupported" ;
VAL_ 2024 PID_87_Supported 1 "Supported" 0 "Unsupported" ;
VAL_ 2024 PID_A7_Supported 1 "Supported" 0 "Unsupported" ;
VAL_ 2024 PID_C7_Supported 1 "Supported" 0 "Unsupported" ;
VAL_ 2024 PID_06_Supported 1 "Supported" 0 "Unsupported" ;
VAL_ 2024 PID_26_Supported 1 "Supported" 0 "Unsupported" ;
VAL_ 2024 PID_46_Supported 1 "Supported" 0 "Unsupported" ;
VAL_ 2024 EvapMonitorStatus 1 "Not Complete" 0 "Complete" ;
VAL_ 2024 PID_66_Supported 1 "Supported" 0 "Unsupported" ;
VAL_ 2024 PID_86_Supported 1 "Supported" 0 "Unsupported" ;
VAL_ 2024 PID_A6_Supported 1 "Supported" 0 "Unsupported" ;
VAL_ 2024 PID_C6_Supported 1 "Supported" 0 "Unsupported" ;
VAL_ 2024 PID_05_Supported 1 "Supported" 0 "Unsupported" ;
VAL_ 2024 PID_25_Supported 1 "Supported" 0 "Unsupported" ;
VAL_ 2024 PID_45_Supported 1 "Supported" 0 "Unsupported" ;
VAL_ 2024 SecondaryAir_BoostPressureM_0001 1 "Not Complete" 0 "Complete" ;
VAL_ 2024 PID_65_Supported 1 "Supported" 0 "Unsupported" ;
VAL_ 2024 PID_85_Supported 1 "Supported" 0 "Unsupported" ;
VAL_ 2024 PID_A5_Supported 1 "Supported" 0 "Unsupported" ;
VAL_ 2024 PID_C5_Supported 1 "Supported" 0 "Unsupported" ;
VAL_ 2024 PID_04_Supported 1 "Supported" 0 "Unsupported" ;
VAL_ 2024 PID_24_Supported 1 "Supported" 0 "Unsupported" ;
VAL_ 2024 PID_44_Supported 1 "Supported" 0 "Unsupported" ;
VAL_ 2024 PID_64_Supported 1 "Supported" 0 "Unsupported" ;
VAL_ 2024 PID_84_Supported 1 "Supported" 0 "Unsupported" ;
VAL_ 2024 PID_A4_Supported 1 "Supported" 0 "Unsupported" ;
VAL_ 2024 PID_C4_Supported 1 "Supported" 0 "Unsupported" ;
VAL_ 2024 PID_03_Supported 1 "Supported" 0 "Unsupported" ;
VAL_ 2024 PID_23_Supported 1 "Supported" 0 "Unsupported" ;
VAL_ 2024 PID_43_Supported 1 "Supported" 0 "Unsupported" ;
VAL_ 2024 O2_ExhaustGasMonitorStatus 1 "Not Complete" 0 "Complete" ;
VAL_ 2024 PID_63_Supported 1 "Supported" 0 "Unsupported" ;
VAL_ 2024 PID_83_Supported 1 "Supported" 0 "Unsupported" ;
VAL_ 2024 PID_A3_Supported 1 "Supported" 0 "Unsupported" ;
VAL_ 2024 PID_C3_Supported 1 "Supported" 0 "Unsupported" ;
VAL_ 2024 PID_02_Supported 1 "Supported" 0 "Unsupported" ;
VAL_ 2024 PID_22_Supported 1 "Supported" 0 "Unsupported" ;
VAL_ 2024 PID_42_Supported 1 "Supported" 0 "Unsupported" ;
VAL_ 2024 O2_PMFilterMonitorStatus 1 "Not Complete" 0 "Complete" ;
VAL_ 2024 PID_62_Supported 1 "Supported" 0 "Unsupported" ;
VAL_ 2024 PID_82_Supported 1 "Supported" 0 "Unsupported" ;
VAL_ 2024 PID_A2_Supported 1 "Supported" 0 "Unsupported" ;
VAL_ 2024 PID_C2_Supported 1 "Supported" 0 "Unsupported" ;
VAL_ 2024 PID_01_Supported 1 "Supported" 0 "Unsupported" ;
VAL_ 2024 PID_21_Supported 1 "Supported" 0 "Unsupported" ;
VAL_ 2024 PID_41_Supported 1 "Supported" 0 "Unsupported" ;
VAL_ 2024 EGR_VVTMonitorStatus 1 "Not Complete" 0 "Complete" ;
VAL_ 2024 PID_61_Supported 1 "Supported" 0 "Unsupported" ;
VAL_ 2024 PID_81_Supported 1 "Supported" 0 "Unsupported" ;
VAL_ 2024 PID_A1_Supported 1 "Supported" 0 "Unsupported" ;
VAL_ 2024 PID_C1_Supported 1 "Supported" 0 "Unsupported" ;
VAL_ 2024 PID_10_Supported 1 "Supported" 0 "Unsupported" ;
VAL_ 2024 PID_30_Supported 1 "Supported" 0 "Unsupported" ;
VAL_ 2024 PID_50_Supported 1 "Supported" 0 "Unsupported" ;
VAL_ 2024 Cat_NMHCCatMonitorEnabled 1 "True" 0 "False" ;
VAL_ 2024 PID_70_Supported 1 "Supported" 0 "Unsupported" ;
VAL_ 2024 PID_90_Supported 1 "Supported" 0 "Unsupported" ;
VAL_ 2024 PID_B0_Supported 1 "Supported" 0 "Unsupported" ;
VAL_ 2024 PID_D0_Supported 1 "Supported" 0 "Unsupported" ;
VAL_ 2024 PID_0F_Supported 1 "Supported" 0 "Unsupported" ;
VAL_ 2024 PID_2F_Supported 1 "Supported" 0 "Unsupported" ;
VAL_ 2024 PID_4F_Supported 1 "Supported" 0 "Unsupported" ;
VAL_ 2024 HeatedCat_NOxSCRMonitorEnabled 1 "True" 0 "False" ;
VAL_ 2024 PID_6F_Supported 1 "Supported" 0 "Unsupported" ;
VAL_ 2024 PID_8F_Supported 1 "Supported" 0 "Unsupported" ;
VAL_ 2024 PID_AF_Supported 1 "Supported" 0 "Unsupported" ;
VAL_ 2024 PID_CF_Supported 1 "Supported" 0 "Unsupported" ;
VAL_ 2024 PID_0E_Supported 1 "Supported" 0 "Unsupported" ;
VAL_ 2024 PID_2E_Supported 1 "Supported" 0 "Unsupported" ;
VAL_ 2024 PID_4E_Supported 1 "Supported" 0 "Unsupported" ;
VAL_ 2024 EvapMonitorEnabled 1 "True" 0 "False" ;
VAL_ 2024 PID_6E_Supported 1 "Supported" 0 "Unsupported" ;
VAL_ 2024 PID_8E_Supported 1 "Supported" 0 "Unsupported" ;
VAL_ 2024 PID_AE_Supported 1 "Supported" 0 "Unsupported" ;
VAL_ 2024 PID_CE_Supported 1 "Supported" 0 "Unsupported" ;
VAL_ 2024 PID_0D_Supported 1 "Supported" 0 "Unsupported" ;
VAL_ 2024 PID_2D_Supported 1 "Supported" 0 "Unsupported" ;
VAL_ 2024 PID_4D_Supported 1 "Supported" 0 "Unsupported" ;
VAL_ 2024 SecondaryAir_BoostPressureM_0002 1 "True" 0 "False" ;
VAL_ 2024 PID_6D_Supported 1 "Supported" 0 "Unsupported" ;
VAL_ 2024 PID_8D_Supported 1 "Supported" 0 "Unsupported" ;
VAL_ 2024 PID_AD_Supported 1 "Supported" 0 "Unsupported" ;
VAL_ 2024 PID_CD_Supported 1 "Supported" 0 "Unsupported" ;
VAL_ 2024 PID_0C_Supported 1 "Supported" 0 "Unsupported" ;
VAL_ 2024 PID_2C_Supported 1 "Supported" 0 "Unsupported" ;
VAL_ 2024 PID_4C_Supported 1 "Supported" 0 "Unsupported" ;
VAL_ 2024 PID_6C_Supported 1 "Supported" 0 "Unsupported" ;
VAL_ 2024 PID_8C_Supported 1 "Supported" 0 "Unsupported" ;
VAL_ 2024 PID_AC_Supported 1 "Supported" 0 "Unsupported" ;
VAL_ 2024 PID_CC_Supported 1 "Supported" 0 "Unsupported" ;
VAL_ 2024 PID_0B_Supported 1 "Supported" 0 "Unsupported" ;
VAL_ 2024 PID_2B_Supported 1 "Supported" 0 "Unsupported" ;
VAL_ 2024 PID_4B_Supported 1 "Supported" 0 "Unsupported" ;
VAL_ 2024 O2_ExhaustGasMonitorEnabled 1 "True" 0 "False" ;
VAL_ 2024 PID_6B_Supported 1 "Supported" 0 "Unsupported" ;
VAL_ 2024 PID_8B_Supported 1 "Supported" 0 "Unsupported" ;
VAL_ 2024 PID_AB_Supported 1 "Supported" 0 "Unsupported" ;
VAL_ 2024 PID_CB_Supported 1 "Supported" 0 "Unsupported" ;
VAL_ 2024 PID_0A_Supported 1 "Supported" 0 "Unsupported" ;
VAL_ 2024 PID_2A_Supported 1 "Supported" 0 "Unsupported" ;
VAL_ 2024 PID_4A_Supported 1 "Supported" 0 "Unsupported" ;
VAL_ 2024 O2Heater_PMFilterMonitorEnabled 1 "True" 0 "False" ;
VAL_ 2024 PID_6A_Supported 1 "Supported" 0 "Unsupported" ;
VAL_ 2024 PID_8A_Supported 1 "Supported" 0 "Unsupported" ;
VAL_ 2024 PID_AA_Supported 1 "Supported" 0 "Unsupported" ;
VAL_ 2024 PID_CA_Supported 1 "Supported" 0 "Unsupported" ;
VAL_ 2024 PID_09_Supported 1 "Supported" 0 "Unsupported" ;
VAL_ 2024 PID_29_Supported 1 "Supported" 0 "Unsupported" ;
VAL_ 2024 PID_49_Supported 1 "Supported" 0 "Unsupported" ;
VAL_ 2024 EGR_VVTSystemMonitorEnabled 1 "True" 0 "False" ;
VAL_ 2024 PID_69_Supported 1 "Supported" 0 "Unsupported" ;
VAL_ 2024 PID_89_Supported 1 "Supported" 0 "Unsupported" ;
VAL_ 2024 PID_A9_Supported 1 "Supported" 0 "Unsupported" ;
VAL_ 2024 PID_C9_Supported 1 "Supported" 0 "Unsupported" ;
VAL_ 2024 PTOStatus2 1 "Enabled" 0 "Disabled" ;
VAL_ 2024 PID_18_Supported 1 "Supported" 0 "Unsupported" ;
VAL_ 2024 PID_38_Supported 1 "Supported" 0 "Unsupported" ;
VAL_ 2024 PID_58_Supported 1 "Supported" 0 "Unsupported" ;
VAL_ 2024 MisfireMonitorEnabled 1 "True" 0 "False" ;
VAL_ 2024 PID_78_Supported 1 "Supported" 0 "Unsupported" ;
VAL_ 2024 PID_98_Supported 1 "Supported" 0 "Unsupported" ;
VAL_ 2024 PID_B8_Supported 1 "Supported" 0 "Unsupported" ;
VAL_ 2024 PID_D8_Supported 1 "Supported" 0 "Unsupported" ;
VAL_ 2024 AutomaticTransmissionGearStatus 1 "In Gear" 0 "Park/Neutral" ;
VAL_ 2024 PID_17_Supported 1 "Supported" 0 "Unsupported" ;
VAL_ 2024 PID_37_Supported 1 "Supported" 0 "Unsupported" ;
VAL_ 2024 PID_57_Supported 1 "Supported" 0 "Unsupported" ;
VAL_ 2024 FuelSystemMonitorEnabled 1 "True" 0 "False" ;
VAL_ 2024 PID_77_Supported 1 "Supported" 0 "Unsupported" ;
VAL_ 2024 PID_97_Supported 1 "Supported" 0 "Unsupported" ;
VAL_ 2024 PID_B7_Supported 1 "Supported" 0 "Unsupported" ;
VAL_ 2024 PID_D7_Supported 1 "Supported" 0 "Unsupported" ;
VAL_ 2024 ManualTransmissionGearStatus 1 "In Gear" 0 "Park/Neutral" ;
VAL_ 2024 PID_16_Supported 1 "Supported" 0 "Unsupported" ;
VAL_ 2024 PID_36_Supported 1 "Supported" 0 "Unsupported" ;
VAL_ 2024 PID_56_Supported 1 "Supported" 0 "Unsupported" ;
VAL_ 2024 CompComponentMonitorEnabled 1 "True" 0 "False" ;
VAL_ 2024 PID_76_Supported 1 "Supported" 0 "Unsupported" ;
VAL_ 2024 PID_96_Supported 1 "Supported" 0 "Unsupported" ;
VAL_ 2024 PID_B6_Supported 1 "Supported" 0 "Unsupported" ;
VAL_ 2024 PID_D6_Supported 1 "Supported" 0 "Unsupported" ;
VAL_ 2024 GlowPlugLampStatus 1 "On" 0 "Off" ;
VAL_ 2024 PID_15_Supported 1 "Supported" 0 "Unsupported" ;
VAL_ 2024 PID_35_Supported 1 "Supported" 0 "Unsupported" ;
VAL_ 2024 PID_55_Supported 1 "Supported" 0 "Unsupported" ;
VAL_ 2024 IgnitionMonitorType 1 "Compression ignition monitor" 0 "Spark ignition monitor" ;
VAL_ 2024 PID_75_Supported 1 "Supported" 0 "Unsupported" ;
VAL_ 2024 PID_95_Supported 1 "Supported" 0 "Unsupported" ;
VAL_ 2024 PID_B5_Supported 1 "Supported" 0 "Unsupported" ;
VAL_ 2024 PID_D5_Supported 1 "Supported" 0 "Unsupported" ;
VAL_ 2024 PID_14_Supported 1 "Supported" 0 "Unsupported" ;
VAL_ 2024 PID_34_Supported 1 "Supported" 0 "Unsupported" ;
VAL_ 2024 PID_54_Supported 1 "Supported" 0 "Unsupported" ;
VAL_ 2024 MisfireMonitorStatus 1 "Not Complete" 0 "Complete" ;
VAL_ 2024 PID_74_Supported 1 "Supported" 0 "Unsupported" ;
VAL_ 2024 PID_94_Supported 1 "Supported" 0 "Unsupported" ;
VAL_ 2024 PID_B4_Supported 1 "Supported" 0 "Unsupported" ;
VAL_ 2024 PID_D4_Supported 1 "Supported" 0 "Unsupported" ;
VAL_ 2024 PID_13_Supported 1 "Supported" 0 "Unsupported" ;
VAL_ 2024 PID_33_Supported 1 "Supported" 0 "Unsupported" ;
VAL_ 2024 PID_53_Supported 1 "Supported" 0 "Unsupported" ;
VAL_ 2024 FuelSystemMonitorStatus 1 "Not Complete" 0 "Complete" ;
VAL_ 2024 PID_73_Supported 1 "Supported" 0 "Unsupported" ;
VAL_ 2024 PID_93_Supported 1 "Supported" 0 "Unsupported" ;
VAL_ 2024 PID_B3_Supported 1 "Supported" 0 "Unsupported" ;
VAL_ 2024 PID_D3_Supported 1 "Supported" 0 "Unsupported" ;
VAL_ 2024 PID_12_Supported 1 "Supported" 0 "Unsupported" ;
VAL_ 2024 PID_32_Supported 1 "Supported" 0 "Unsupported" ;
VAL_ 2024 PID_52_Supported 1 "Supported" 0 "Unsupported" ;
VAL_ 2024 CompComponentMonitorStatus 1 "Not Complete" 0 "Complete" ;
VAL_ 2024 PID_72_Supported 1 "Supported" 0 "Unsupported" ;
VAL_ 2024 PID_92_Supported 1 "Supported" 0 "Unsupported" ;
VAL_ 2024 PID_B2_Supported 1 "Supported" 0 "Unsupported" ;
VAL_ 2024 PID_D2_Supported 1 "Supported" 0 "Unsupported" ;
VAL_ 2024 PID_11_Supported 1 "Supported" 0 "Unsupported" ;
VAL_ 2024 FuelSystem2Status 1 "Open loop (insuff. eng. temp.)" 2 "Closed loop (oxy sens)" 4 "Open loop (eng. load, fuel cut)" 8 "Open loop (system failure)" 16 "Closed loop (feedback issue)" ;
VAL_ 2024 PID_31_Supported 1 "Supported" 0 "Unsupported" ;
VAL_ 2024 PID_51_Supported 1 "Supported" 0 "Unsupported" ;
VAL_ 2024 PID_71_Supported 1 "Supported" 0 "Unsupported" ;
VAL_ 2024 PID_91_Supported 1 "Supported" 0 "Unsupported" ;
VAL_ 2024 PID_B1_Supported 1 "Supported" 0 "Unsupported" ;
VAL_ 2024 PID_D1_Supported 1 "Supported" 0 "Unsupported" ;
VAL_ 2024 IAT_B1S1_Support 1 "Supported" 0 "Unsupported" ;
VAL_ 2024 ECTSensorASupport 1 "Supported" 0 "Unsupported" ;
VAL_ 2024 MAFSensorASupport 1 "Supported" 0 "Unsupported" ;
VAL_ 2024 PTOStatus2Support 1 "Supported" 0 "Unsupported" ;
VAL_ 2024 PID_20_Supported 1 "Supported" 0 "Unsupported" ;
VAL_ 2024 IntakeManifoldAbsolutePress_0000 1 "Supported" 0 "Unsupported" ;
VAL_ 2024 O2_B1S1_Supported 1 "Supported" 0 "Unsupported" ;
VAL_ 2024 PTOStatus 1 "Enabled" 0 "Disabled" ;
VAL_ 2024 PID_40_Supported 1 "Supported" 0 "Unsupported" ;
VAL_ 2024 PID_60_Supported 1 "Supported" 0 "Unsupported" ;
VAL_ 2024 PID_80_Supported 1 "Supported" 0 "Unsupported" ;
VAL_ 2024 PID_A0_Supported 1 "Supported" 0 "Unsupported" ;
VAL_ 2024 NOxConcentrationB1S1Supported 1 "Supported" 0 "Unsupported" ;
VAL_ 2024 NOxReagentSupported 1 "Supported" 0 "Unsupported" ;
VAL_ 2024 PMConcentration_B1S1_Supported 1 "Supported" 0 "Unsupported" ;
VAL_ 2024 PID_C0_Supported 1 "Supported" 0 "Unsupported" ;
VAL_ 2024 PID_E0_Supported 1 "Supported" 0 "Unsupported" ;
VAL_ 2024 EGR_A_DutyCyclePositionSupport 1 "Supported" 0 "Unsupported" ;
VAL_ 2024 IAT_B1S2_Support 1 "Supported" 0 "Unsupported" ;
VAL_ 2024 ECTSensorBSupport 1 "Supported" 0 "Unsupported" ;
VAL_ 2024 MAFSensorBSupport 1 "Supported" 0 "Unsupported" ;
VAL_ 2024 AutomaticTransmissionGearSt_0000 1 "Supported" 0 "Unsupported" ;
VAL_ 2024 PID_1F_Supported 1 "Supported" 0 "Unsupported" ;
VAL_ 2024 O2_B1S2_Supported 1 "Supported" 0 "Unsupported" ;
VAL_ 2024 PID_3F_Supported 1 "Supported" 0 "Unsupported" ;
VAL_ 2024 PID_5F_Supported 1 "Supported" 0 "Unsupported" ;
VAL_ 2024 PID_7F_Supported 1 "Supported" 0 "Unsupported" ;
VAL_ 2024 PID_9F_Supported 1 "Supported" 0 "Unsupported" ;
VAL_ 2024 NOxConcentrationB1S2Supported 1 "Supported" 0 "Unsupported" ;
VAL_ 2024 NOxReagentDemandedSupported 1 "Supported" 0 "Unsupported" ;
VAL_ 2024 PMConcentration_B2S1_Supported 1 "Supported" 0 "Unsupported" ;
VAL_ 2024 IntakeManifoldAbsolutePress_0001 1 "Supported" 0 "Unsupported" ;
VAL_ 2024 PID_BF_Supported 1 "Supported" 0 "Unsupported" ;
VAL_ 2024 PID_DF_Supported 1 "Supported" 0 "Unsupported" ;
VAL_ 2024 EGR_A_ErrorSupport 1 "Supported" 0 "Unsupported" ;
VAL_ 2024 IAT_B1S3_Support 1 "Supported" 0 "Unsupported" ;
VAL_ 2024 ManualTransmissionGearStatu_0000 1 "Supported" 0 "Unsupported" ;
VAL_ 2024 PID_1E_Supported 1 "Supported" 0 "Unsupported" ;
VAL_ 2024 O2_B1S3_Supported 1 "Supported" 0 "Unsupported" ;
VAL_ 2024 PID_3E_Supported 1 "Supported" 0 "Unsupported" ;
VAL_ 2024 PID_5E_Supported 1 "Supported" 0 "Unsupported" ;
VAL_ 2024 PID_7E_Supported 1 "Supported" 0 "Unsupported" ;
VAL_ 2024 PID_9E_Supported 1 "Supported" 0 "Unsupported" ;
VAL_ 2024 NOxConcentrationB2S1Supported 1 "Supported" 0 "Unsupported" ;
VAL_ 2024 NOxReagentLevelSupported 1 "Supported" 0 "Unsupported" ;
VAL_ 2024 PID_BE_Supported 1 "Supported" 0 "Unsupported" ;
VAL_ 2024 PID_DE_Supported 1 "Supported" 0 "Unsupported" ;
VAL_ 2024 IAT_B2S1_Support 1 "Supported" 0 "Unsupported" ;
VAL_ 2024 GlowPlugLampStatusSupport 1 "Supported" 0 "Unsupported" ;
VAL_ 2024 PID_1D_Supported 1 "Supported" 0 "Unsupported" ;
VAL_ 2024 O2_B1S4_Supported 1 "Supported" 0 "Unsupported" ;
VAL_ 2024 PID_3D_Supported 1 "Supported" 0 "Unsupported" ;
VAL_ 2024 PID_5D_Supported 1 "Supported" 0 "Unsupported" ;
VAL_ 2024 PID_7D_Supported 1 "Supported" 0 "Unsupported" ;
VAL_ 2024 PID_9D_Supported 1 "Supported" 0 "Unsupported" ;
VAL_ 2024 NOxConcentrationB2S2Supported 1 "Supported" 0 "Unsupported" ;
VAL_ 2024 NOxRuntimeWarningSupported 1 "Supported" 0 "Unsupported" ;
VAL_ 2024 PID_BD_Supported 1 "Supported" 0 "Unsupported" ;
VAL_ 2024 PID_DD_Supported 1 "Supported" 0 "Unsupported" ;
VAL_ 2024 EGR_B_DutyCyclePositionSupport 1 "Supported" 0 "Unsupported" ;
VAL_ 2024 IAT_B2S2_Support 1 "Supported" 0 "Unsupported" ;
VAL_ 2024 PID_1C_Supported 1 "Supported" 0 "Unsupported" ;
VAL_ 2024 O2_B2S1_Supported 1 "Supported" 0 "Unsupported" ;
VAL_ 2024 PID_3C_Supported 1 "Supported" 0 "Unsupported" ;
VAL_ 2024 PID_5C_Supported 1 "Supported" 0 "Unsupported" ;
VAL_ 2024 PID_7C_Supported 1 "Supported" 0 "Unsupported" ;
VAL_ 2024 PID_9C_Supported 1 "Supported" 0 "Unsupported" ;
VAL_ 2024 PID_BC_Supported 1 "Supported" 0 "Unsupported" ;
VAL_ 2024 PID_DC_Supported 1 "Supported" 0 "Unsupported" ;
VAL_ 2024 EGR_B_ErrorSupport 1 "Supported" 0 "Unsupported" ;
VAL_ 2024 IAT_B2S3_Support 1 "Supported" 0 "Unsupported" ;
VAL_ 2024 PID_1B_Supported 1 "Supported" 0 "Unsupported" ;
VAL_ 2024 O2_B2S2_Supported 1 "Supported" 0 "Unsupported" ;
VAL_ 2024 PID_3B_Supported 1 "Supported" 0 "Unsupported" ;
VAL_ 2024 PID_5B_Supported 1 "Supported" 0 "Unsupported" ;
VAL_ 2024 PID_7B_Supported 1 "Supported" 0 "Unsupported" ;
VAL_ 2024 PID_9B_Supported 1 "Supported" 0 "Unsupported" ;
VAL_ 2024 PID_BB_Supported 1 "Supported" 0 "Unsupported" ;
VAL_ 2024 PID_DB_Supported 1 "Supported" 0 "Unsupported" ;
VAL_ 2024 PID_1A_Supported 1 "Supported" 0 "Unsupported" ;
VAL_ 2024 O2_B2S3_Supported 1 "Supported" 0 "Unsupported" ;
VAL_ 2024 PID_3A_Supported 1 "Supported" 0 "Unsupported" ;
VAL_ 2024 PID_5A_Supported 1 "Supported" 0 "Unsupported" ;
VAL_ 2024 PID_7A_Supported 1 "Supported" 0 "Unsupported" ;
VAL_ 2024 PID_9A_Supported 1 "Supported" 0 "Unsupported" ;
VAL_ 2024 PID_BA_Supported 1 "Supported" 0 "Unsupported" ;
VAL_ 2024 PID_DA_Supported 1 "Supported" 0 "Unsupported" ;
VAL_ 2024 PID_19_Supported 1 "Supported" 0 "Unsupported" ;
VAL_ 2024 FuelSystem1Status 1 "Open loop (insuff. eng. temp.)" 2 "Closed loop (oxy sens)" 4 "Open loop (eng. load, fuel cut)" 8 "Open loop (system failure)" 16 "Closed loop (feedback issue)" ;
VAL_ 2024 CommandSecondaryAirStatus 1 "Upstream" 2 "Downstream catalytic conv" 4 "From outside atmosphere/off" 8 "Pump cmd on for diagn." ;
VAL_ 2024 O2_B2S4_Supported 1 "Supported" 0 "Unsupported" ;
VAL_ 2024 OBDStandard 1 "OBD-II as defined by the CARB" 2 "OBD as defined by the EPA" 3 "OBD and OBD-II" 4 "OBD-I" 5 "Not OBD compliant" 6 "EOBD (Europe)" 7 "EOBD and OBD-II" 8 "EOBD and OBD" 9 "EOBD, OBD and OBD II" 10 "JOBD (Japan)" 11 "JOBD and OBD II" 12 "JOBD and EOBD" 13 "JOBD, EOBD, and OBD II" 14 "Reserved" 15 "Reserved" 16 "Reserved" 17 "Eng. Manu. Diag. (EMD)" 18 "EMD Enhanced (EMD+)" 19 "HD OBD-C" 20 "HD OBD" 21 "WWH OBD" 22 "Reserved" 23 "HD EOBD-I" 24 "HD EOBD-I N" 25 "HD EOBD-II" 26 "HD EOBD-II N" 27 "Reserved" 28 "OBDBr-1" 29 "OBDBr-2" 30 "KOBD" 31 "IOBD I" 32 "IOBD II" 33 "HD EOBD-IV" 34 "Reserved" 35 "Reserved" ;
VAL_ 2024 PID_39_Supported 1 "Supported" 0 "Unsupported" ;
VAL_ 2024 PID_59_Supported 1 "Supported" 0 "Unsupported" ;
VAL_ 2024 FuelType 0 "Not available" 1 "Gasoline" 2 "Methanol" 3 "Ethanol" 4 "Diesel" 5 "LPG" 6 "CNG" 7 "Propane" 8 "Electric" 9 "Bifuel running Gasoline" 10 "Bifuel running Methanol" 11 "Bifuel running Ethanol" 12 "Bifuel running LPG" 13 "Bifuel running CNG" 14 "Bifuel running Propane" 15 "Bifuel running Electricity" 16 "Bifuel electric/comb. eng." 17 "Hybrid gasoline" 18 "Hybrid Ethanol" 19 "Hybrid Diesel" 20 "Hybrid Electric" 21 "Hybrid running electric/comb." 22 "Hybrid Regenerative" 23 "Bifuel running diesel" ;
VAL_ 2024 EmissionRequirements 16 "Heavy Duty Vehicles (EURO EEV) C" 15 "Heavy Duty Vehicles (EURO V) B2" 14 "Heavy Duty Vehicles (EURO IV) B1" ;
VAL_ 2024 PID_79_Supported 1 "Supported" 0 "Unsupported" ;
VAL_ 2024 PID_99_Supported 1 "Supported" 0 "Unsupported" ;
VAL_ 2024 PID_B9_Supported 1 "Supported" 0 "Unsupported" ;
VAL_ 2024 PID_D9_Supported 1 "Supported" 0 "Unsupported" ;
VAL_ 2024 pid 0 "PIDsSupported_01_20" 1 "MonitorStatus" 2 "FreezeDTC" 3 "FuelSystemStatus" 4 "CalculatedEngineLoad" 5 "EngineCoolantTemp" 6 "ShortTermFuelTrim_B1_B3" 7 "LongTermFuelTrim_B1_B3" 8 "ShortTermFuelTrim_B2_B4" 9 "LongTermFuelTrim_B2_B4" 10 "FuelPressure" 11 "IntakeManifoldAbsolutePressure" 12 "EngineRPM" 13 "VehicleSpeed" 14 "TimingAdvance" 15 "IntakeAirTemp" 16 "MAFAirFlowRate" 17 "ThrottlePosition" 18 "CommandSecondaryAirStatus" 19 "OxygenSensorsSupported_B1_B2_S1_S2_S3_S4" 20 "O2_B1S1_Volt_STFT" 21 "O2_B1S2_Volt_STFT" 22 "O2_B1S3_Volt_STFT" 23 "O2_B1S4_Volt_STFT" 24 "O2_B2S1_Volt_STFT" 25 "O2_B2S2_Volt_STFT" 26 "O2_B2S3_Volt_STFT" 27 "O2_B2S4_Volt_STFT" 28 "OBDStandard" 29 "OxygenSensorsPresent2" 30 "PTOStatus" 31 "TimeSinceEngineStart" 32 "PIDsSupported_21_40" 33 "DistanceMILOn" 34 "FuelRailPressureRelativeToManifoldVacuum" 35 "FuelRailPressure" 36 "O2_B1S1_WB_Volt" 37 "O2_B1S2_WB_Volt" 38 "O2_B1S3_WB_Volt" 39 "O2_B1S4_WB_Volt" 40 "O2_B2S1_WB_Volt" 41 "O2_B2S2_WB_Volt" 42 "O2_B2S3_WB_Volt" 43 "O2_B2S4_WB_Volt" 44 "CommandEGR" 45 "EGRError" 46 "CommandEVAPPurge" 47 "FuelTankLevel" 48 "WarmUpsSinceCodeClear" 49 "DistanceSinceCodeClear" 50 "EVAPSystemVaporPressure" 51 "AbsoluteBarometricPressure" 52 "O2_B1S1_WB_Lambda_Current" 53 "O2_B1S2_WB_Lambda_Current" 54 "O2_B1S3_WB_Lambda_Current" 55 "O2_B1S4_WB_Lambda_Current" 56 "O2_B2S1_WB_Lambda_Current" 57 "O2_B2S2_WB_Lambda_Current" 58 "O2_B2S3_WB_Lambda_Current" 59 "O2_B2S4_WB_Lambda_Current" 60 "CatalystTemperature_B1S1" 61 "CatalystTemperature_B2S1" 62 "CatalystTemperature_B1S2" 63 "CatalystTemperature_B2S2" 64 "PIDsSupported_41_60" 65 "DriveCycleMonitorStatus" 66 "ControlModuleVolt" 67 "AbsoluteLoadValue" 68 "FuelAirCommandedLambda" 69 "RelativeThrottlePosition" 70 "AmbientAirTemp" 71 "AbsoluteThrottlePositionB" 72 "AbsoluteThrottlePositionC" 73 "AbsoluteThrottlePositionD" 74 "AbsoluteThrottlePositionE" 75 "AbsoluteThrottlePositionF" 76 "CommandThrottleActuator" 77 "TimeRunMILOn" 78 "TimeSinceCodeClear" 79 "MaximumValues_EQ_O2Volt_O2Current_IntakeABS" 80 "MaximumValueForMassAirFlowSensor" 81 "FuelType" 82 "EthanolFuelPct" 83 "AbsoluteEVAPSystemVaporPressure" 84 "EvapSysVapPres" 85 "ShortSecOxyTrimBankX" 86 "LongSecOxyTrimBankX" 87 "O2Secondary_ShortTermFuelTrim_B1_B2_B3_B4" 88 "O2Secondary_LongTermFuelTrim_B1_B2_B3_B4" 89 "FuelRailPressureAbsolute" 90 "RelativeAcceleratorPedalPosition" 91 "HybridBattteryPackRemainingLife" 92 "EngineOilTemp" 93 "FuelInjectionTiming" 94 "EngineFuelRate" 95 "EmissionRequirements" 96 "PIDsSupported_61_80" 97 "EngineTorqueDemand" 98 "EngineTorque" 99 "EngineTorqueReference" 100 "EngineTorquePoint" 101 "AuxInputOutput" 102 "MAFSensorAB" 103 "EngineCoolantTemp AB" 104 "IntakeAirTempSensors" 105 "CmdEGR_EGRError" 106 "CmdDieselIntAir" 107 "ExhaustGasTemp" 108 "CommandThrottleActuatorRelative" 109 "FuelPresContrSys" 110 "InjPresContrSys" 111 "TurboCompressorPressure" 112 "BoostPresCntrl" 113 "TurboVGTControl" 114 "WastegateControl" 115 "ExhaustPressure" 116 "TurbochargerRpm" 117 "TurbochargerTemp1" 118 "TurbochargerTemp2" 119 "CACTemp" 120 "EGTBank1" 121 "EGTBank2" 122 "DPF1" 123 "DPF2" 124 "DPFTemp" 125 "NOxNTE" 126 "PMNTE" 127 "EngineRunTime" 128 "PIDsSupported_81_A0" 129 "AECDEngineRuntime1" 130 "AECDEngineRuntime2" 131 "NOxConcentration" 132 "IntakeManifoldSurfaceTemperature" 133 "NOxReagentSystem" 134 "PMConcentration" 135 "IntakeManifoldAbsolutePressureAB" 136 "SCRInduceSystem" 137 "AECDRuntime_11_15" 138 "AECDRuntime_16_20" 139 "DieselTreatment" 140 "O2WideRange" 141 "ThrottlePositionG" 142 "EngineFrictionTorque" 143 "PMSensor1&2" 144 "WWHOBDSystemInfo1" 145 "WWHOBDSystemInfo2" 146 "FuelSystemControl" 147 "WWHOBDCounterSupport" 148 "NOxWarningSystem" 152 "ExhaustGasTemp1" 153 "ExhaustGasTemp2" 154 "EVHybridVehSysData" 155 "DieselEFData" 156 "O2SensorData" 157 "FuelRate" 158 "ExhaustFlowRate" 159 "FuelSystemUse" 160 "PIDsSupported_A1_C0" 161 "NOxCorrectedData" 162 "CylinderFuelRate" 163 "EVAPSysPress" 164 "TransmissionGear" 165 "DieselEFD" 166 "Odometer" 192 "PIDsSupported_C1_E0" ;
VAL_ 2024 ParameterID_Service02 2 "S2_PID_02_FreezeDTC" ;
VAL_ 2024 mode 10 "Permanent DTCs (Cleared DTCs)" 9 "Request vehicle information" 8 "Control on-board system" 7 "Show pending DTCs" 6 "Other system monitoring" 5 "Oxygen sensor monitoring" 4 "Clear DTCs and stored values" 3 "Show stored DTCs" 2 "Show freeze frame data" 1 "Live Data" ;

SG_MUL_VAL_ 2015 EGR_B_CommandedDutyCyclePosition pid 105-105;
SG_MUL_VAL_ 2015 IAT_B2S1 pid 104-104;
SG_MUL_VAL_ 2015 EngineTorquePoint4 pid 100-100;
SG_MUL_VAL_ 2015 PID_08_Supported pid 0-0;
SG_MUL_VAL_ 2015 PID_28_Supported pid 32-32;
SG_MUL_VAL_ 2015 PID_48_Supported pid 64-64;
SG_MUL_VAL_ 2015 Cat_NMHCCatMonitorStatus pid 65-65;
SG_MUL_VAL_ 2015 PID_68_Supported pid 96-96;
SG_MUL_VAL_ 2015 PID_88_Supported pid 128-128;
SG_MUL_VAL_ 2015 PID_A8_Supported pid 160-160;
SG_MUL_VAL_ 2015 PID_C8_Supported pid 192-192;
SG_MUL_VAL_ 2015 PID_07_Supported pid 0-0;
SG_MUL_VAL_ 2015 PID_27_Supported pid 32-32;
SG_MUL_VAL_ 2015 PID_47_Supported pid 64-64;
SG_MUL_VAL_ 2015 HeatedCat_NOxSCRMonitorStatus pid 65-65;
SG_MUL_VAL_ 2015 PID_67_Supported pid 96-96;
SG_MUL_VAL_ 2015 PID_87_Supported pid 128-128;
SG_MUL_VAL_ 2015 PID_A7_Supported pid 160-160;
SG_MUL_VAL_ 2015 PID_C7_Supported pid 192-192;
SG_MUL_VAL_ 2015 PID_06_Supported pid 0-0;
SG_MUL_VAL_ 2015 PID_26_Supported pid 32-32;
SG_MUL_VAL_ 2015 PID_46_Supported pid 64-64;
SG_MUL_VAL_ 2015 EvapMonitorStatus pid 65-65;
SG_MUL_VAL_ 2015 PID_66_Supported pid 96-96;
SG_MUL_VAL_ 2015 PID_86_Supported pid 128-128;
SG_MUL_VAL_ 2015 PID_A6_Supported pid 160-160;
SG_MUL_VAL_ 2015 PID_C6_Supported pid 192-192;
SG_MUL_VAL_ 2015 PID_05_Supported pid 0-0;
SG_MUL_VAL_ 2015 PID_25_Supported pid 32-32;
SG_MUL_VAL_ 2015 PID_45_Supported pid 64-64;
SG_MUL_VAL_ 2015 SecondaryAir_BoostPressureMonito pid 65-65;
SG_MUL_VAL_ 2015 PID_65_Supported pid 96-96;
SG_MUL_VAL_ 2015 PID_85_Supported pid 128-128;
SG_MUL_VAL_ 2015 PID_A5_Supported pid 160-160;
SG_MUL_VAL_ 2015 PID_C5_Supported pid 192-192;
SG_MUL_VAL_ 2015 PID_04_Supported pid 0-0;
SG_MUL_VAL_ 2015 PID_24_Supported pid 32-32;
SG_MUL_VAL_ 2015 PID_44_Supported pid 64-64;
SG_MUL_VAL_ 2015 PID_64_Supported pid 96-96;
SG_MUL_VAL_ 2015 PID_84_Supported pid 128-128;
SG_MUL_VAL_ 2015 PID_A4_Supported pid 160-160;
SG_MUL_VAL_ 2015 PID_C4_Supported pid 192-192;
SG_MUL_VAL_ 2015 PID_03_Supported pid 0-0;
SG_MUL_VAL_ 2015 PID_23_Supported pid 32-32;
SG_MUL_VAL_ 2015 PID_43_Supported pid 64-64;
SG_MUL_VAL_ 2015 O2_ExhaustGasMonitorStatus pid 65-65;
SG_MUL_VAL_ 2015 PID_63_Supported pid 96-96;
SG_MUL_VAL_ 2015 PID_83_Supported pid 128-128;
SG_MUL_VAL_ 2015 PID_A3_Supported pid 160-160;
SG_MUL_VAL_ 2015 PID_C3_Supported pid 192-192;
SG_MUL_VAL_ 2015 PID_02_Supported pid 0-0;
SG_MUL_VAL_ 2015 PID_22_Supported pid 32-32;
SG_MUL_VAL_ 2015 PID_42_Supported pid 64-64;
SG_MUL_VAL_ 2015 O2_PMFilterMonitorStatus pid 65-65;
SG_MUL_VAL_ 2015 PID_62_Supported pid 96-96;
SG_MUL_VAL_ 2015 PID_82_Supported pid 128-128;
SG_MUL_VAL_ 2015 PID_A2_Supported pid 160-160;
SG_MUL_VAL_ 2015 PID_C2_Supported pid 192-192;
SG_MUL_VAL_ 2015 EGR_A_Error pid 105-105;
SG_MUL_VAL_ 2015 IAT_B1S3 pid 104-104;
SG_MUL_VAL_ 2015 MAFSensorB pid 102-102;
SG_MUL_VAL_ 2015 MaximumValueForIntakeManifoldAbs pid 79-79;
SG_MUL_VAL_ 2015 PID_01_Supported pid 0-0;
SG_MUL_VAL_ 2015 PID_21_Supported pid 32-32;
SG_MUL_VAL_ 2015 PID_41_Supported pid 64-64;
SG_MUL_VAL_ 2015 EGR_VVTMonitorStatus pid 65-65;
SG_MUL_VAL_ 2015 PID_61_Supported pid 96-96;
SG_MUL_VAL_ 2015 EngineTorquePoint3 pid 100-100;
SG_MUL_VAL_ 2015 PID_81_Supported pid 128-128;
SG_MUL_VAL_ 2015 NOxConcentrationB1S2 pid 131-131;
SG_MUL_VAL_ 2015 NOxAvgDemReagentConsumption pid 133-133;
SG_MUL_VAL_ 2015 PMConcentration_B2S1 pid 134-134;
SG_MUL_VAL_ 2015 IntakeManifoldAbsolutePressureB pid 135-135;
SG_MUL_VAL_ 2015 PID_A1_Supported pid 160-160;
SG_MUL_VAL_ 2015 PID_C1_Supported pid 192-192;
SG_MUL_VAL_ 2015 PID_10_Supported pid 0-0;
SG_MUL_VAL_ 2015 PID_30_Supported pid 32-32;
SG_MUL_VAL_ 2015 PID_50_Supported pid 64-64;
SG_MUL_VAL_ 2015 Cat_NMHCCatMonitorEnabled pid 65-65;
SG_MUL_VAL_ 2015 PID_70_Supported pid 96-96;
SG_MUL_VAL_ 2015 PID_90_Supported pid 128-128;
SG_MUL_VAL_ 2015 PID_B0_Supported pid 160-160;
SG_MUL_VAL_ 2015 PID_D0_Supported pid 192-192;
SG_MUL_VAL_ 2015 PID_0F_Supported pid 0-0;
SG_MUL_VAL_ 2015 PID_2F_Supported pid 32-32;
SG_MUL_VAL_ 2015 PID_4F_Supported pid 64-64;
SG_MUL_VAL_ 2015 HeatedCat_NOxSCRMonitorEnabled pid 65-65;
SG_MUL_VAL_ 2015 PID_6F_Supported pid 96-96;
SG_MUL_VAL_ 2015 PID_8F_Supported pid 128-128;
SG_MUL_VAL_ 2015 PID_AF_Supported pid 160-160;
SG_MUL_VAL_ 2015 PID_CF_Supported pid 192-192;
SG_MUL_VAL_ 2015 PID_0E_Supported pid 0-0;
SG_MUL_VAL_ 2015 PID_2E_Supported pid 32-32;
SG_MUL_VAL_ 2015 PID_4E_Supported pid 64-64;
SG_MUL_VAL_ 2015 EvapMonitorEnabled pid 65-65;
SG_MUL_VAL_ 2015 PID_6E_Supported pid 96-96;
SG_MUL_VAL_ 2015 PID_8E_Supported pid 128-128;
SG_MUL_VAL_ 2015 PID_AE_Supported pid 160-160;
SG_MUL_VAL_ 2015 PID_CE_Supported pid 192-192;
SG_MUL_VAL_ 2015 PID_0D_Supported pid 0-0;
SG_MUL_VAL_ 2015 PID_2D_Supported pid 32-32;
SG_MUL_VAL_ 2015 PID_4D_Supported pid 64-64;
SG_MUL_VAL_ 2015 SecondaryAir_BoostPressureM_0000 pid 65-65;
SG_MUL_VAL_ 2015 PID_6D_Supported pid 96-96;
SG_MUL_VAL_ 2015 PID_8D_Supported pid 128-128;
SG_MUL_VAL_ 2015 PID_AD_Supported pid 160-160;
SG_MUL_VAL_ 2015 PID_CD_Supported pid 192-192;
SG_MUL_VAL_ 2015 PID_0C_Supported pid 0-0;
SG_MUL_VAL_ 2015 PID_2C_Supported pid 32-32;
SG_MUL_VAL_ 2015 PID_4C_Supported pid 64-64;
SG_MUL_VAL_ 2015 PID_6C_Supported pid 96-96;
SG_MUL_VAL_ 2015 PID_8C_Supported pid 128-128;
SG_MUL_VAL_ 2015 PID_AC_Supported pid 160-160;
SG_MUL_VAL_ 2015 PID_CC_Supported pid 192-192;
SG_MUL_VAL_ 2015 PID_0B_Supported pid 0-0;
SG_MUL_VAL_ 2015 PID_2B_Supported pid 32-32;
SG_MUL_VAL_ 2015 PID_4B_Supported pid 64-64;
SG_MUL_VAL_ 2015 O2_ExhaustGasMonitorEnabled pid 65-65;
SG_MUL_VAL_ 2015 PID_6B_Supported pid 96-96;
SG_MUL_VAL_ 2015 PID_8B_Supported pid 128-128;
SG_MUL_VAL_ 2015 PID_AB_Supported pid 160-160;
SG_MUL_VAL_ 2015 PID_CB_Supported pid 192-192;
SG_MUL_VAL_ 2015 PID_0A_Supported pid 0-0;
SG_MUL_VAL_ 2015 PID_2A_Supported pid 32-32;
SG_MUL_VAL_ 2015 PID_4A_Supported pid 64-64;
SG_MUL_VAL_ 2015 O2Heater_PMFilterMonitorEnabled pid 65-65;
SG_MUL_VAL_ 2015 PID_6A_Supported pid 96-96;
SG_MUL_VAL_ 2015 PID_8A_Supported pid 128-128;
SG_MUL_VAL_ 2015 PID_AA_Supported pid 160-160;
SG_MUL_VAL_ 2015 PID_CA_Supported pid 192-192;
SG_MUL_VAL_ 2015 EGR_A_DutyCyclePosition pid 105-105;
SG_MUL_VAL_ 2015 IAT_B1S2 pid 104-104;
SG_MUL_VAL_ 2015 ECTSensorB pid 103-103;
SG_MUL_VAL_ 2015 MaximumValueForOxygenSensorCurre pid 79-79;
SG_MUL_VAL_ 2015 PID_09_Supported pid 0-0;
SG_MUL_VAL_ 2015 PID_29_Supported pid 32-32;
SG_MUL_VAL_ 2015 O2_B1S1_WB_Volt pid 36-36;
SG_MUL_VAL_ 2015 O2_B1S2_WB_Volt pid 37-37;
SG_MUL_VAL_ 2015 O2_B1S3_WB_Volt pid 38-38;
SG_MUL_VAL_ 2015 O2_B1S4_WB_Volt pid 39-39;
SG_MUL_VAL_ 2015 O2_B2S1_WB_Volt pid 40-40;
SG_MUL_VAL_ 2015 O2_B2S2_WB_Volt pid 41-41;
SG_MUL_VAL_ 2015 O2_B2S3_WB_Volt pid 42-42;
SG_MUL_VAL_ 2015 O2_B2S4_WB_Volt pid 43-43;
SG_MUL_VAL_ 2015 O2_B1S1_WB_Current pid 52-52;
SG_MUL_VAL_ 2015 O2_B1S2_WB_Current pid 53-53;
SG_MUL_VAL_ 2015 O2_B1S3_WB_Current pid 54-54;
SG_MUL_VAL_ 2015 O2_B1S4_WB_Current pid 55-55;
SG_MUL_VAL_ 2015 O2_B2S1_WB_Current pid 56-56;
SG_MUL_VAL_ 2015 O2_B2S2_WB_Current pid 57-57;
SG_MUL_VAL_ 2015 O2_B2S3_WB_Current pid 58-58;
SG_MUL_VAL_ 2015 O2_B2S4_WB_Current pid 59-59;
SG_MUL_VAL_ 2015 PID_49_Supported pid 64-64;
SG_MUL_VAL_ 2015 EGR_VVTSystemMonitorEnabled pid 65-65;
SG_MUL_VAL_ 2015 PID_69_Supported pid 96-96;
SG_MUL_VAL_ 2015 EngineTorquePoint2 pid 100-100;
SG_MUL_VAL_ 2015 PID_89_Supported pid 128-128;
SG_MUL_VAL_ 2015 PID_A9_Supported pid 160-160;
SG_MUL_VAL_ 2015 PID_C9_Supported pid 192-192;
SG_MUL_VAL_ 2015 PTOStatus2 pid 101-101;
SG_MUL_VAL_ 2015 PID_18_Supported pid 0-0;
SG_MUL_VAL_ 2015 PID_38_Supported pid 32-32;
SG_MUL_VAL_ 2015 PID_58_Supported pid 64-64;
SG_MUL_VAL_ 2015 MisfireMonitorEnabled pid 65-65;
SG_MUL_VAL_ 2015 PID_78_Supported pid 96-96;
SG_MUL_VAL_ 2015 PID_98_Supported pid 128-128;
SG_MUL_VAL_ 2015 PID_B8_Supported pid 160-160;
SG_MUL_VAL_ 2015 PID_D8_Supported pid 192-192;
SG_MUL_VAL_ 2015 AutomaticTransmissionGearStatus pid 101-101;
SG_MUL_VAL_ 2015 PID_17_Supported pid 0-0;
SG_MUL_VAL_ 2015 PID_37_Supported pid 32-32;
SG_MUL_VAL_ 2015 PID_57_Supported pid 64-64;
SG_MUL_VAL_ 2015 FuelSystemMonitorEnabled pid 65-65;
SG_MUL_VAL_ 2015 PID_77_Supported pid 96-96;
SG_MUL_VAL_ 2015 PID_97_Supported pid 128-128;
SG_MUL_VAL_ 2015 PID_B7_Supported pid 160-160;
SG_MUL_VAL_ 2015 PID_D7_Supported pid 192-192;
SG_MUL_VAL_ 2015 ManualTransmissionGearStatus pid 101-101;
SG_MUL_VAL_ 2015 PID_16_Supported pid 0-0;
SG_MUL_VAL_ 2015 PID_36_Supported pid 32-32;
SG_MUL_VAL_ 2015 PID_56_Supported pid 64-64;
SG_MUL_VAL_ 2015 CompComponentMonitorEnabled pid 65-65;
SG_MUL_VAL_ 2015 PID_76_Supported pid 96-96;
SG_MUL_VAL_ 2015 PID_96_Supported pid 128-128;
SG_MUL_VAL_ 2015 PID_B6_Supported pid 160-160;
SG_MUL_VAL_ 2015 PID_D6_Supported pid 192-192;
SG_MUL_VAL_ 2015 GlowPlugLampStatus pid 101-101;
SG_MUL_VAL_ 2015 PID_15_Supported pid 0-0;
SG_MUL_VAL_ 2015 PID_35_Supported pid 32-32;
SG_MUL_VAL_ 2015 PID_55_Supported pid 64-64;
SG_MUL_VAL_ 2015 IgnitionMonitorType pid 65-65;
SG_MUL_VAL_ 2015 PID_75_Supported pid 96-96;
SG_MUL_VAL_ 2015 PID_95_Supported pid 128-128;
SG_MUL_VAL_ 2015 PID_B5_Supported pid 160-160;
SG_MUL_VAL_ 2015 PID_D5_Supported pid 192-192;
SG_MUL_VAL_ 2015 PID_14_Supported pid 0-0;
SG_MUL_VAL_ 2015 PID_34_Supported pid 32-32;
SG_MUL_VAL_ 2015 PID_54_Supported pid 64-64;
SG_MUL_VAL_ 2015 MisfireMonitorStatus pid 65-65;
SG_MUL_VAL_ 2015 PID_74_Supported pid 96-96;
SG_MUL_VAL_ 2015 PID_94_Supported pid 128-128;
SG_MUL_VAL_ 2015 PID_B4_Supported pid 160-160;
SG_MUL_VAL_ 2015 PID_D4_Supported pid 192-192;
SG_MUL_VAL_ 2015 PID_13_Supported pid 0-0;
SG_MUL_VAL_ 2015 PID_33_Supported pid 32-32;
SG_MUL_VAL_ 2015 PID_53_Supported pid 64-64;
SG_MUL_VAL_ 2015 FuelSystemMonitorStatus pid 65-65;
SG_MUL_VAL_ 2015 PID_73_Supported pid 96-96;
SG_MUL_VAL_ 2015 PID_93_Supported pid 128-128;
SG_MUL_VAL_ 2015 PID_B3_Supported pid 160-160;
SG_MUL_VAL_ 2015 PID_D3_Supported pid 192-192;
SG_MUL_VAL_ 2015 PID_12_Supported pid 0-0;
SG_MUL_VAL_ 2015 PID_32_Supported pid 32-32;
SG_MUL_VAL_ 2015 PID_52_Supported pid 64-64;
SG_MUL_VAL_ 2015 CompComponentMonitorStatus pid 65-65;
SG_MUL_VAL_ 2015 PID_72_Supported pid 96-96;
SG_MUL_VAL_ 2015 PID_92_Supported pid 128-128;
SG_MUL_VAL_ 2015 PID_B2_Supported pid 160-160;
SG_MUL_VAL_ 2015 PID_D2_Supported pid 192-192;
SG_MUL_VAL_ 2015 EGR_A_CommandedDutyCyclePosition pid 105-105;
SG_MUL_VAL_ 2015 IAT_B1S1 pid 104-104;
SG_MUL_VAL_ 2015 ECTSensorA pid 103-103;
SG_MUL_VAL_ 2015 MAFSensorA pid 102-102;
SG_MUL_VAL_ 2015 MaximumValueForOxygenSensorVolta pid 79-79;
SG_MUL_VAL_ 2015 PID_11_Supported pid 0-0;
SG_MUL_VAL_ 2015 FuelSystem2Status pid 3-3;
SG_MUL_VAL_ 2015 ShortTermFuelTrim_B3 pid 6-6;
SG_MUL_VAL_ 2015 LongTermFuelTrim_B3 pid 7-7;
SG_MUL_VAL_ 2015 ShortTermFuelTrim_B4 pid 8-8;
SG_MUL_VAL_ 2015 LongTermFuelTrim_B4 pid 9-9;
SG_MUL_VAL_ 2015 O2_B1S1_ShortTermFuelTrim pid 20-20;
SG_MUL_VAL_ 2015 O2_B1S2_ShortTermFuelTrim pid 21-21;
SG_MUL_VAL_ 2015 O2_B1S3_ShortTermFuelTrim pid 22-22;
SG_MUL_VAL_ 2015 O2_B1S4_ShortTermFuelTrim pid 23-23;
SG_MUL_VAL_ 2015 O2_B2S1_ShortTermFuelTrim pid 24-24;
SG_MUL_VAL_ 2015 O2_B2S2_ShortTermFuelTrim pid 25-25;
SG_MUL_VAL_ 2015 O2_B2S3_ShortTermFuelTrim pid 26-26;
SG_MUL_VAL_ 2015 O2_B2S4_ShortTermFuelTrim pid 27-27;
SG_MUL_VAL_ 2015 PID_31_Supported pid 32-32;
SG_MUL_VAL_ 2015 PID_51_Supported pid 64-64;
SG_MUL_VAL_ 2015 O2Secondary_B3_ShortTermFuelTrim pid 85-85;
SG_MUL_VAL_ 2015 O2Secondary_B3_LongTermFuelTrim pid 86-86;
SG_MUL_VAL_ 2015 O2Secondary_B4_ShortTermFuelTrim pid 87-87;
SG_MUL_VAL_ 2015 O2Secondary_B4_LongTermFuelTrim pid 88-88;
SG_MUL_VAL_ 2015 PID_71_Supported pid 96-96;
SG_MUL_VAL_ 2015 EngineTorquePoint1 pid 100-100;
SG_MUL_VAL_ 2015 PID_91_Supported pid 128-128;
SG_MUL_VAL_ 2015 NOxConcentrationB1S1 pid 131-131;
SG_MUL_VAL_ 2015 NOxAvgReagentConsumption pid 133-133;
SG_MUL_VAL_ 2015 PMConcentration_B1S1 pid 134-134;
SG_MUL_VAL_ 2015 IntakeManifoldAbsolutePressureA pid 135-135;
SG_MUL_VAL_ 2015 PID_B1_Supported pid 160-160;
SG_MUL_VAL_ 2015 PID_D1_Supported pid 192-192;
SG_MUL_VAL_ 2015 IAT_B1S1_Support pid 104-104;
SG_MUL_VAL_ 2015 ECTSensorASupport pid 103-103;
SG_MUL_VAL_ 2015 MAFSensorASupport pid 102-102;
SG_MUL_VAL_ 2015 PTOStatus2Support pid 101-101;
SG_MUL_VAL_ 2015 PID_20_Supported pid 0-0;
SG_MUL_VAL_ 2015 O2_B1S1_Supported pid 19-19;
SG_MUL_VAL_ 2015 PTOStatus pid 30-30;
SG_MUL_VAL_ 2015 PID_40_Supported pid 32-32;
SG_MUL_VAL_ 2015 PID_60_Supported pid 64-64;
SG_MUL_VAL_ 2015 PID_80_Supported pid 96-96;
SG_MUL_VAL_ 2015 PID_A0_Supported pid 128-128;
SG_MUL_VAL_ 2015 NOxConcentrationB1S1Supported pid 131-131;
SG_MUL_VAL_ 2015 NOxReagentSupported pid 133-133;
SG_MUL_VAL_ 2015 PMConcentration_B1S1_Supported pid 134-134;
SG_MUL_VAL_ 2015 PID_C0_Supported pid 160-160;
SG_MUL_VAL_ 2015 PID_E0_Supported pid 192-192;
SG_MUL_VAL_ 2015 EGR_A_DutyCyclePositionSupport pid 105-105;
SG_MUL_VAL_ 2015 IAT_B1S2_Support pid 104-104;
SG_MUL_VAL_ 2015 ECTSensorBSupport pid 103-103;
SG_MUL_VAL_ 2015 MAFSensorBSupport pid 102-102;
SG_MUL_VAL_ 2015 AutomaticTransmissionGearStatusS pid 101-101;
SG_MUL_VAL_ 2015 PID_1F_Supported pid 0-0;
SG_MUL_VAL_ 2015 O2_B1S2_Supported pid 19-19;
SG_MUL_VAL_ 2015 PID_3F_Supported pid 32-32;
SG_MUL_VAL_ 2015 PID_5F_Supported pid 64-64;
SG_MUL_VAL_ 2015 PID_7F_Supported pid 96-96;
SG_MUL_VAL_ 2015 PID_9F_Supported pid 128-128;
SG_MUL_VAL_ 2015 NOxConcentrationB1S2Supported pid 131-131;
SG_MUL_VAL_ 2015 NOxReagentDemandedSupported pid 133-133;
SG_MUL_VAL_ 2015 PMConcentration_B2S1_Supported pid 134-134;
SG_MUL_VAL_ 2015 IntakeManifoldAbsolutePressureSu pid 135-135;
SG_MUL_VAL_ 2015 PID_BF_Supported pid 160-160;
SG_MUL_VAL_ 2015 PID_DF_Supported pid 192-192;
SG_MUL_VAL_ 2015 EGR_A_ErrorSupport pid 105-105;
SG_MUL_VAL_ 2015 IAT_B1S3_Support pid 104-104;
SG_MUL_VAL_ 2015 ManualTransmissionGearStatusSupp pid 101-101;
SG_MUL_VAL_ 2015 PID_1E_Supported pid 0-0;
SG_MUL_VAL_ 2015 O2_B1S3_Supported pid 19-19;
SG_MUL_VAL_ 2015 PID_3E_Supported pid 32-32;
SG_MUL_VAL_ 2015 PID_5E_Supported pid 64-64;
SG_MUL_VAL_ 2015 PID_7E_Supported pid 96-96;
SG_MUL_VAL_ 2015 PID_9E_Supported pid 128-128;
SG_MUL_VAL_ 2015 NOxConcentrationB2S1Supported pid 131-131;
SG_MUL_VAL_ 2015 NOxReagentLevelSupported pid 133-133;
SG_MUL_VAL_ 2015 PID_BE_Supported pid 160-160;
SG_MUL_VAL_ 2015 PID_DE_Supported pid 192-192;
SG_MUL_VAL_ 2015 IAT_B2S1_Support pid 104-104;
SG_MUL_VAL_ 2015 GlowPlugLampStatusSupport pid 101-101;
SG_MUL_VAL_ 2015 PID_1D_Supported pid 0-0;
SG_MUL_VAL_ 2015 O2_B1S4_Supported pid 19-19;
SG_MUL_VAL_ 2015 PID_3D_Supported pid 32-32;
SG_MUL_VAL_ 2015 PID_5D_Supported pid 64-64;
SG_MUL_VAL_ 2015 PID_7D_Supported pid 96-96;
SG_MUL_VAL_ 2015 PID_9D_Supported pid 128-128;
SG_MUL_VAL_ 2015 NOxConcentrationB2S2Supported pid 131-131;
SG_MUL_VAL_ 2015 NOxRuntimeWarningSupported pid 133-133;
SG_MUL_VAL_ 2015 PID_BD_Supported pid 160-160;
SG_MUL_VAL_ 2015 PID_DD_Supported pid 192-192;
SG_MUL_VAL_ 2015 EGR_B_DutyCyclePositionSupport pid 105-105;
SG_MUL_VAL_ 2015 IAT_B2S2_Support pid 104-104;
SG_MUL_VAL_ 2015 PID_1C_Supported pid 0-0;
SG_MUL_VAL_ 2015 O2_B2S1_Supported pid 19-19;
SG_MUL_VAL_ 2015 PID_3C_Supported pid 32-32;
SG_MUL_VAL_ 2015 PID_5C_Supported pid 64-64;
SG_MUL_VAL_ 2015 PID_7C_Supported pid 96-96;
SG_MUL_VAL_ 2015 PID_9C_Supported pid 128-128;
SG_MUL_VAL_ 2015 PID_BC_Supported pid 160-160;
SG_MUL_VAL_ 2015 PID_DC_Supported pid 192-192;
SG_MUL_VAL_ 2015 EGR_B_ErrorSupport pid 105-105;
SG_MUL_VAL_ 2015 IAT_B2S3_Support pid 104-104;
SG_MUL_VAL_ 2015 PID_1B_Supported pid 0-0;
SG_MUL_VAL_ 2015 O2_B2S2_Supported pid 19-19;
SG_MUL_VAL_ 2015 PID_3B_Supported pid 32-32;
SG_MUL_VAL_ 2015 PID_5B_Supported pid 64-64;
SG_MUL_VAL_ 2015 PID_7B_Supported pid 96-96;
SG_MUL_VAL_ 2015 PID_9B_Supported pid 128-128;
SG_MUL_VAL_ 2015 PID_BB_Supported pid 160-160;
SG_MUL_VAL_ 2015 PID_DB_Supported pid 192-192;
SG_MUL_VAL_ 2015 PID_1A_Supported pid 0-0;
SG_MUL_VAL_ 2015 O2_B2S3_Supported pid 19-19;
SG_MUL_VAL_ 2015 PID_3A_Supported pid 32-32;
SG_MUL_VAL_ 2015 PID_5A_Supported pid 64-64;
SG_MUL_VAL_ 2015 PID_7A_Supported pid 96-96;
SG_MUL_VAL_ 2015 PID_9A_Supported pid 128-128;
SG_MUL_VAL_ 2015 PID_BA_Supported pid 160-160;
SG_MUL_VAL_ 2015 PID_DA_Supported pid 192-192;
SG_MUL_VAL_ 2015 MaximumValueForMassAirFlowSensor pid 80-80;
SG_MUL_VAL_ 2015 MaximumValueForEquivalenceRatio pid 79-79;
SG_MUL_VAL_ 2015 PID_19_Supported pid 0-0;
SG_MUL_VAL_ 2015 MonitorStatus pid 1-1;
SG_MUL_VAL_ 2015 FreezeDTC pid 2-2;
SG_MUL_VAL_ 2015 FuelSystem1Status pid 3-3;
SG_MUL_VAL_ 2015 CalculatedEngineLoad pid 4-4;
SG_MUL_VAL_ 2015 EngineCoolantTemp pid 5-5;
SG_MUL_VAL_ 2015 ShortTermFuelTrim_B1 pid 6-6;
SG_MUL_VAL_ 2015 LongTermFuelTrim_B1 pid 7-7;
SG_MUL_VAL_ 2015 ShortTermFuelTrim_B2 pid 8-8;
SG_MUL_VAL_ 2015 LongTermFuelTrim_B2 pid 9-9;
SG_MUL_VAL_ 2015 FuelPressure pid 10-10;
SG_MUL_VAL_ 2015 IntakeManifoldAbsolutePressure pid 11-11;
SG_MUL_VAL_ 2015 EngineRPM pid 12-12;
SG_MUL_VAL_ 2015 VehicleSpeed pid 13-13;
SG_MUL_VAL_ 2015 TimingAdvance pid 14-14;
SG_MUL_VAL_ 2015 IntakeAirTemp pid 15-15;
SG_MUL_VAL_ 2015 MAFAirFlowRate pid 16-16;
SG_MUL_VAL_ 2015 ThrottlePosition pid 17-17;
SG_MUL_VAL_ 2015 CommandSecondaryAirStatus pid 18-18;
SG_MUL_VAL_ 2015 O2_B2S4_Supported pid 19-19;
SG_MUL_VAL_ 2015 O2_B1S1_Volt pid 20-20;
SG_MUL_VAL_ 2015 O2_B1S2_Volt pid 21-21;
SG_MUL_VAL_ 2015 O2_B1S3_Volt pid 22-22;
SG_MUL_VAL_ 2015 O2_B1S4_Volt pid 23-23;
SG_MUL_VAL_ 2015 O2_B2S1_Volt pid 24-24;
SG_MUL_VAL_ 2015 O2_B2S2_Volt pid 25-25;
SG_MUL_VAL_ 2015 O2_B2S3_Volt pid 26-26;
SG_MUL_VAL_ 2015 O2_B2S4_Volt pid 27-27;
SG_MUL_VAL_ 2015 OBDStandard pid 28-28;
SG_MUL_VAL_ 2015 TimeSinceEngineStart pid 31-31;
SG_MUL_VAL_ 2015 PID_39_Supported pid 32-32;
SG_MUL_VAL_ 2015 DistanceMILOn pid 33-33;
SG_MUL_VAL_ 2015 FuelRailPressureRelativeToManifo pid 34-34;
SG_MUL_VAL_ 2015 FuelRailPressure pid 35-35;
SG_MUL_VAL_ 2015 CommandEGR pid 44-44;
SG_MUL_VAL_ 2015 EGRError pid 45-45;
SG_MUL_VAL_ 2015 CommandEVAPPurge pid 46-46;
SG_MUL_VAL_ 2015 FuelTankLevel pid 47-47;
SG_MUL_VAL_ 2015 WarmUpsSinceCodeClear pid 48-48;
SG_MUL_VAL_ 2015 DistanceSinceCodeClear pid 49-49;
SG_MUL_VAL_ 2015 EVAPSystemVaporPressure pid 50-50;
SG_MUL_VAL_ 2015 AbsoluteBarometricPressure pid 51-51;
SG_MUL_VAL_ 2015 O2_B1S1_WB_Lambda pid 52-52;
SG_MUL_VAL_ 2015 O2_B1S2_WB_Lambda pid 53-53;
SG_MUL_VAL_ 2015 O2_B1S3_WB_Lambda pid 54-54;
SG_MUL_VAL_ 2015 O2_B1S4_WB_Lambda pid 55-55;
SG_MUL_VAL_ 2015 O2_B2S1_WB_Lambda pid 56-56;
SG_MUL_VAL_ 2015 O2_B2S2_WB_Lambda pid 57-57;
SG_MUL_VAL_ 2015 O2_B2S3_WB_Lambda pid 58-58;
SG_MUL_VAL_ 2015 O2_B2S4_WB_Lambda pid 59-59;
SG_MUL_VAL_ 2015 CatalystTemperature_B1S1 pid 60-60;
SG_MUL_VAL_ 2015 CatalystTemperature_B2S1 pid 61-61;
SG_MUL_VAL_ 2015 CatalystTemperature_B1S2 pid 62-62;
SG_MUL_VAL_ 2015 CatalystTemperature_B2S2 pid 63-63;
SG_MUL_VAL_ 2015 PID_59_Supported pid 64-64;
SG_MUL_VAL_ 2015 ControlModuleVolt pid 66-66;
SG_MUL_VAL_ 2015 AbsoluteLoadValue pid 67-67;
SG_MUL_VAL_ 2015 FuelAirCommandedLambda pid 68-68;
SG_MUL_VAL_ 2015 RelativeThrottlePosition pid 69-69;
SG_MUL_VAL_ 2015 AmbientAirTemp pid 70-70;
SG_MUL_VAL_ 2015 AbsoluteThrottlePositionB pid 71-71;
SG_MUL_VAL_ 2015 AbsoluteThrottlePositionC pid 72-72;
SG_MUL_VAL_ 2015 AbsoluteThrottlePositionD pid 73-73;
SG_MUL_VAL_ 2015 AbsoluteThrottlePositionE pid 74-74;
SG_MUL_VAL_ 2015 AbsoluteThrottlePositionF pid 75-75;
SG_MUL_VAL_ 2015 CommandThrottleActuator pid 76-76;
SG_MUL_VAL_ 2015 TimeRunMILOn pid 77-77;
SG_MUL_VAL_ 2015 TimeSinceCodeClear pid 78-78;
SG_MUL_VAL_ 2015 FuelType pid 81-81;
SG_MUL_VAL_ 2015 EthanolFuelPct pid 82-82;
SG_MUL_VAL_ 2015 AbsoluteEVAPSystemVaporPressure pid 83-83;
SG_MUL_VAL_ 2015 EvapSysVapPres pid 84-84;
SG_MUL_VAL_ 2015 O2Secondary_B1_ShortTermFuelTrim pid 85-85;
SG_MUL_VAL_ 2015 O2Secondary_B1_LongTermFuelTrim pid 86-86;
SG_MUL_VAL_ 2015 O2Secondary_B2_ShortTermFuelTrim pid 87-87;
SG_MUL_VAL_ 2015 O2Secondary_B2_LongTermFuelTrim pid 88-88;
SG_MUL_VAL_ 2015 FuelRailPressureAbsolute pid 89-89;
SG_MUL_VAL_ 2015 RelativeAcceleratorPedalPosition pid 90-90;
SG_MUL_VAL_ 2015 HybridBattteryPackRemainingLife pid 91-91;
SG_MUL_VAL_ 2015 EngineOilTemp pid 92-92;
SG_MUL_VAL_ 2015 FuelInjectionTiming pid 93-93;
SG_MUL_VAL_ 2015 EngineFuelRate pid 94-94;
SG_MUL_VAL_ 2015 EmissionRequirements pid 95-95;
SG_MUL_VAL_ 2015 PID_79_Supported pid 96-96;
SG_MUL_VAL_ 2015 EngineTorqueDemand pid 97-97;
SG_MUL_VAL_ 2015 EngineTorque pid 98-98;
SG_MUL_VAL_ 2015 EngineTorqueReference pid 99-99;
SG_MUL_VAL_ 2015 EngineTorqueIdle pid 100-100;
SG_MUL_VAL_ 2015 CmdDieselIntAir pid 106-106;
SG_MUL_VAL_ 2015 ExhaustGasTemp pid 107-107;
SG_MUL_VAL_ 2015 CommandThrottleActuatorRelative pid 108-108;
SG_MUL_VAL_ 2015 FuelPresContrSys pid 109-109;
SG_MUL_VAL_ 2015 InjPresContrSys pid 110-110;
SG_MUL_VAL_ 2015 TurboCompressorPressure pid 111-111;
SG_MUL_VAL_ 2015 BoostPresCntrl pid 112-112;
SG_MUL_VAL_ 2015 PID_99_Supported pid 128-128;
SG_MUL_VAL_ 2015 IntakeManifoldSurfaceTemperature pid 132-132;
SG_MUL_VAL_ 2015 EngineFrictionTorque pid 142-142;
SG_MUL_VAL_ 2015 PID_B9_Supported pid 160-160;
SG_MUL_VAL_ 2015 Odometer pid 166-166;
SG_MUL_VAL_ 2015 PID_D9_Supported pid 192-192;
SG_MUL_VAL_ 2015 pid mode 1-1;
SG_MUL_VAL_ 2024 EGR_B_CommandedDutyCyclePosition pid 105-105;
SG_MUL_VAL_ 2024 IAT_B2S1 pid 104-104;
SG_MUL_VAL_ 2024 EngineTorquePoint4 pid 100-100;
SG_MUL_VAL_ 2024 PID_08_Supported pid 0-0;
SG_MUL_VAL_ 2024 PID_28_Supported pid 32-32;
SG_MUL_VAL_ 2024 PID_48_Supported pid 64-64;
SG_MUL_VAL_ 2024 Cat_NMHCCatMonitorStatus pid 65-65;
SG_MUL_VAL_ 2024 PID_68_Supported pid 96-96;
SG_MUL_VAL_ 2024 PID_88_Supported pid 128-128;
SG_MUL_VAL_ 2024 PID_A8_Supported pid 160-160;
SG_MUL_VAL_ 2024 PID_C8_Supported pid 192-192;
SG_MUL_VAL_ 2024 PID_07_Supported pid 0-0;
SG_MUL_VAL_ 2024 PID_27_Supported pid 32-32;
SG_MUL_VAL_ 2024 PID_47_Supported pid 64-64;
SG_MUL_VAL_ 2024 HeatedCat_NOxSCRMonitorStatus pid 65-65;
SG_MUL_VAL_ 2024 PID_67_Supported pid 96-96;
SG_MUL_VAL_ 2024 PID_87_Supported pid 128-128;
SG_MUL_VAL_ 2024 PID_A7_Supported pid 160-160;
SG_MUL_VAL_ 2024 PID_C7_Supported pid 192-192;
SG_MUL_VAL_ 2024 PID_06_Supported pid 0-0;
SG_MUL_VAL_ 2024 PID_26_Supported pid 32-32;
SG_MUL_VAL_ 2024 PID_46_Supported pid 64-64;
SG_MUL_VAL_ 2024 EvapMonitorStatus pid 65-65;
SG_MUL_VAL_ 2024 PID_66_Supported pid 96-96;
SG_MUL_VAL_ 2024 PID_86_Supported pid 128-128;
SG_MUL_VAL_ 2024 PID_A6_Supported pid 160-160;
SG_MUL_VAL_ 2024 PID_C6_Supported pid 192-192;
SG_MUL_VAL_ 2024 PID_05_Supported pid 0-0;
SG_MUL_VAL_ 2024 PID_25_Supported pid 32-32;
SG_MUL_VAL_ 2024 PID_45_Supported pid 64-64;
SG_MUL_VAL_ 2024 SecondaryAir_BoostPressureM_0001 pid 65-65;
SG_MUL_VAL_ 2024 PID_65_Supported pid 96-96;
SG_MUL_VAL_ 2024 PID_85_Supported pid 128-128;
SG_MUL_VAL_ 2024 PID_A5_Supported pid 160-160;
SG_MUL_VAL_ 2024 PID_C5_Supported pid 192-192;
SG_MUL_VAL_ 2024 PID_04_Supported pid 0-0;
SG_MUL_VAL_ 2024 PID_24_Supported pid 32-32;
SG_MUL_VAL_ 2024 PID_44_Supported pid 64-64;
SG_MUL_VAL_ 2024 PID_64_Supported pid 96-96;
SG_MUL_VAL_ 2024 PID_84_Supported pid 128-128;
SG_MUL_VAL_ 2024 PID_A4_Supported pid 160-160;
SG_MUL_VAL_ 2024 PID_C4_Supported pid 192-192;
SG_MUL_VAL_ 2024 PID_03_Supported pid 0-0;
SG_MUL_VAL_ 2024 PID_23_Supported pid 32-32;
SG_MUL_VAL_ 2024 PID_43_Supported pid 64-64;
SG_MUL_VAL_ 2024 O2_ExhaustGasMonitorStatus pid 65-65;
SG_MUL_VAL_ 2024 PID_63_Supported pid 96-96;
SG_MUL_VAL_ 2024 PID_83_Supported pid 128-128;
SG_MUL_VAL_ 2024 PID_A3_Supported pid 160-160;
SG_MUL_VAL_ 2024 PID_C3_Supported pid 192-192;
SG_MUL_VAL_ 2024 PID_02_Supported pid 0-0;
SG_MUL_VAL_ 2024 PID_22_Supported pid 32-32;
SG_MUL_VAL_ 2024 PID_42_Supported pid 64-64;
SG_MUL_VAL_ 2024 O2_PMFilterMonitorStatus pid 65-65;
SG_MUL_VAL_ 2024 PID_62_Supported pid 96-96;
SG_MUL_VAL_ 2024 PID_82_Supported pid 128-128;
SG_MUL_VAL_ 2024 PID_A2_Supported pid 160-160;
SG_MUL_VAL_ 2024 PID_C2_Supported pid 192-192;
SG_MUL_VAL_ 2024 EGR_A_Error pid 105-105;
SG_MUL_VAL_ 2024 IAT_B1S3 pid 104-104;
SG_MUL_VAL_ 2024 MAFSensorB pid 102-102;
SG_MUL_VAL_ 2024 MaximumValueForIntakeManifo_0000 pid 79-79;
SG_MUL_VAL_ 2024 PID_01_Supported pid 0-0;
SG_MUL_VAL_ 2024 PID_21_Supported pid 32-32;
SG_MUL_VAL_ 2024 PID_41_Supported pid 64-64;
SG_MUL_VAL_ 2024 EGR_VVTMonitorStatus pid 65-65;
SG_MUL_VAL_ 2024 PID_61_Supported pid 96-96;
SG_MUL_VAL_ 2024 EngineTorquePoint3 pid 100-100;
SG_MUL_VAL_ 2024 PID_81_Supported pid 128-128;
SG_MUL_VAL_ 2024 NOxConcentrationB1S2 pid 131-131;
SG_MUL_VAL_ 2024 NOxAvgDemReagentConsumption pid 133-133;
SG_MUL_VAL_ 2024 PMConcentration_B2S1 pid 134-134;
SG_MUL_VAL_ 2024 IntakeManifoldAbsolutePressureB pid 135-135;
SG_MUL_VAL_ 2024 PID_A1_Supported pid 160-160;
SG_MUL_VAL_ 2024 PID_C1_Supported pid 192-192;
SG_MUL_VAL_ 2024 PID_10_Supported pid 0-0;
SG_MUL_VAL_ 2024 PID_30_Supported pid 32-32;
SG_MUL_VAL_ 2024 PID_50_Supported pid 64-64;
SG_MUL_VAL_ 2024 Cat_NMHCCatMonitorEnabled pid 65-65;
SG_MUL_VAL_ 2024 PID_70_Supported pid 96-96;
SG_MUL_VAL_ 2024 PID_90_Supported pid 128-128;
SG_MUL_VAL_ 2024 PID_B0_Supported pid 160-160;
SG_MUL_VAL_ 2024 PID_D0_Supported pid 192-192;
SG_MUL_VAL_ 2024 PID_0F_Supported pid 0-0;
SG_MUL_VAL_ 2024 PID_2F_Supported pid 32-32;
SG_MUL_VAL_ 2024 PID_4F_Supported pid 64-64;
SG_MUL_VAL_ 2024 HeatedCat_NOxSCRMonitorEnabled pid 65-65;
SG_MUL_VAL_ 2024 PID_6F_Supported pid 96-96;
SG_MUL_VAL_ 2024 PID_8F_Supported pid 128-128;
SG_MUL_VAL_ 2024 PID_AF_Supported pid 160-160;
SG_MUL_VAL_ 2024 PID_CF_Supported pid 192-192;
SG_MUL_VAL_ 2024 PID_0E_Supported pid 0-0;
SG_MUL_VAL_ 2024 PID_2E_Supported pid 32-32;
SG_MUL_VAL_ 2024 PID_4E_Supported pid 64-64;
SG_MUL_VAL_ 2024 EvapMonitorEnabled pid 65-65;
SG_MUL_VAL_ 2024 PID_6E_Supported pid 96-96;
SG_MUL_VAL_ 2024 PID_8E_Supported pid 128-128;
SG_MUL_VAL_ 2024 PID_AE_Supported pid 160-160;
SG_MUL_VAL_ 2024 PID_CE_Supported pid 192-192;
SG_MUL_VAL_ 2024 PID_0D_Supported pid 0-0;
SG_MUL_VAL_ 2024 PID_2D_Supported pid 32-32;
SG_MUL_VAL_ 2024 PID_4D_Supported pid 64-64;
SG_MUL_VAL_ 2024 SecondaryAir_BoostPressureM_0002 pid 65-65;
SG_MUL_VAL_ 2024 PID_6D_Supported pid 96-96;
SG_MUL_VAL_ 2024 PID_8D_Supported pid 128-128;
SG_MUL_VAL_ 2024 PID_AD_Supported pid 160-160;
SG_MUL_VAL_ 2024 PID_CD_Supported pid 192-192;
SG_MUL_VAL_ 2024 PID_0C_Supported pid 0-0;
SG_MUL_VAL_ 2024 PID_2C_Supported pid 32-32;
SG_MUL_VAL_ 2024 PID_4C_Supported pid 64-64;
SG_MUL_VAL_ 2024 PID_6C_Supported pid 96-96;
SG_MUL_VAL_ 2024 PID_8C_Supported pid 128-128;
SG_MUL_VAL_ 2024 PID_AC_Supported pid 160-160;
SG_MUL_VAL_ 2024 PID_CC_Supported pid 192-192;
SG_MUL_VAL_ 2024 PID_0B_Supported pid 0-0;
SG_MUL_VAL_ 2024 PID_2B_Supported pid 32-32;
SG_MUL_VAL_ 2024 PID_4B_Supported pid 64-64;
SG_MUL_VAL_ 2024 O2_ExhaustGasMonitorEnabled pid 65-65;
SG_MUL_VAL_ 2024 PID_6B_Supported pid 96-96;
SG_MUL_VAL_ 2024 PID_8B_Supported pid 128-128;
SG_MUL_VAL_ 2024 PID_AB_Supported pid 160-160;
SG_MUL_VAL_ 2024 PID_CB_Supported pid 192-192;
SG_MUL_VAL_ 2024 PID_0A_Supported pid 0-0;
SG_MUL_VAL_ 2024 PID_2A_Supported pid 32-32;
SG_MUL_VAL_ 2024 PID_4A_Supported pid 64-64;
SG_MUL_VAL_ 2024 O2Heater_PMFilterMonitorEnabled pid 65-65;
SG_MUL_VAL_ 2024 PID_6A_Supported pid 96-96;
SG_MUL_VAL_ 2024 PID_8A_Supported pid 128-128;
SG_MUL_VAL_ 2024 PID_AA_Supported pid 160-160;
SG_MUL_VAL_ 2024 PID_CA_Supported pid 192-192;
SG_MUL_VAL_ 2024 EGR_A_DutyCyclePosition pid 105-105;
SG_MUL_VAL_ 2024 IAT_B1S2 pid 104-104;
SG_MUL_VAL_ 2024 ECTSensorB pid 103-103;
SG_MUL_VAL_ 2024 MaximumValueForOxygenSensor_0000 pid 79-79;
SG_MUL_VAL_ 2024 PID_09_Supported pid 0-0;
SG_MUL_VAL_ 2024 PID_29_Supported pid 32-32;
SG_MUL_VAL_ 2024 O2_B1S1_WB_Volt pid 36-36;
SG_MUL_VAL_ 2024 O2_B1S2_WB_Volt pid 37-37;
SG_MUL_VAL_ 2024 O2_B1S3_WB_Volt pid 38-38;
SG_MUL_VAL_ 2024 O2_B1S4_WB_Volt pid 39-39;
SG_MUL_VAL_ 2024 O2_B2S1_WB_Volt pid 40-40;
SG_MUL_VAL_ 2024 O2_B2S2_WB_Volt pid 41-41;
SG_MUL_VAL_ 2024 O2_B2S3_WB_Volt pid 42-42;
SG_MUL_VAL_ 2024 O2_B2S4_WB_Volt pid 43-43;
SG_MUL_VAL_ 2024 O2_B1S1_WB_Current pid 52-52;
SG_MUL_VAL_ 2024 O2_B1S2_WB_Current pid 53-53;
SG_MUL_VAL_ 2024 O2_B1S3_WB_Current pid 54-54;
SG_MUL_VAL_ 2024 O2_B1S4_WB_Current pid 55-55;
SG_MUL_VAL_ 2024 O2_B2S1_WB_Current pid 56-56;
SG_MUL_VAL_ 2024 O2_B2S2_WB_Current pid 57-57;
SG_MUL_VAL_ 2024 O2_B2S3_WB_Current pid 58-58;
SG_MUL_VAL_ 2024 O2_B2S4_WB_Current pid 59-59;
SG_MUL_VAL_ 2024 PID_49_Supported pid 64-64;
SG_MUL_VAL_ 2024 EGR_VVTSystemMonitorEnabled pid 65-65;
SG_MUL_VAL_ 2024 PID_69_Supported pid 96-96;
SG_MUL_VAL_ 2024 EngineTorquePoint2 pid 100-100;
SG_MUL_VAL_ 2024 PID_89_Supported pid 128-128;
SG_MUL_VAL_ 2024 PID_A9_Supported pid 160-160;
SG_MUL_VAL_ 2024 PID_C9_Supported pid 192-192;
SG_MUL_VAL_ 2024 PTOStatus2 pid 101-101;
SG_MUL_VAL_ 2024 PID_18_Supported pid 0-0;
SG_MUL_VAL_ 2024 PID_38_Supported pid 32-32;
SG_MUL_VAL_ 2024 PID_58_Supported pid 64-64;
SG_MUL_VAL_ 2024 MisfireMonitorEnabled pid 65-65;
SG_MUL_VAL_ 2024 PID_78_Supported pid 96-96;
SG_MUL_VAL_ 2024 PID_98_Supported pid 128-128;
SG_MUL_VAL_ 2024 PID_B8_Supported pid 160-160;
SG_MUL_VAL_ 2024 PID_D8_Supported pid 192-192;
SG_MUL_VAL_ 2024 AutomaticTransmissionGearStatus pid 101-101;
SG_MUL_VAL_ 2024 PID_17_Supported pid 0-0;
SG_MUL_VAL_ 2024 PID_37_Supported pid 32-32;
SG_MUL_VAL_ 2024 PID_57_Supported pid 64-64;
SG_MUL_VAL_ 2024 FuelSystemMonitorEnabled pid 65-65;
SG_MUL_VAL_ 2024 PID_77_Supported pid 96-96;
SG_MUL_VAL_ 2024 PID_97_Supported pid 128-128;
SG_MUL_VAL_ 2024 PID_B7_Supported pid 160-160;
SG_MUL_VAL_ 2024 PID_D7_Supported pid 192-192;
SG_MUL_VAL_ 2024 ManualTransmissionGearStatus pid 101-101;
SG_MUL_VAL_ 2024 PID_16_Supported pid 0-0;
SG_MUL_VAL_ 2024 PID_36_Supported pid 32-32;
SG_MUL_VAL_ 2024 PID_56_Supported pid 64-64;
SG_MUL_VAL_ 2024 CompComponentMonitorEnabled pid 65-65;
SG_MUL_VAL_ 2024 PID_76_Supported pid 96-96;
SG_MUL_VAL_ 2024 PID_96_Supported pid 128-128;
SG_MUL_VAL_ 2024 PID_B6_Supported pid 160-160;
SG_MUL_VAL_ 2024 PID_D6_Supported pid 192-192;
SG_MUL_VAL_ 2024 GlowPlugLampStatus pid 101-101;
SG_MUL_VAL_ 2024 PID_15_Supported pid 0-0;
SG_MUL_VAL_ 2024 PID_35_Supported pid 32-32;
SG_MUL_VAL_ 2024 PID_55_Supported pid 64-64;
SG_MUL_VAL_ 2024 IgnitionMonitorType pid 65-65;
SG_MUL_VAL_ 2024 PID_75_Supported pid 96-96;
SG_MUL_VAL_ 2024 PID_95_Supported pid 128-128;
SG_MUL_VAL_ 2024 PID_B5_Supported pid 160-160;
SG_MUL_VAL_ 2024 PID_D5_Supported pid 192-192;
SG_MUL_VAL_ 2024 PID_14_Supported pid 0-0;
SG_MUL_VAL_ 2024 PID_34_Supported pid 32-32;
SG_MUL_VAL_ 2024 PID_54_Supported pid 64-64;
SG_MUL_VAL_ 2024 MisfireMonitorStatus pid 65-65;
SG_MUL_VAL_ 2024 PID_74_Supported pid 96-96;
SG_MUL_VAL_ 2024 PID_94_Supported pid 128-128;
SG_MUL_VAL_ 2024 PID_B4_Supported pid 160-160;
SG_MUL_VAL_ 2024 PID_D4_Supported pid 192-192;
SG_MUL_VAL_ 2024 PID_13_Supported pid 0-0;
SG_MUL_VAL_ 2024 PID_33_Supported pid 32-32;
SG_MUL_VAL_ 2024 PID_53_Supported pid 64-64;
SG_MUL_VAL_ 2024 FuelSystemMonitorStatus pid 65-65;
SG_MUL_VAL_ 2024 PID_73_Supported pid 96-96;
SG_MUL_VAL_ 2024 PID_93_Supported pid 128-128;
SG_MUL_VAL_ 2024 PID_B3_Supported pid 160-160;
SG_MUL_VAL_ 2024 PID_D3_Supported pid 192-192;
SG_MUL_VAL_ 2024 PID_12_Supported pid 0-0;
SG_MUL_VAL_ 2024 PID_32_Supported pid 32-32;
SG_MUL_VAL_ 2024 PID_52_Supported pid 64-64;
SG_MUL_VAL_ 2024 CompComponentMonitorStatus pid 65-65;
SG_MUL_VAL_ 2024 PID_72_Supported pid 96-96;
SG_MUL_VAL_ 2024 PID_92_Supported pid 128-128;
SG_MUL_VAL_ 2024 PID_B2_Supported pid 160-160;
SG_MUL_VAL_ 2024 PID_D2_Supported pid 192-192;
SG_MUL_VAL_ 2024 EGR_A_CommandedDutyCyclePosition pid 105-105;
SG_MUL_VAL_ 2024 IAT_B1S1 pid 104-104;
SG_MUL_VAL_ 2024 ECTSensorA pid 103-103;
SG_MUL_VAL_ 2024 MAFSensorA pid 102-102;
SG_MUL_VAL_ 2024 MaximumValueForOxygenSensor_0001 pid 79-79;
SG_MUL_VAL_ 2024 PID_11_Supported pid 0-0;
SG_MUL_VAL_ 2024 FuelSystem2Status pid 3-3;
SG_MUL_VAL_ 2024 ShortTermFuelTrim_B3 pid 6-6;
SG_MUL_VAL_ 2024 LongTermFuelTrim_B3 pid 7-7;
SG_MUL_VAL_ 2024 ShortTermFuelTrim_B4 pid 8-8;
SG_MUL_VAL_ 2024 LongTermFuelTrim_B4 pid 9-9;
SG_MUL_VAL_ 2024 O2_B1S1_ShortTermFuelTrim pid 20-20;
SG_MUL_VAL_ 2024 O2_B1S2_ShortTermFuelTrim pid 21-21;
SG_MUL_VAL_ 2024 O2_B1S3_ShortTermFuelTrim pid 22-22;
SG_MUL_VAL_ 2024 O2_B1S4_ShortTermFuelTrim pid 23-23;
SG_MUL_VAL_ 2024 O2_B2S1_ShortTermFuelTrim pid 24-24;
SG_MUL_VAL_ 2024 O2_B2S2_ShortTermFuelTrim pid 25-25;
SG_MUL_VAL_ 2024 O2_B2S3_ShortTermFuelTrim pid 26-26;
SG_MUL_VAL_ 2024 O2_B2S4_ShortTermFuelTrim pid 27-27;
SG_MUL_VAL_ 2024 PID_31_Supported pid 32-32;
SG_MUL_VAL_ 2024 PID_51_Supported pid 64-64;
SG_MUL_VAL_ 2024 O2Secondary_B3_ShortTermFuelTrim pid 85-85;
SG_MUL_VAL_ 2024 O2Secondary_B3_LongTermFuelTrim pid 86-86;
SG_MUL_VAL_ 2024 O2Secondary_B4_ShortTermFuelTrim pid 87-87;
SG_MUL_VAL_ 2024 O2Secondary_B4_LongTermFuelTrim pid 88-88;
SG_MUL_VAL_ 2024 PID_71_Supported pid 96-96;
SG_MUL_VAL_ 2024 EngineTorquePoint1 pid 100-100;
SG_MUL_VAL_ 2024 PID_91_Supported pid 128-128;
SG_MUL_VAL_ 2024 NOxConcentrationB1S1 pid 131-131;
SG_MUL_VAL_ 2024 NOxAvgReagentConsumption pid 133-133;
SG_MUL_VAL_ 2024 PMConcentration_B1S1 pid 134-134;
SG_MUL_VAL_ 2024 IntakeManifoldAbsolutePressureA pid 135-135;
SG_MUL_VAL_ 2024 PID_B1_Supported pid 160-160;
SG_MUL_VAL_ 2024 PID_D1_Supported pid 192-192;
SG_MUL_VAL_ 2024 IAT_B1S1_Support pid 104-104;
SG_MUL_VAL_ 2024 ECTSensorASupport pid 103-103;
SG_MUL_VAL_ 2024 MAFSensorASupport pid 102-102;
SG_MUL_VAL_ 2024 PTOStatus2Support pid 101-101;
SG_MUL_VAL_ 2024 PID_20_Supported pid 0-0;
SG_MUL_VAL_ 2024 IntakeManifoldAbsolutePress_0000 pid 135-135;
SG_MUL_VAL_ 2024 O2_B1S1_Supported pid 19-19;
SG_MUL_VAL_ 2024 PTOStatus pid 30-30;
SG_MUL_VAL_ 2024 PID_40_Supported pid 32-32;
SG_MUL_VAL_ 2024 PID_60_Supported pid 64-64;
SG_MUL_VAL_ 2024 PID_80_Supported pid 96-96;
SG_MUL_VAL_ 2024 PID_A0_Supported pid 128-128;
SG_MUL_VAL_ 2024 NOxConcentrationB1S1Supported pid 131-131;
SG_MUL_VAL_ 2024 NOxReagentSupported pid 133-133;
SG_MUL_VAL_ 2024 PMConcentration_B1S1_Supported pid 134-134;
SG_MUL_VAL_ 2024 PID_C0_Supported pid 160-160;
SG_MUL_VAL_ 2024 PID_E0_Supported pid 192-192;
SG_MUL_VAL_ 2024 EGR_A_DutyCyclePositionSupport pid 105-105;
SG_MUL_VAL_ 2024 IAT_B1S2_Support pid 104-104;
SG_MUL_VAL_ 2024 ECTSensorBSupport pid 103-103;
SG_MUL_VAL_ 2024 MAFSensorBSupport pid 102-102;
SG_MUL_VAL_ 2024 AutomaticTransmissionGearSt_0000 pid 101-101;
SG_MUL_VAL_ 2024 PID_1F_Supported pid 0-0;
SG_MUL_VAL_ 2024 O2_B1S2_Supported pid 19-19;
SG_MUL_VAL_ 2024 PID_3F_Supported pid 32-32;
SG_MUL_VAL_ 2024 PID_5F_Supported pid 64-64;
SG_MUL_VAL_ 2024 PID_7F_Supported pid 96-96;
SG_MUL_VAL_ 2024 PID_9F_Supported pid 128-128;
SG_MUL_VAL_ 2024 NOxConcentrationB1S2Supported pid 131-131;
SG_MUL_VAL_ 2024 NOxReagentDemandedSupported pid 133-133;
SG_MUL_VAL_ 2024 PMConcentration_B2S1_Supported pid 134-134;
SG_MUL_VAL_ 2024 IntakeManifoldAbsolutePress_0001 pid 135-135;
SG_MUL_VAL_ 2024 PID_BF_Supported pid 160-160;
SG_MUL_VAL_ 2024 PID_DF_Supported pid 192-192;
SG_MUL_VAL_ 2024 EGR_A_ErrorSupport pid 105-105;
SG_MUL_VAL_ 2024 IAT_B1S3_Support pid 104-104;
SG_MUL_VAL_ 2024 ManualTransmissionGearStatu_0000 pid 101-101;
SG_MUL_VAL_ 2024 PID_1E_Supported pid 0-0;
SG_MUL_VAL_ 2024 O2_B1S3_Supported pid 19-19;
SG_MUL_VAL_ 2024 PID_3E_Supported pid 32-32;
SG_MUL_VAL_ 2024 PID_5E_Supported pid 64-64;
SG_MUL_VAL_ 2024 PID_7E_Supported pid 96-96;
SG_MUL_VAL_ 2024 PID_9E_Supported pid 128-128;
SG_MUL_VAL_ 2024 NOxConcentrationB2S1Supported pid 131-131;
SG_MUL_VAL_ 2024 NOxReagentLevelSupported pid 133-133;
SG_MUL_VAL_ 2024 PID_BE_Supported pid 160-160;
SG_MUL_VAL_ 2024 PID_DE_Supported pid 192-192;
SG_MUL_VAL_ 2024 IAT_B2S1_Support pid 104-104;
SG_MUL_VAL_ 2024 GlowPlugLampStatusSupport pid 101-101;
SG_MUL_VAL_ 2024 PID_1D_Supported pid 0-0;
SG_MUL_VAL_ 2024 O2_B1S4_Supported pid 19-19;
SG_MUL_VAL_ 2024 PID_3D_Supported pid 32-32;
SG_MUL_VAL_ 2024 PID_5D_Supported pid 64-64;
SG_MUL_VAL_ 2024 PID_7D_Supported pid 96-96;
SG_MUL_VAL_ 2024 PID_9D_Supported pid 128-128;
SG_MUL_VAL_ 2024 NOxConcentrationB2S2Supported pid 131-131;
SG_MUL_VAL_ 2024 NOxRuntimeWarningSupported pid 133-133;
SG_MUL_VAL_ 2024 PID_BD_Supported pid 160-160;
SG_MUL_VAL_ 2024 PID_DD_Supported pid 192-192;
SG_MUL_VAL_ 2024 EGR_B_DutyCyclePositionSupport pid 105-105;
SG_MUL_VAL_ 2024 IAT_B2S2_Support pid 104-104;
SG_MUL_VAL_ 2024 PID_1C_Supported pid 0-0;
SG_MUL_VAL_ 2024 IntakeManifoldAbsolutePressure pid 11-11;
SG_MUL_VAL_ 2024 O2_B2S1_Supported pid 19-19;
SG_MUL_VAL_ 2024 PID_3C_Supported pid 32-32;
SG_MUL_VAL_ 2024 PID_5C_Supported pid 64-64;
SG_MUL_VAL_ 2024 PID_7C_Supported pid 96-96;
SG_MUL_VAL_ 2024 PID_9C_Supported pid 128-128;
SG_MUL_VAL_ 2024 PID_BC_Supported pid 160-160;
SG_MUL_VAL_ 2024 PID_DC_Supported pid 192-192;
SG_MUL_VAL_ 2024 EGR_B_ErrorSupport pid 105-105;
SG_MUL_VAL_ 2024 IAT_B2S3_Support pid 104-104;
SG_MUL_VAL_ 2024 PID_1B_Supported pid 0-0;
SG_MUL_VAL_ 2024 O2_B2S2_Supported pid 19-19;
SG_MUL_VAL_ 2024 PID_3B_Supported pid 32-32;
SG_MUL_VAL_ 2024 PID_5B_Supported pid 64-64;
SG_MUL_VAL_ 2024 PID_7B_Supported pid 96-96;
SG_MUL_VAL_ 2024 PID_9B_Supported pid 128-128;
SG_MUL_VAL_ 2024 PID_BB_Supported pid 160-160;
SG_MUL_VAL_ 2024 PID_DB_Supported pid 192-192;
SG_MUL_VAL_ 2024 PID_1A_Supported pid 0-0;
SG_MUL_VAL_ 2024 O2_B2S3_Supported pid 19-19;
SG_MUL_VAL_ 2024 PID_3A_Supported pid 32-32;
SG_MUL_VAL_ 2024 PID_5A_Supported pid 64-64;
SG_MUL_VAL_ 2024 PID_7A_Supported pid 96-96;
SG_MUL_VAL_ 2024 PID_9A_Supported pid 128-128;
SG_MUL_VAL_ 2024 PID_BA_Supported pid 160-160;
SG_MUL_VAL_ 2024 PID_DA_Supported pid 192-192;
SG_MUL_VAL_ 2024 MaximumValueForMassAirFlowSensor pid 80-80;
SG_MUL_VAL_ 2024 MaximumValueForEquivalenceRatio pid 79-79;
SG_MUL_VAL_ 2024 PID_19_Supported pid 0-0;
SG_MUL_VAL_ 2024 MonitorStatus pid 1-1;
SG_MUL_VAL_ 2024 FreezeDTC pid 2-2;
SG_MUL_VAL_ 2024 FuelSystem1Status pid 3-3;
SG_MUL_VAL_ 2024 CalculatedEngineLoad pid 4-4;
SG_MUL_VAL_ 2024 EngineCoolantTemp pid 5-5;
SG_MUL_VAL_ 2024 ShortTermFuelTrim_B1 pid 6-6;
SG_MUL_VAL_ 2024 LongTermFuelTrim_B1 pid 7-7;
SG_MUL_VAL_ 2024 ShortTermFuelTrim_B2 pid 8-8;
SG_MUL_VAL_ 2024 LongTermFuelTrim_B2 pid 9-9;
SG_MUL_VAL_ 2024 FuelPressure pid 10-10;
SG_MUL_VAL_ 2024 EngineRPM pid 12-12;
SG_MUL_VAL_ 2024 VehicleSpeed pid 13-13;
SG_MUL_VAL_ 2024 TimingAdvance pid 14-14;
SG_MUL_VAL_ 2024 IntakeAirTemp pid 15-15;
SG_MUL_VAL_ 2024 MAFAirFlowRate pid 16-16;
SG_MUL_VAL_ 2024 ThrottlePosition pid 17-17;
SG_MUL_VAL_ 2024 CommandSecondaryAirStatus pid 18-18;
SG_MUL_VAL_ 2024 O2_B2S4_Supported pid 19-19;
SG_MUL_VAL_ 2024 O2_B1S1_Volt pid 20-20;
SG_MUL_VAL_ 2024 O2_B1S2_Volt pid 21-21;
SG_MUL_VAL_ 2024 O2_B1S3_Volt pid 22-22;
SG_MUL_VAL_ 2024 O2_B1S4_Volt pid 23-23;
SG_MUL_VAL_ 2024 O2_B2S1_Volt pid 24-24;
SG_MUL_VAL_ 2024 O2_B2S2_Volt pid 25-25;
SG_MUL_VAL_ 2024 O2_B2S3_Volt pid 26-26;
SG_MUL_VAL_ 2024 O2_B2S4_Volt pid 27-27;
SG_MUL_VAL_ 2024 OBDStandard pid 28-28;
SG_MUL_VAL_ 2024 TimeSinceEngineStart pid 31-31;
SG_MUL_VAL_ 2024 PID_39_Supported pid 32-32;
SG_MUL_VAL_ 2024 DistanceMILOn pid 33-33;
SG_MUL_VAL_ 2024 FuelRailPressureRelativeToM_0000 pid 34-34;
SG_MUL_VAL_ 2024 FuelRailPressure pid 35-35;
SG_MUL_VAL_ 2024 CommandEGR pid 44-44;
SG_MUL_VAL_ 2024 EGRError pid 45-45;
SG_MUL_VAL_ 2024 CommandEVAPPurge pid 46-46;
SG_MUL_VAL_ 2024 FuelTankLevel pid 47-47;
SG_MUL_VAL_ 2024 WarmUpsSinceCodeClear pid 48-48;
SG_MUL_VAL_ 2024 DistanceSinceCodeClear pid 49-49;
SG_MUL_VAL_ 2024 EVAPSystemVaporPressure pid 50-50;
SG_MUL_VAL_ 2024 AbsoluteBarometricPressure pid 51-51;
SG_MUL_VAL_ 2024 O2_B1S1_WB_Lambda pid 52-52;
SG_MUL_VAL_ 2024 O2_B1S2_WB_Lambda pid 53-53;
SG_MUL_VAL_ 2024 O2_B1S3_WB_Lambda pid 54-54;
SG_MUL_VAL_ 2024 O2_B1S4_WB_Lambda pid 55-55;
SG_MUL_VAL_ 2024 O2_B2S1_WB_Lambda pid 56-56;
SG_MUL_VAL_ 2024 O2_B2S2_WB_Lambda pid 57-57;
SG_MUL_VAL_ 2024 O2_B2S3_WB_Lambda pid 58-58;
SG_MUL_VAL_ 2024 O2_B2S4_WB_Lambda pid 59-59;
SG_MUL_VAL_ 2024 CatalystTemperature_B1S1 pid 60-60;
SG_MUL_VAL_ 2024 CatalystTemperature_B2S1 pid 61-61;
SG_MUL_VAL_ 2024 CatalystTemperature_B1S2 pid 62-62;
SG_MUL_VAL_ 2024 CatalystTemperature_B2S2 pid 63-63;
SG_MUL_VAL_ 2024 PID_59_Supported pid 64-64;
SG_MUL_VAL_ 2024 ControlModuleVolt pid 66-66;
SG_MUL_VAL_ 2024 AbsoluteLoadValue pid 67-67;
SG_MUL_VAL_ 2024 FuelAirCommandedLambda pid 68-68;
SG_MUL_VAL_ 2024 RelativeThrottlePosition pid 69-69;
SG_MUL_VAL_ 2024 AmbientAirTemp pid 70-70;
SG_MUL_VAL_ 2024 AbsoluteThrottlePositionB pid 71-71;
SG_MUL_VAL_ 2024 AbsoluteThrottlePositionC pid 72-72;
SG_MUL_VAL_ 2024 AbsoluteThrottlePositionD pid 73-73;
SG_MUL_VAL_ 2024 AbsoluteThrottlePositionE pid 74-74;
SG_MUL_VAL_ 2024 AbsoluteThrottlePositionF pid 75-75;
SG_MUL_VAL_ 2024 CommandThrottleActuator pid 76-76;
SG_MUL_VAL_ 2024 TimeRunMILOn pid 77-77;
SG_MUL_VAL_ 2024 TimeSinceCodeClear pid 78-78;
SG_MUL_VAL_ 2024 FuelType pid 81-81;
SG_MUL_VAL_ 2024 EthanolFuelPct pid 82-82;
SG_MUL_VAL_ 2024 AbsoluteEVAPSystemVaporPressure pid 83-83;
SG_MUL_VAL_ 2024 EvapSysVapPres pid 84-84;
SG_MUL_VAL_ 2024 O2Secondary_B1_ShortTermFuelTrim pid 85-85;
SG_MUL_VAL_ 2024 O2Secondary_B1_LongTermFuelTrim pid 86-86;
SG_MUL_VAL_ 2024 O2Secondary_B2_ShortTermFuelTrim pid 87-87;
SG_MUL_VAL_ 2024 O2Secondary_B2_LongTermFuelTrim pid 88-88;
SG_MUL_VAL_ 2024 FuelRailPressureAbsolute pid 89-89;
SG_MUL_VAL_ 2024 RelativeAcceleratorPedalPosition pid 90-90;
SG_MUL_VAL_ 2024 HybridBattteryPackRemainingLife pid 91-91;
SG_MUL_VAL_ 2024 EngineOilTemp pid 92-92;
SG_MUL_VAL_ 2024 FuelInjectionTiming pid 93-93;
SG_MUL_VAL_ 2024 EngineFuelRate pid 94-94;
SG_MUL_VAL_ 2024 EmissionRequirements pid 95-95;
SG_MUL_VAL_ 2024 PID_79_Supported pid 96-96;
SG_MUL_VAL_ 2024 EngineTorqueDemand pid 97-97;
SG_MUL_VAL_ 2024 EngineTorque pid 98-98;
SG_MUL_VAL_ 2024 EngineTorqueReference pid 99-99;
SG_MUL_VAL_ 2024 EngineTorqueIdle pid 100-100;
SG_MUL_VAL_ 2024 CmdDieselIntAir pid 106-106;
SG_MUL_VAL_ 2024 ExhaustGasTemp pid 107-107;
SG_MUL_VAL_ 2024 CommandThrottleActuatorRelative pid 108-108;
SG_MUL_VAL_ 2024 FuelPresContrSys pid 109-109;
SG_MUL_VAL_ 2024 InjPresContrSys pid 110-110;
SG_MUL_VAL_ 2024 TurboCompressorPressure pid 111-111;
SG_MUL_VAL_ 2024 BoostPresCntrl pid 112-112;
SG_MUL_VAL_ 2024 PID_99_Supported pid 128-128;
SG_MUL_VAL_ 2024 IntakeManifoldSurfaceTemperature pid 132-132;
SG_MUL_VAL_ 2024 EngineFrictionTorque pid 142-142;
SG_MUL_VAL_ 2024 PID_B9_Supported pid 160-160;
SG_MUL_VAL_ 2024 Odometer pid 166-166;
SG_MUL_VAL_ 2024 PID_D9_Supported pid 192-192;
SG_MUL_VAL_ 2024 S2_PID_02_FreezeDTC ParameterID_Service02 2-2;
SG_MUL_VAL_ 2024 pid mode 1-1;
SG_MUL_VAL_ 2024 ParameterID_Service02 mode 2-2;
